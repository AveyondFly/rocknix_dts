/dts-v1/;

/ {
	compatible = "rockchip,rk3566-rk817-tablet\0rockchip,rk3566";
	interrupt-parent = <0x01>;
	#address-cells = <0x02>;
	#size-cells = <0x02>;
	model = "GameMT E6 Plus";

	ddr3-params {
		version = <0x100>;
		expanded_version = <0x00>;
		reserved = <0x00>;
		freq_0 = <0x420>;
		freq_1 = <0x144>;
		freq_2 = <0x210>;
		freq_3 = <0x30c>;
		freq_4 = <0x00>;
		freq_5 = <0x00>;
		pd_idle = <0x0d>;
		sr_idle = <0x5d>;
		sr_mc_gate_idle = <0x00>;
		srpd_lite_idle = <0x00>;
		standby_idle = <0x00>;
		pd_dis_freq = <0x42a>;
		sr_dis_freq = <0x320>;
		dram_dll_dis_freq = <0x12c>;
		phy_dll_dis_freq = <0x00>;
		phy_dq_drv_odten = <0x21>;
		phy_ca_drv_odten = <0x21>;
		phy_clk_drv_odten = <0x21>;
		dram_dq_drv_odten = <0x22>;
		phy_dq_drv_odtoff = <0x21>;
		phy_ca_drv_odtoff = <0x21>;
		phy_clk_drv_odtoff = <0x21>;
		dram_dq_drv_odtoff = <0x22>;
		dram_odt = <0x78>;
		phy_odt = <0xa7>;
		phy_odt_puup_en = <0x01>;
		phy_odt_pudn_en = <0x01>;
		dram_dq_odt_en_freq = <0x14d>;
		phy_odt_en_freq = <0x14d>;
		phy_dq_sr_odten = <0x0f>;
		phy_ca_sr_odten = <0x03>;
		phy_clk_sr_odten = <0x00>;
		phy_dq_sr_odtoff = <0x0f>;
		phy_ca_sr_odtoff = <0x03>;
		phy_clk_sr_odtoff = <0x00>;
		ssmod_downspread = <0x00>;
		ssmod_div = <0x00>;
		ssmod_spread = <0x00>;
		mode_2t = <0x00>;
		speed_bin = <0x15>;
		dram_ext_temp = <0x00>;
		byte_map = <0xe4>;
		dq_map_cs0_dq_l = <0x00>;
		dq_map_cs0_dq_h = <0x00>;
		dq_map_cs1_dq_l = <0x00>;
		dq_map_cs1_dq_h = <0x00>;
		phandle = <0x99>;
	};

	ddr4-params {
		version = <0x100>;
		expanded_version = <0x00>;
		reserved = <0x00>;
		freq_0 = <0x420>;
		freq_1 = <0x144>;
		freq_2 = <0x210>;
		freq_3 = <0x30c>;
		freq_4 = <0x00>;
		freq_5 = <0x00>;
		pd_idle = <0x0d>;
		sr_idle = <0x5d>;
		sr_mc_gate_idle = <0x00>;
		srpd_lite_idle = <0x00>;
		standby_idle = <0x00>;
		pd_dis_freq = <0x42a>;
		sr_dis_freq = <0x320>;
		dram_dll_dis_freq = <0x271>;
		phy_dll_dis_freq = <0x00>;
		phy_dq_drv_odten = <0x25>;
		phy_ca_drv_odten = <0x25>;
		phy_clk_drv_odten = <0x25>;
		dram_dq_drv_odten = <0x22>;
		phy_dq_drv_odtoff = <0x25>;
		phy_ca_drv_odtoff = <0x25>;
		phy_clk_drv_odtoff = <0x25>;
		dram_dq_drv_odtoff = <0x22>;
		dram_odt = <0x78>;
		phy_odt = <0x8b>;
		phy_odt_puup_en = <0x01>;
		phy_odt_pudn_en = <0x01>;
		dram_dq_odt_en_freq = <0x1f4>;
		phy_odt_en_freq = <0x1f4>;
		phy_dq_sr_odten = <0x0e>;
		phy_ca_sr_odten = <0x01>;
		phy_clk_sr_odten = <0x01>;
		phy_dq_sr_odtoff = <0x0e>;
		phy_ca_sr_odtoff = <0x01>;
		phy_clk_sr_odtoff = <0x01>;
		ssmod_downspread = <0x00>;
		ssmod_div = <0x00>;
		ssmod_spread = <0x00>;
		mode_2t = <0x00>;
		speed_bin = <0x0c>;
		dram_ext_temp = <0x00>;
		byte_map = <0xe4>;
		dq_map_cs0_dq_l = <0x22777788>;
		dq_map_cs0_dq_h = <0xd7888877>;
		dq_map_cs1_dq_l = <0x22777788>;
		dq_map_cs1_dq_h = <0xd7888877>;
		phandle = <0x9a>;
	};

	lpddr3-params {
		version = <0x100>;
		expanded_version = <0x00>;
		reserved = <0x00>;
		freq_0 = <0x420>;
		freq_1 = <0x144>;
		freq_2 = <0x210>;
		freq_3 = <0x30c>;
		freq_4 = <0x00>;
		freq_5 = <0x00>;
		pd_idle = <0x0d>;
		sr_idle = <0x5d>;
		sr_mc_gate_idle = <0x00>;
		srpd_lite_idle = <0x00>;
		standby_idle = <0x00>;
		pd_dis_freq = <0x42a>;
		sr_dis_freq = <0x320>;
		dram_dll_dis_freq = <0x00>;
		phy_dll_dis_freq = <0x00>;
		phy_dq_drv_odten = <0x25>;
		phy_ca_drv_odten = <0x25>;
		phy_clk_drv_odten = <0x27>;
		dram_dq_drv_odten = <0x22>;
		phy_dq_drv_odtoff = <0x25>;
		phy_ca_drv_odtoff = <0x25>;
		phy_clk_drv_odtoff = <0x27>;
		dram_dq_drv_odtoff = <0x22>;
		dram_odt = <0x78>;
		phy_odt = <0x94>;
		phy_odt_puup_en = <0x01>;
		phy_odt_pudn_en = <0x01>;
		dram_dq_odt_en_freq = <0x14d>;
		phy_odt_en_freq = <0x14d>;
		phy_dq_sr_odten = <0x0f>;
		phy_ca_sr_odten = <0x01>;
		phy_clk_sr_odten = <0x0f>;
		phy_dq_sr_odtoff = <0x0f>;
		phy_ca_sr_odtoff = <0x01>;
		phy_clk_sr_odtoff = <0x0f>;
		ssmod_downspread = <0x00>;
		ssmod_div = <0x00>;
		ssmod_spread = <0x00>;
		mode_2t = <0x00>;
		speed_bin = <0x00>;
		dram_ext_temp = <0x00>;
		byte_map = <0x8d>;
		dq_map_cs0_dq_l = <0x00>;
		dq_map_cs0_dq_h = <0x00>;
		dq_map_cs1_dq_l = <0x00>;
		dq_map_cs1_dq_h = <0x00>;
		phandle = <0x9b>;
	};

	lpddr4-params {
		version = <0x100>;
		expanded_version = <0x00>;
		reserved = <0x00>;
		freq_0 = <0x420>;
		freq_1 = <0x144>;
		freq_2 = <0x210>;
		freq_3 = <0x30c>;
		freq_4 = <0x00>;
		freq_5 = <0x00>;
		pd_idle = <0x0d>;
		sr_idle = <0x5d>;
		sr_mc_gate_idle = <0x00>;
		srpd_lite_idle = <0x00>;
		standby_idle = <0x00>;
		pd_dis_freq = <0x42a>;
		sr_dis_freq = <0x320>;
		dram_dll_dis_freq = <0x00>;
		phy_dll_dis_freq = <0x00>;
		phy_dq_drv_odten = <0x1e>;
		phy_ca_drv_odten = <0x26>;
		phy_clk_drv_odten = <0x26>;
		dram_dq_drv_odten = <0x28>;
		phy_dq_drv_odtoff = <0x1e>;
		phy_ca_drv_odtoff = <0x26>;
		phy_clk_drv_odtoff = <0x26>;
		dram_dq_drv_odtoff = <0x28>;
		dram_odt = <0x50>;
		phy_odt = <0x3c>;
		phy_odt_puup_en = <0x00>;
		phy_odt_pudn_en = <0x00>;
		dram_dq_odt_en_freq = <0x320>;
		phy_odt_en_freq = <0x320>;
		phy_dq_sr_odten = <0x00>;
		phy_ca_sr_odten = <0x0f>;
		phy_clk_sr_odten = <0x0f>;
		phy_dq_sr_odtoff = <0x00>;
		phy_ca_sr_odtoff = <0x0f>;
		phy_clk_sr_odtoff = <0x0f>;
		ssmod_downspread = <0x00>;
		ssmod_div = <0x00>;
		ssmod_spread = <0x00>;
		mode_2t = <0x00>;
		speed_bin = <0x00>;
		dram_ext_temp = <0x00>;
		byte_map = <0xe4>;
		dq_map_cs0_dq_l = <0x00>;
		dq_map_cs0_dq_h = <0x00>;
		dq_map_cs1_dq_l = <0x00>;
		dq_map_cs1_dq_h = <0x00>;
		lp4_ca_odt = <0x78>;
		lp4_drv_pu_cal_odten = <0x01>;
		lp4_drv_pu_cal_odtoff = <0x01>;
		phy_lp4_drv_pulldown_en_odten = <0x00>;
		phy_lp4_drv_pulldown_en_odtoff = <0x00>;
		lp4_ca_odt_en_freq = <0x320>;
		phy_lp4_cs_drv_odten = <0x00>;
		phy_lp4_cs_drv_odtoff = <0x00>;
		lp4_odte_ck_en = <0x01>;
		lp4_odte_cs_en = <0x01>;
		lp4_odtd_ca_en = <0x00>;
		phy_lp4_dq_vref_odten = <0xa6>;
		lp4_dq_vref_odten = <0x12c>;
		lp4_ca_vref_odten = <0x17c>;
		phy_lp4_dq_vref_odtoff = <0x1a4>;
		lp4_dq_vref_odtoff = <0x1a4>;
		lp4_ca_vref_odtoff = <0x1a4>;
		phandle = <0x9c>;
	};

	lpddr4x-params {
		version = <0x100>;
		expanded_version = <0x00>;
		reserved = <0x00>;
		freq_0 = <0x420>;
		freq_1 = <0x144>;
		freq_2 = <0x210>;
		freq_3 = <0x30c>;
		freq_4 = <0x00>;
		freq_5 = <0x00>;
		pd_idle = <0x0d>;
		sr_idle = <0x5d>;
		sr_mc_gate_idle = <0x00>;
		srpd_lite_idle = <0x00>;
		standby_idle = <0x00>;
		pd_dis_freq = <0x42a>;
		sr_dis_freq = <0x320>;
		dram_dll_dis_freq = <0x00>;
		phy_dll_dis_freq = <0x00>;
		phy_dq_drv_odten = <0x1d>;
		phy_ca_drv_odten = <0x24>;
		phy_clk_drv_odten = <0x24>;
		dram_dq_drv_odten = <0x28>;
		phy_dq_drv_odtoff = <0x1d>;
		phy_ca_drv_odtoff = <0x24>;
		phy_clk_drv_odtoff = <0x24>;
		dram_dq_drv_odtoff = <0x28>;
		dram_odt = <0x50>;
		phy_odt = <0x3c>;
		phy_odt_puup_en = <0x00>;
		phy_odt_pudn_en = <0x00>;
		dram_dq_odt_en_freq = <0x320>;
		phy_odt_en_freq = <0x320>;
		phy_dq_sr_odten = <0x00>;
		phy_ca_sr_odten = <0x00>;
		phy_clk_sr_odten = <0x00>;
		phy_dq_sr_odtoff = <0x00>;
		phy_ca_sr_odtoff = <0x00>;
		phy_clk_sr_odtoff = <0x00>;
		ssmod_downspread = <0x00>;
		ssmod_div = <0x00>;
		ssmod_spread = <0x00>;
		mode_2t = <0x00>;
		speed_bin = <0x00>;
		dram_ext_temp = <0x00>;
		byte_map = <0xe4>;
		dq_map_cs0_dq_l = <0x00>;
		dq_map_cs0_dq_h = <0x00>;
		dq_map_cs1_dq_l = <0x00>;
		dq_map_cs1_dq_h = <0x00>;
		lp4_ca_odt = <0x78>;
		lp4_drv_pu_cal_odten = <0x00>;
		lp4_drv_pu_cal_odtoff = <0x00>;
		phy_lp4_drv_pulldown_en_odten = <0x00>;
		phy_lp4_drv_pulldown_en_odtoff = <0x00>;
		lp4_ca_odt_en_freq = <0x320>;
		phy_lp4_cs_drv_odten = <0x00>;
		phy_lp4_cs_drv_odtoff = <0x00>;
		lp4_odte_ck_en = <0x00>;
		lp4_odte_cs_en = <0x00>;
		lp4_odtd_ca_en = <0x00>;
		phy_lp4_dq_vref_odten = <0xa6>;
		lp4_dq_vref_odten = <0xe4>;
		lp4_ca_vref_odten = <0x157>;
		phy_lp4_dq_vref_odtoff = <0x1a4>;
		lp4_dq_vref_odtoff = <0x1a4>;
		lp4_ca_vref_odtoff = <0x157>;
		phandle = <0x9d>;
	};

	aliases {
		csi2dphy0 = "/csi2-dphy0";
		csi2dphy1 = "/csi2-dphy1";
		csi2dphy2 = "/csi2-dphy2";
		dsi0 = "/dsi@fe060000";
		dsi1 = "/dsi@fe070000";
		ethernet1 = "/ethernet@fe010000";
		gpio0 = "/pinctrl/gpio@fdd60000";
		gpio1 = "/pinctrl/gpio@fe740000";
		gpio2 = "/pinctrl/gpio@fe750000";
		gpio3 = "/pinctrl/gpio@fe760000";
		gpio4 = "/pinctrl/gpio@fe770000";
		i2c0 = "/i2c@fdd40000";
		i2c1 = "/i2c@fe5a0000";
		i2c2 = "/i2c@fe5b0000";
		i2c3 = "/i2c@fe5c0000";
		i2c4 = "/i2c@fe5d0000";
		i2c5 = "/i2c@fe5e0000";
		mmc0 = "/dwmmc@fe2b0000";
		mmc1 = "/dwmmc@fe2c0000";
		mmc2 = "/sdhci@fe310000";
		mmc3 = "/dwmmc@fe000000";
		serial0 = "/serial@fdd50000";
		serial1 = "/serial@fe650000";
		serial2 = "/serial@fe660000";
		serial3 = "/serial@fe670000";
		serial4 = "/serial@fe680000";
		serial5 = "/serial@fe690000";
		serial6 = "/serial@fe6a0000";
		serial7 = "/serial@fe6b0000";
		serial8 = "/serial@fe6c0000";
		serial9 = "/serial@fe6d0000";
		spi0 = "/spi@fe610000";
		spi1 = "/spi@fe620000";
		spi2 = "/spi@fe630000";
		spi3 = "/spi@fe640000";
		spi4 = "/sfc@fe300000";
	};

	cpus {
		#address-cells = <0x02>;
		#size-cells = <0x00>;

		cpu@0 {
			device_type = "cpu";
			compatible = "arm,cortex-a55";
			reg = <0x00 0x00>;
			enable-method = "psci";
			clocks = <0x02 0x00>;
			operating-points-v2 = <0x03>;
			cpu-idle-states = <0x04>;
			#cooling-cells = <0x02>;
			dynamic-power-coefficient = <0xbb>;
			cpu-supply = <0x05>;
			phandle = <0x09>;
		};

		cpu@100 {
			device_type = "cpu";
			compatible = "arm,cortex-a55";
			reg = <0x00 0x100>;
			enable-method = "psci";
			clocks = <0x02 0x00>;
			operating-points-v2 = <0x03>;
			cpu-idle-states = <0x04>;
			phandle = <0x0a>;
		};

		cpu@200 {
			device_type = "cpu";
			compatible = "arm,cortex-a55";
			reg = <0x00 0x200>;
			enable-method = "psci";
			clocks = <0x02 0x00>;
			operating-points-v2 = <0x03>;
			cpu-idle-states = <0x04>;
			phandle = <0x0b>;
		};

		cpu@300 {
			device_type = "cpu";
			compatible = "arm,cortex-a55";
			reg = <0x00 0x300>;
			enable-method = "psci";
			clocks = <0x02 0x00>;
			operating-points-v2 = <0x03>;
			cpu-idle-states = <0x04>;
			phandle = <0x0c>;
		};

		idle-states {
			entry-method = "psci";

			cpu-sleep {
				compatible = "arm,idle-state";
				local-timer-stop;
				arm,psci-suspend-param = <0x10000>;
				entry-latency-us = <0x64>;
				exit-latency-us = <0x78>;
				min-residency-us = <0x3e8>;
				phandle = <0x04>;
			};
		};
	};

	cpu0-opp-table {
		compatible = "operating-points-v2";
		opp-shared;
		mbist-vmin = <0xc96a8 0xdbba0 0xe7ef0>;
		nvmem-cells = <0x06 0x07 0x08>;
		nvmem-cell-names = "leakage\0pvtm\0mbist-vmin";
		rockchip,pvtm-voltage-sel = <0x00 0x14050 0x00 0x14051 0x16b48 0x01 0x16b49 0x186a0 0x02>;
		rockchip,pvtm-freq = <0x639c0>;
		rockchip,pvtm-volt = <0xdbba0>;
		rockchip,pvtm-ch = <0x00 0x05>;
		rockchip,pvtm-sample-time = <0x3e8>;
		rockchip,pvtm-number = <0x0a>;
		rockchip,pvtm-error = <0x3e8>;
		rockchip,pvtm-ref-temp = <0x28>;
		rockchip,pvtm-temp-prop = <0x1a 0x1a>;
		rockchip,thermal-zone = "soc-thermal";
		rockchip,temp-hysteresis = <0x1388>;
		rockchip,low-temp = <0x00>;
		rockchip,low-temp-adjust-volt = <0x00 0x648 0x124f8>;
		phandle = <0x03>;

		opp-408000000 {
			opp-hz = <0x00 0x18519600>;
			opp-microvolt = <0xc96a8 0xc96a8 0x118c30>;
			clock-latency-ns = <0x9c40>;
		};

		opp-600000000 {
			opp-hz = <0x00 0x23c34600>;
			opp-microvolt = <0xc96a8 0xc96a8 0x118c30>;
			clock-latency-ns = <0x9c40>;
		};

		opp-816000000 {
			opp-hz = <0x00 0x30a32c00>;
			opp-microvolt = <0xc96a8 0xc96a8 0x118c30>;
			clock-latency-ns = <0x9c40>;
			opp-suspend;
		};

		opp-1104000000 {
			opp-hz = <0x00 0x41cdb400>;
			opp-microvolt = <0xc96a8 0xc96a8 0x118c30>;
			clock-latency-ns = <0x9c40>;
		};

		opp-1416000000 {
			opp-hz = <0x00 0x54667200>;
			opp-microvolt = <0xe1d48 0xe1d48 0x118c30>;
			clock-latency-ns = <0x9c40>;
		};

		opp-1608000000 {
			opp-hz = <0x00 0x5fd82200>;
			opp-microvolt = <0xf4240 0xf4240 0x118c30>;
			clock-latency-ns = <0x9c40>;
		};

		opp-1800000000 {
			opp-hz = <0x00 0x6b49d200>;
			opp-microvolt = <0x100590 0x100590 0x118c30>;
			clock-latency-ns = <0x9c40>;
		};

		opp-1992000000 {
			opp-hz = <0x00 0x76bb8200>;
			opp-microvolt = <0x118c30 0x118c30 0x118c30>;
			clock-latency-ns = <0x9c40>;
		};
	};

	arm-pmu {
		compatible = "arm,cortex-a55-pmu\0arm,armv8-pmuv3";
		interrupts = <0x00 0xe4 0x04 0x00 0xe5 0x04 0x00 0xe6 0x04 0x00 0xe7 0x04>;
		interrupt-affinity = <0x09 0x0a 0x0b 0x0c>;
	};

	cpuinfo {
		compatible = "rockchip,cpuinfo";
		nvmem-cells = <0x0d 0x0e 0x0f>;
		nvmem-cell-names = "id\0cpu-version\0cpu-code";
	};

	display-subsystem {
		compatible = "rockchip,display-subsystem";
		memory-region = <0x10 0x11>;
		memory-region-names = "drm-logo\0drm-cubic-lut";
		ports = <0x12>;
		devfreq = <0x13>;
		phandle = <0x110>;

		route {

			route-dsi0 {
				status = "okay";
				logo,uboot = "logo.bmp";
				logo,kernel = "logo_kernel.bmp";
				logo,mode = "center";
				charge_logo,mode = "center";
				connect = <0x14>;
				phandle = <0x111>;
			};

			route-dsi1 {
				status = "disabled";
				logo,uboot = "logo.bmp";
				logo,kernel = "logo_kernel.bmp";
				logo,mode = "center";
				charge_logo,mode = "center";
				connect = <0x15>;
				phandle = <0x112>;
			};

			route-edp {
				status = "disabled";
				logo,uboot = "logo.bmp";
				logo,kernel = "logo_kernel.bmp";
				logo,mode = "center";
				charge_logo,mode = "center";
				connect = <0x16>;
				phandle = <0x113>;
			};

			route-hdmi {
				status = "okay";
				logo,uboot = "logo.bmp";
				logo,kernel = "logo_kernel.bmp";
				logo,mode = "center";
				charge_logo,mode = "center";
				connect = <0x17>;
				phandle = <0x114>;
			};

			route-lvds {
				status = "disabled";
				logo,uboot = "logo.bmp";
				logo,kernel = "logo_kernel.bmp";
				logo,mode = "center";
				charge_logo,mode = "center";
				connect = <0x18>;
				phandle = <0x115>;
			};

			route-rgb {
				status = "disabled";
				logo,uboot = "logo.bmp";
				logo,kernel = "logo_kernel.bmp";
				logo,mode = "center";
				charge_logo,mode = "center";
				connect = <0x19>;
				phandle = <0x116>;
			};
		};
	};

	firmware {

		optee {
			compatible = "linaro,optee-tz";
			method = "smc";
			phandle = <0x117>;
		};

		scmi {
			compatible = "arm,scmi-smc";
			shmem = <0x1a>;
			arm,smc-id = <0x82000010>;
			#address-cells = <0x01>;
			#size-cells = <0x00>;
			phandle = <0x118>;

			protocol@14 {
				reg = <0x14>;
				#clock-cells = <0x01>;
				rockchip,clk-init = "Tfr";
				phandle = <0x02>;
			};
		};

		sdei {
			compatible = "arm,sdei-1.0";
			method = "smc";
			phandle = <0x119>;
		};
	};

	mpp-srv {
		compatible = "rockchip,mpp-service";
		rockchip,taskqueue-count = <0x06>;
		rockchip,resetgroup-count = <0x06>;
		status = "okay";
		phandle = <0x67>;
	};

	psci {
		compatible = "arm,psci-1.0";
		method = "smc";
	};

	reserved-memory {
		#address-cells = <0x02>;
		#size-cells = <0x02>;
		ranges;
		phandle = <0x11a>;

		drm-logo@00000000 {
			compatible = "rockchip,drm-logo";
			reg = <0x00 0x00 0x00 0x00>;
			phandle = <0x10>;
		};

		drm-cubic-lut@00000000 {
			compatible = "rockchip,drm-cubic-lut";
			reg = <0x00 0x00 0x00 0x00>;
			phandle = <0x11>;
		};

		linux,cma {
			compatible = "shared-dma-pool";
			inactive;
			reusable;
			reg = <0x00 0x10000000 0x00 0x800000>;
			linux,cma-default;
		};

		ramoops@110000 {
			compatible = "ramoops";
			reg = <0x00 0x110000 0x00 0xf0000>;
			record-size = <0x20000>;
			console-size = <0x80000>;
			ftrace-size = <0x00>;
			pmsg-size = <0x50000>;
			phandle = <0x11b>;
		};
	};

	rockchip-suspend {
		compatible = "rockchip,pm-rk3568";
		status = "okay";
		rockchip,sleep-debug-en = <0x01>;
		rockchip,sleep-mode-config = <0x5ec>;
		rockchip,wakeup-config = <0x10>;
		phandle = <0x11c>;
	};

	rockchip-system-monitor {
		compatible = "rockchip,system-monitor";
		rockchip,thermal-zone = "soc-thermal";
		phandle = <0x11d>;
	};

	thermal-zones {
		phandle = <0x11e>;

		soc-thermal {
			polling-delay-passive = <0x14>;
			polling-delay = <0x3e8>;
			sustainable-power = <0x389>;
			thermal-sensors = <0x1b 0x00>;
			phandle = <0x11f>;

			trips {

				trip-point-0 {
					temperature = <0x124f8>;
					hysteresis = <0x7d0>;
					type = "passive";
					phandle = <0x120>;
				};

				trip-point-1 {
					temperature = <0x14c08>;
					hysteresis = <0x7d0>;
					type = "passive";
					phandle = <0x1c>;
				};

				soc-crit {
					temperature = <0x1c138>;
					hysteresis = <0x7d0>;
					type = "critical";
					phandle = <0x121>;
				};
			};

			cooling-maps {

				map0 {
					trip = <0x1c>;
					cooling-device = <0x09 0xffffffff 0xffffffff>;
					contribution = <0x400>;
				};

				map1 {
					trip = <0x1c>;
					cooling-device = <0x1d 0xffffffff 0xffffffff>;
					contribution = <0x400>;
				};
			};
		};

		gpu-thermal {
			polling-delay-passive = <0x14>;
			polling-delay = <0x3e8>;
			thermal-sensors = <0x1b 0x01>;
			phandle = <0x122>;
		};
	};

	timer {
		compatible = "arm,armv8-timer";
		interrupts = <0x01 0x0d 0xf04 0x01 0x0e 0xf04 0x01 0x0b 0xf04 0x01 0x0a 0xf04>;
		arm,no-tick-in-suspend;
	};

	external-gmac1-clock {
		compatible = "fixed-clock";
		clock-frequency = <0x7735940>;
		clock-output-names = "gmac1_clkin";
		#clock-cells = <0x00>;
		phandle = <0x123>;
	};

	xpcs-gmac1-clock {
		compatible = "fixed-clock";
		clock-frequency = <0x7735940>;
		clock-output-names = "clk_gmac1_xpcs_mii";
		#clock-cells = <0x00>;
		phandle = <0x124>;
	};

	i2s1-mclkin-rx {
		compatible = "fixed-clock";
		#clock-cells = <0x00>;
		clock-frequency = <0xbb8000>;
		clock-output-names = "i2s1_mclkin_rx";
		phandle = <0x125>;
	};

	i2s1-mclkin-tx {
		compatible = "fixed-clock";
		#clock-cells = <0x00>;
		clock-frequency = <0xbb8000>;
		clock-output-names = "i2s1_mclkin_tx";
		phandle = <0x126>;
	};

	i2s2-mclkin {
		compatible = "fixed-clock";
		#clock-cells = <0x00>;
		clock-frequency = <0xbb8000>;
		clock-output-names = "i2s2_mclkin";
		phandle = <0x127>;
	};

	i2s3-mclkin {
		compatible = "fixed-clock";
		#clock-cells = <0x00>;
		clock-frequency = <0xbb8000>;
		clock-output-names = "i2s3_mclkin";
		phandle = <0x128>;
	};

	mpll {
		compatible = "fixed-clock";
		#clock-cells = <0x00>;
		clock-frequency = <0x2faf0800>;
		clock-output-names = "mpll";
		phandle = <0x129>;
	};

	xin24m {
		compatible = "fixed-clock";
		#clock-cells = <0x00>;
		clock-frequency = <0x16e3600>;
		clock-output-names = "xin24m";
		phandle = <0x12a>;
	};

	xin32k {
		compatible = "fixed-clock";
		clock-frequency = <0x8000>;
		clock-output-names = "xin32k";
		#clock-cells = <0x00>;
		pinctrl-names = "default";
		pinctrl-0 = <0x1e>;
		phandle = <0x12b>;
	};

	scmi-shmem@10f000 {
		compatible = "arm,scmi-shmem";
		reg = <0x00 0x10f000 0x00 0x100>;
		phandle = <0x1a>;
	};

	sata@fc400000 {
		compatible = "snps,dwc-ahci";
		reg = <0x00 0xfc400000 0x00 0x1000>;
		clocks = <0x1f 0x9b 0x1f 0x9c 0x1f 0x9d>;
		clock-names = "sata\0pmalive\0rxoob";
		interrupts = <0x00 0x5f 0x04>;
		interrupt-names = "hostc";
		phys = <0x20 0x01>;
		phy-names = "sata-phy";
		ports-implemented = <0x01>;
		power-domains = <0x21 0x0f>;
		status = "disabled";
		phandle = <0x12c>;
	};

	sata@fc800000 {
		compatible = "snps,dwc-ahci";
		reg = <0x00 0xfc800000 0x00 0x1000>;
		clocks = <0x1f 0xa0 0x1f 0xa1 0x1f 0xa2>;
		clock-names = "sata\0pmalive\0rxoob";
		interrupts = <0x00 0x60 0x04>;
		interrupt-names = "hostc";
		phys = <0x22 0x01>;
		phy-names = "sata-phy";
		ports-implemented = <0x01>;
		power-domains = <0x21 0x0f>;
		status = "disabled";
		phandle = <0x12d>;
	};

	usbdrd {
		compatible = "rockchip,rk3568-dwc3\0rockchip,rk3399-dwc3";
		clocks = <0x1f 0xa6 0x1f 0xa7 0x1f 0xa5 0x1f 0x7f>;
		clock-names = "ref_clk\0suspend_clk\0bus_clk\0pipe_clk";
		#address-cells = <0x02>;
		#size-cells = <0x02>;
		ranges;
		status = "okay";
		phandle = <0x12e>;

		dwc3@fcc00000 {
			compatible = "snps,dwc3";
			reg = <0x00 0xfcc00000 0x00 0x400000>;
			interrupts = <0x00 0xa9 0x04>;
			dr_mode = "otg";
			phys = <0x23>;
			phy-names = "usb2-phy";
			phy_type = "utmi_wide";
			power-domains = <0x21 0x0f>;
			resets = <0x1f 0x94>;
			reset-names = "usb3-otg";
			snps,dis_enblslpm_quirk;
			snps,dis-u1u2-quirk;
			snps,dis-u2-freeclk-exists-quirk;
			snps,dis-del-phy-power-chg-quirk;
			snps,dis-tx-ipgap-linecheck-quirk;
			snps,dis_rxdet_inp3_quirk;
			snps,xhci-trb-ent-quirk;
			status = "okay";
			extcon = <0x24>;
			maximum-speed = "high-speed";
			snps,dis_u2_susphy_quirk;
			phandle = <0x12f>;
		};
	};

	usbhost {
		compatible = "rockchip,rk3568-dwc3\0rockchip,rk3399-dwc3";
		clocks = <0x1f 0xa9 0x1f 0xaa 0x1f 0xa8 0x1f 0x7f>;
		clock-names = "ref_clk\0suspend_clk\0bus_clk\0pipe_clk";
		#address-cells = <0x02>;
		#size-cells = <0x02>;
		ranges;
		status = "okay";
		phandle = <0x130>;

		dwc3@fd000000 {
			compatible = "snps,dwc3";
			reg = <0x00 0xfd000000 0x00 0x400000>;
			interrupts = <0x00 0xaa 0x04>;
			dr_mode = "host";
			phys = <0x25 0x20 0x04>;
			phy-names = "usb2-phy\0usb3-phy";
			phy_type = "utmi_wide";
			power-domains = <0x21 0x0f>;
			resets = <0x1f 0x95>;
			reset-names = "usb3-host";
			snps,dis_enblslpm_quirk;
			snps,dis-u2-freeclk-exists-quirk;
			snps,dis-del-phy-power-chg-quirk;
			snps,dis-tx-ipgap-linecheck-quirk;
			snps,dis_rxdet_inp3_quirk;
			snps,xhci-trb-ent-quirk;
			status = "okay";
			phandle = <0x131>;
		};
	};

	interrupt-controller@fd400000 {
		compatible = "arm,gic-v3";
		#interrupt-cells = <0x03>;
		#address-cells = <0x02>;
		#size-cells = <0x02>;
		ranges;
		interrupt-controller;
		reg = <0x00 0xfd400000 0x00 0x10000 0x00 0xfd460000 0x00 0xc0000>;
		interrupts = <0x01 0x09 0x04>;
		phandle = <0x01>;

		interrupt-controller@fd440000 {
			compatible = "arm,gic-v3-its";
			msi-controller;
			#msi-cells = <0x01>;
			reg = <0x00 0xfd440000 0x00 0x20000>;
			phandle = <0xa0>;
		};
	};

	usb@fd800000 {
		compatible = "generic-ehci";
		reg = <0x00 0xfd800000 0x00 0x40000>;
		interrupts = <0x00 0x82 0x04>;
		clocks = <0x1f 0xbd 0x1f 0xbe 0x1f 0xbc 0x26>;
		clock-names = "usbhost\0arbiter\0pclk\0utmi";
		phys = <0x27>;
		phy-names = "usb2-phy";
		status = "okay";
		phandle = <0x132>;
	};

	usb@fd840000 {
		compatible = "generic-ohci";
		reg = <0x00 0xfd840000 0x00 0x40000>;
		interrupts = <0x00 0x83 0x04>;
		clocks = <0x1f 0xbd 0x1f 0xbe 0x1f 0xbc 0x26>;
		clock-names = "usbhost\0arbiter\0pclk\0utmi";
		phys = <0x27>;
		phy-names = "usb2-phy";
		status = "okay";
		phandle = <0x133>;
	};

	usb@fd880000 {
		compatible = "generic-ehci";
		reg = <0x00 0xfd880000 0x00 0x40000>;
		interrupts = <0x00 0x85 0x04>;
		clocks = <0x1f 0xbf 0x1f 0xc0 0x1f 0xbc 0x26>;
		clock-names = "usbhost\0arbiter\0pclk\0utmi";
		phys = <0x28>;
		phy-names = "usb2-phy";
		status = "okay";
		phandle = <0x134>;
	};

	usb@fd8c0000 {
		compatible = "generic-ohci";
		reg = <0x00 0xfd8c0000 0x00 0x40000>;
		interrupts = <0x00 0x86 0x04>;
		clocks = <0x1f 0xbf 0x1f 0xc0 0x1f 0xbc 0x26>;
		clock-names = "usbhost\0arbiter\0pclk\0utmi";
		phys = <0x28>;
		phy-names = "usb2-phy";
		status = "okay";
		phandle = <0x135>;
	};

	syscon@fda00000 {
		compatible = "rockchip,rk3568-xpcs\0syscon";
		reg = <0x00 0xfda00000 0x00 0x200000>;
		status = "disabled";
		phandle = <0x136>;
	};

	syscon@fdc20000 {
		compatible = "rockchip,rk3568-pmugrf\0syscon\0simple-mfd";
		reg = <0x00 0xfdc20000 0x00 0x10000>;
		phandle = <0x33>;

		io-domains {
			compatible = "rockchip,rk3568-pmu-io-voltage-domain";
			status = "okay";
			pmuio1-supply = <0x29>;
			pmuio2-supply = <0x29>;
			vccio1-supply = <0x2a>;
			vccio3-supply = <0x2b>;
			vccio4-supply = <0x2c>;
			vccio5-supply = <0x2c>;
			vccio6-supply = <0x2d>;
			vccio7-supply = <0x2c>;
			phandle = <0x137>;
		};

		reboot-mode {
			compatible = "syscon-reboot-mode";
			offset = <0x200>;
			mode-bootloader = <0x5242c301>;
			mode-charge = <0x5242c30b>;
			mode-fastboot = <0x5242c309>;
			mode-loader = <0x5242c301>;
			mode-normal = <0x5242c300>;
			mode-recovery = <0x5242c303>;
			mode-ums = <0x5242c30c>;
			mode-panic = <0x5242c307>;
			mode-watchdog = <0x5242c308>;
			phandle = <0x138>;
		};
	};

	syscon@fdc50000 {
		compatible = "rockchip,rk3568-pipegrf\0syscon";
		reg = <0x00 0xfdc50000 0x00 0x1000>;
		phandle = <0xee>;
	};

	syscon@fdc60000 {
		compatible = "rockchip,rk3568-grf\0syscon\0simple-mfd";
		reg = <0x00 0xfdc60000 0x00 0x10000>;
		phandle = <0x32>;

		io-domains {
			compatible = "rockchip,rk3568-io-voltage-domain";
			status = "disabled";
			phandle = <0x139>;
		};

		lvds {
			compatible = "rockchip,rk3568-lvds";
			phys = <0x2e>;
			phy-names = "phy";
			status = "disabled";
			phandle = <0x13a>;

			ports {
				#address-cells = <0x01>;
				#size-cells = <0x00>;

				port@0 {
					reg = <0x00>;
					#address-cells = <0x01>;
					#size-cells = <0x00>;

					endpoint@1 {
						reg = <0x01>;
						remote-endpoint = <0x18>;
						status = "disabled";
						phandle = <0x82>;
					};

					endpoint@2 {
						reg = <0x02>;
						remote-endpoint = <0x2f>;
						status = "disabled";
						phandle = <0x83>;
					};
				};
			};
		};

		rgb {
			compatible = "rockchip,rk3568-rgb";
			pinctrl-names = "default";
			pinctrl-0 = <0x30>;
			status = "disabled";
			phandle = <0x13b>;

			ports {
				#address-cells = <0x01>;
				#size-cells = <0x00>;

				port@0 {
					reg = <0x00>;
					#address-cells = <0x01>;
					#size-cells = <0x00>;

					endpoint@2 {
						reg = <0x02>;
						remote-endpoint = <0x19>;
						status = "disabled";
						phandle = <0x84>;
					};
				};
			};
		};
	};

	syscon@fdc70000 {
		compatible = "rockchip,pipe-phy-grf\0syscon";
		reg = <0x00 0xfdc70000 0x00 0x1000>;
		phandle = <0x13c>;
	};

	syscon@fdc80000 {
		compatible = "rockchip,pipe-phy-grf\0syscon";
		reg = <0x00 0xfdc80000 0x00 0x1000>;
		phandle = <0xef>;
	};

	syscon@fdc90000 {
		compatible = "rockchip,pipe-phy-grf\0syscon";
		reg = <0x00 0xfdc90000 0x00 0x1000>;
		phandle = <0xf0>;
	};

	syscon@fdca0000 {
		compatible = "rockchip,rk3568-usb2phy-grf\0syscon";
		reg = <0x00 0xfdca0000 0x00 0x8000>;
		phandle = <0xf2>;
	};

	syscon@fdca8000 {
		compatible = "rockchip,rk3568-usb2phy-grf\0syscon";
		reg = <0x00 0xfdca8000 0x00 0x8000>;
		phandle = <0xf3>;
	};

	edp-phy@fdcb0000 {
		compatible = "rockchip,rk3568-edp-phy";
		reg = <0x00 0xfdcb0000 0x00 0x8000>;
		clocks = <0x31 0x29 0x1f 0x192>;
		clock-names = "refclk\0pclk";
		resets = <0x1f 0x1d6>;
		reset-names = "apb";
		#phy-cells = <0x00>;
		status = "disabled";
		phandle = <0x90>;
	};

	sram@fdcc0000 {
		compatible = "mmio-sram";
		reg = <0x00 0xfdcc0000 0x00 0xb000>;
		#address-cells = <0x01>;
		#size-cells = <0x01>;
		ranges = <0x00 0x00 0xfdcc0000 0xb000>;
		phandle = <0x13d>;

		rkvdec-sram@0 {
			reg = <0x00 0xb000>;
			phandle = <0x6f>;
		};
	};

	clock-controller@fdd00000 {
		compatible = "rockchip,rk3568-pmucru";
		reg = <0x00 0xfdd00000 0x00 0x1000>;
		rockchip,grf = <0x32>;
		rockchip,pmugrf = <0x33>;
		#clock-cells = <0x01>;
		#reset-cells = <0x01>;
		assigned-clocks = <0x31 0x32>;
		assigned-clock-parents = <0x31 0x05>;
		phandle = <0x31>;
	};

	clock-controller@fdd20000 {
		compatible = "rockchip,rk3568-cru";
		reg = <0x00 0xfdd20000 0x00 0x1000>;
		rockchip,grf = <0x32>;
		#clock-cells = <0x01>;
		#reset-cells = <0x01>;
		assigned-clocks = <0x31 0x05 0x1f 0x106 0x1f 0x10b 0x31 0x01 0x31 0x2b 0x1f 0x03 0x1f 0x19b 0x1f 0x09 0x1f 0x19c 0x1f 0x19d 0x1f 0x1a1 0x1f 0x19e 0x1f 0x19f 0x1f 0x1a0 0x1f 0x04 0x1f 0x10d 0x1f 0x10e 0x1f 0x173 0x1f 0x174 0x1f 0x175 0x1f 0x176 0x1f 0xc9 0x1f 0xca 0x1f 0x06 0x1f 0x7e 0x1f 0x7f 0x1f 0x3d 0x1f 0x41 0x1f 0x45 0x1f 0x49 0x1f 0x4d 0x1f 0x4d 0x1f 0x55 0x1f 0x51 0x1f 0x5d 0x1f 0xdd>;
		assigned-clock-rates = <0x8000 0x11e1a300 0x11e1a300 0xbebc200 0x5f5e100 0x3b9aca00 0x1dcd6500 0x13d92d40 0xee6b280 0x7735940 0x5f5e100 0x3b9aca0 0x2faf080 0x17d7840 0x46cf7100 0x8f0d180 0x5f5e100 0x1dcd6500 0x17d78400 0x8f0d180 0x5f5e100 0x11e1a300 0x8f0d180 0x47868c00 0x17d78400 0x5f5e100 0x46cf7100 0x46cf7100 0x46cf7100 0x46cf7100 0x46cf7100 0x46cf7100 0x46cf7100 0x46cf7100 0x46cf7100 0x1dcd6500>;
		assigned-clock-parents = <0x31 0x08 0x1f 0x04 0x1f 0x04>;
		phandle = <0x1f>;
	};

	i2c@fdd40000 {
		compatible = "rockchip,rk3399-i2c";
		reg = <0x00 0xfdd40000 0x00 0x1000>;
		clocks = <0x31 0x07 0x31 0x2d>;
		clock-names = "i2c\0pclk";
		interrupts = <0x00 0x2e 0x04>;
		pinctrl-names = "default";
		pinctrl-0 = <0x34>;
		#address-cells = <0x01>;
		#size-cells = <0x00>;
		status = "okay";
		phandle = <0x13e>;

		tcs4525@1c {
			compatible = "tcs,tcs452x";
			reg = <0x1c>;
			vin-supply = <0x35>;
			regulator-compatible = "fan53555-reg";
			regulator-name = "vdd_cpu";
			regulator-min-microvolt = <0xadf34>;
			regulator-max-microvolt = <0x1535b0>;
			regulator-init-microvolt = <0xdbba0>;
			regulator-ramp-delay = <0x8fc>;
			fcs,suspend-voltage-selector = <0x01>;
			regulator-boot-on;
			regulator-always-on;
			phandle = <0x05>;

			regulator-state-mem {
				regulator-off-in-suspend;
			};
		};

		pmic@20 {
			compatible = "rockchip,rk817";
			reg = <0x20>;
			interrupt-parent = <0x36>;
			interrupts = <0x03 0x08>;
			pinctrl-names = "default\0pmic-sleep\0pmic-power-off\0pmic-reset";
			pinctrl-0 = <0x37>;
			pinctrl-1 = <0x38 0x39>;
			pinctrl-2 = <0x3a 0x3b>;
			pinctrl-3 = <0x3a 0x3c>;
			rockchip,system-power-controller;
			wakeup-source;
			#clock-cells = <0x01>;
			clock-output-names = "rk808-clkout1\0rk808-clkout2";
			pmic-reset-func = <0x00>;
			not-save-power-en = <0x01>;
			vcc1-supply = <0x35>;
			vcc2-supply = <0x35>;
			vcc3-supply = <0x35>;
			vcc4-supply = <0x35>;
			vcc5-supply = <0x35>;
			vcc6-supply = <0x35>;
			vcc7-supply = <0x35>;
			vcc8-supply = <0x35>;
			vcc9-supply = <0x3d>;
			phandle = <0x13f>;

			pwrkey {
				status = "okay";
			};

			pinctrl_rk8xx {
				gpio-controller;
				#gpio-cells = <0x02>;
				phandle = <0x140>;

				rk817_slppin_null {
					pins = "gpio_slp";
					function = "pin_fun0";
					phandle = <0x141>;
				};

				rk817_slppin_slp {
					pins = "gpio_slp";
					function = "pin_fun1";
					phandle = <0x39>;
				};

				rk817_slppin_pwrdn {
					pins = "gpio_slp";
					function = "pin_fun2";
					phandle = <0x3b>;
				};

				rk817_slppin_rst {
					pins = "gpio_slp";
					function = "pin_fun3";
					phandle = <0x3c>;
				};
			};

			regulators {

				DCDC_REG1 {
					regulator-always-on;
					regulator-boot-on;
					regulator-min-microvolt = <0x7a120>;
					regulator-max-microvolt = <0x149970>;
					regulator-init-microvolt = <0xdbba0>;
					regulator-ramp-delay = <0x1771>;
					regulator-initial-mode = <0x02>;
					regulator-name = "vdd_logic";
					phandle = <0x98>;

					regulator-state-mem {
						regulator-on-in-suspend;
						regulator-suspend-microvolt = <0xdbba0>;
					};
				};

				DCDC_REG2 {
					regulator-always-on;
					regulator-boot-on;
					regulator-min-microvolt = <0x7a120>;
					regulator-max-microvolt = <0x149970>;
					regulator-init-microvolt = <0xdbba0>;
					regulator-ramp-delay = <0x1771>;
					regulator-initial-mode = <0x02>;
					regulator-name = "vdd_gpu";
					phandle = <0x64>;

					regulator-state-mem {
						regulator-off-in-suspend;
					};
				};

				DCDC_REG3 {
					regulator-always-on;
					regulator-boot-on;
					regulator-initial-mode = <0x02>;
					regulator-name = "vcc_ddr";
					phandle = <0x142>;

					regulator-state-mem {
						regulator-on-in-suspend;
					};
				};

				DCDC_REG4 {
					regulator-always-on;
					regulator-boot-on;
					regulator-min-microvolt = <0x325aa0>;
					regulator-max-microvolt = <0x325aa0>;
					regulator-initial-mode = <0x02>;
					regulator-name = "vcc_3v3";
					phandle = <0x2c>;

					regulator-state-mem {
						regulator-on-in-suspend;
					};
				};

				LDO_REG1 {
					regulator-always-on;
					regulator-boot-on;
					regulator-min-microvolt = <0x1b7740>;
					regulator-max-microvolt = <0x1b7740>;
					regulator-name = "vcca1v8_pmu";
					phandle = <0x143>;

					regulator-state-mem {
						regulator-on-in-suspend;
						regulator-suspend-microvolt = <0x1b7740>;
					};
				};

				LDO_REG2 {
					regulator-always-on;
					regulator-boot-on;
					regulator-min-microvolt = <0xdbba0>;
					regulator-max-microvolt = <0xdbba0>;
					regulator-name = "vdda_0v9";
					phandle = <0x144>;

					regulator-state-mem {
						regulator-off-in-suspend;
					};
				};

				LDO_REG3 {
					regulator-always-on;
					regulator-boot-on;
					regulator-min-microvolt = <0xdbba0>;
					regulator-max-microvolt = <0xdbba0>;
					regulator-name = "vdda0v9_pmu";
					phandle = <0x145>;

					regulator-state-mem {
						regulator-on-in-suspend;
						regulator-suspend-microvolt = <0xdbba0>;
					};
				};

				LDO_REG4 {
					regulator-always-on;
					regulator-boot-on;
					regulator-min-microvolt = <0x325aa0>;
					regulator-max-microvolt = <0x325aa0>;
					regulator-name = "vccio_acodec";
					phandle = <0x2a>;

					regulator-state-mem {
						regulator-off-in-suspend;
					};
				};

				LDO_REG5 {
					regulator-always-on;
					regulator-boot-on;
					regulator-min-microvolt = <0x1b7740>;
					regulator-max-microvolt = <0x325aa0>;
					regulator-name = "vccio_sd";
					phandle = <0x2b>;

					regulator-state-mem {
						regulator-off-in-suspend;
					};
				};

				LDO_REG6 {
					regulator-always-on;
					regulator-boot-on;
					regulator-min-microvolt = <0x325aa0>;
					regulator-max-microvolt = <0x325aa0>;
					regulator-name = "vcc3v3_pmu";
					phandle = <0x29>;

					regulator-state-mem {
						regulator-on-in-suspend;
						regulator-suspend-microvolt = <0x2dc6c0>;
					};
				};

				LDO_REG7 {
					regulator-always-on;
					regulator-boot-on;
					regulator-min-microvolt = <0x1b7740>;
					regulator-max-microvolt = <0x1b7740>;
					regulator-name = "vcc_1v8";
					phandle = <0xed>;

					regulator-state-mem {
						regulator-off-in-suspend;
					};
				};

				LDO_REG8 {
					regulator-always-on;
					regulator-boot-on;
					regulator-min-microvolt = <0x1b7740>;
					regulator-max-microvolt = <0x1b7740>;
					regulator-name = "vcc1v8_dvp";
					phandle = <0x2d>;

					regulator-state-mem {
						regulator-on-in-suspend;
					};
				};

				LDO_REG9 {
					regulator-always-on;
					regulator-boot-on;
					regulator-min-microvolt = <0x1b7740>;
					regulator-max-microvolt = <0x325aa0>;
					regulator-name = "vcc2v8_dvp";
					phandle = <0x146>;

					regulator-state-mem {
						regulator-off-in-suspend;
					};
				};

				BOOST {
					regulator-always-on;
					regulator-boot-on;
					regulator-min-microvolt = <0x47b760>;
					regulator-max-microvolt = <0x5265c0>;
					regulator-name = "boost";
					phandle = <0x3d>;

					regulator-state-mem {
						regulator-off-in-suspend;
					};
				};

				OTG_SWITCH {
					regulator-name = "otg_switch";
					phandle = <0x147>;

					regulator-state-mem {
						regulator-off-in-suspend;
					};
				};
			};

			battery {
				compatible = "rk817,battery";
				ocv_table = <0xdac 0xdc4 0xde0 0xdfb 0xe11 0xe22 0xe33 0xe48 0xe62 0xe85 0xeb4 0xee7 0xf0e 0xf2e 0xf4a 0xf76 0xfa3 0xfbb 0xfd6 0x1006 0x1050>;
				design_capacity = <0x11fd>;
				design_qmax = <0x157c>;
				bat_res = <0x52>;
				sleep_enter_current = <0x96>;
				sleep_exit_current = <0xb4>;
				sleep_filter_current = <0x64>;
				power_off_thresd = <0xdac>;
				zero_algorithm_vol = <0xf0a>;
				max_soc_offset = <0x3c>;
				monitor_sec = <0x05>;
				sample_res = <0x0a>;
				virtual_power = <0x00>;
			};

			charger {
				compatible = "rk817,charger";
				min_input_voltage = <0x1194>;
				max_input_current = <0x7d0>;
				max_chrg_current = <0x7d0>;
				max_chrg_voltage = <0x10cc>;
				chrg_term_mode = <0x00>;
				chrg_finish_cur = <0x12c>;
				virtual_power = <0x00>;
				dc_det_adc = <0x00>;
				pinctrl-names = "default";
				pinctrl-0 = <0x3e>;
				extcon = <0x24>;
				gate_function_disable = <0x01>;
			};

			codec {
				#sound-dai-cells = <0x00>;
				compatible = "rockchip,rk817-codec";
				clocks = <0x1f 0x1a3>;
				clock-names = "mclk";
				assigned-clocks = <0x1f 0x1a3 0x1f 0x1a6>;
				assigned-clock-rates = <0xbb8000>;
				assigned-clock-parents = <0x1f 0x48 0x1f 0x48>;
				pinctrl-names = "default";
				pinctrl-0 = <0x3f>;
				hp-volume = <0x03>;
				spk-volume = <0x03>;
				out-l2spk-r2hp;
				spk-ctl-gpios = <0x40 0x12 0x00>;
				status = "okay";
				phandle = <0x106>;
			};
		};
	};

	serial@fdd50000 {
		compatible = "rockchip,rk3568-uart\0snps,dw-apb-uart";
		reg = <0x00 0xfdd50000 0x00 0x100>;
		interrupts = <0x00 0x74 0x04>;
		clocks = <0x31 0x0b 0x31 0x2c>;
		clock-names = "baudclk\0apb_pclk";
		reg-shift = <0x02>;
		reg-io-width = <0x04>;
		dmas = <0x41 0x00 0x41 0x01>;
		pinctrl-names = "default";
		pinctrl-0 = <0x42>;
		status = "disabled";
		phandle = <0x148>;
	};

	pwm@fdd70000 {
		compatible = "rockchip,rk3568-pwm\0rockchip,rk3328-pwm";
		reg = <0x00 0xfdd70000 0x00 0x10>;
		#pwm-cells = <0x03>;
		pinctrl-names = "active";
		pinctrl-0 = <0x43>;
		clocks = <0x31 0x0d 0x31 0x30>;
		clock-names = "pwm\0pclk";
		status = "disabled";
		phandle = <0x149>;
	};

	pwm@fdd70010 {
		compatible = "rockchip,rk3568-pwm\0rockchip,rk3328-pwm";
		reg = <0x00 0xfdd70010 0x00 0x10>;
		#pwm-cells = <0x03>;
		pinctrl-names = "active";
		pinctrl-0 = <0x44>;
		clocks = <0x31 0x0d 0x31 0x30>;
		clock-names = "pwm\0pclk";
		status = "disabled";
		phandle = <0x14a>;
	};

	pwm@fdd70020 {
		compatible = "rockchip,rk3568-pwm\0rockchip,rk3328-pwm";
		reg = <0x00 0xfdd70020 0x00 0x10>;
		#pwm-cells = <0x03>;
		pinctrl-names = "active";
		pinctrl-0 = <0x45>;
		clocks = <0x31 0x0d 0x31 0x30>;
		clock-names = "pwm\0pclk";
		status = "disabled";
		phandle = <0x14b>;
	};

	pwm@fdd70030 {
		compatible = "rockchip,rk3568-pwm\0rockchip,rk3328-pwm";
		reg = <0x00 0xfdd70030 0x00 0x10>;
		interrupts = <0x00 0x52 0x04 0x00 0x56 0x04>;
		#pwm-cells = <0x03>;
		pinctrl-names = "active";
		pinctrl-0 = <0x46>;
		clocks = <0x31 0x0d 0x31 0x30>;
		clock-names = "pwm\0pclk";
		status = "disabled";
		phandle = <0x14c>;
	};

	power-management@fdd90000 {
		compatible = "rockchip,rk3568-pmu\0syscon\0simple-mfd";
		reg = <0x00 0xfdd90000 0x00 0x1000>;
		phandle = <0x14d>;

		power-controller {
			compatible = "rockchip,rk3568-power-controller";
			#power-domain-cells = <0x01>;
			#address-cells = <0x01>;
			#size-cells = <0x00>;
			status = "okay";
			phandle = <0x21>;

			pd_npu@6 {
				reg = <0x06>;
				clocks = <0x1f 0x27 0x1f 0x25 0x1f 0x26>;
				pm_qos = <0x47>;
			};

			pd_gpu@7 {
				reg = <0x07>;
				clocks = <0x1f 0x19 0x1f 0x1a>;
				pm_qos = <0x48>;
			};

			pd_vi@8 {
				reg = <0x08>;
				clocks = <0x1f 0xcc 0x1f 0xcd>;
				pm_qos = <0x49 0x4a 0x4b>;
			};

			pd_vo@9 {
				reg = <0x09>;
				clocks = <0x1f 0xda 0x1f 0xdb 0x1f 0xdc>;
				pm_qos = <0x4c 0x4d 0x4e>;
			};

			pd_rga@10 {
				reg = <0x0a>;
				clocks = <0x1f 0xf1 0x1f 0xf2>;
				pm_qos = <0x4f 0x50 0x51 0x52 0x53 0x54>;
			};

			pd_vpu@11 {
				reg = <0x0b>;
				clocks = <0x1f 0xed>;
				pm_qos = <0x55>;
			};

			pd_rkvdec@13 {
				clocks = <0x1f 0x107>;
				reg = <0x0d>;
				pm_qos = <0x56>;
			};

			pd_rkvenc@14 {
				reg = <0x0e>;
				clocks = <0x1f 0x102>;
				pm_qos = <0x57 0x58 0x59>;
			};

			pd_pipe@15 {
				reg = <0x0f>;
				clocks = <0x1f 0x7f>;
				pm_qos = <0x5a 0x5b 0x5c 0x5d 0x5e>;
			};
		};
	};

	pvtm@fde00000 {
		compatible = "rockchip,rk3568-core-pvtm";
		reg = <0x00 0xfde00000 0x00 0x100>;
		#address-cells = <0x01>;
		#size-cells = <0x00>;

		pvtm@0 {
			reg = <0x00>;
			clocks = <0x1f 0x13 0x1f 0x1c2>;
			clock-names = "clk\0pclk";
			resets = <0x1f 0x1a 0x1f 0x19>;
			reset-names = "rts\0rst-p";
			thermal-zone = "soc-thermal";
		};
	};

	npu@fde40000 {
		compatible = "rockchip,rk3568-rknpu\0rockchip,rknpu";
		reg = <0x00 0xfde40000 0x00 0x10000>;
		interrupts = <0x00 0x97 0x04>;
		clocks = <0x02 0x02 0x1f 0x23 0x1f 0x28 0x1f 0x29>;
		clock-names = "scmi_clk\0clk\0aclk\0hclk";
		assigned-clocks = <0x1f 0x23>;
		assigned-clock-rates = <0x23c34600>;
		resets = <0x1f 0x2b 0x1f 0x2c>;
		reset-names = "srst_a\0srst_h";
		power-domains = <0x21 0x06>;
		operating-points-v2 = <0x5f>;
		iommus = <0x60>;
		status = "disabled";
		phandle = <0x14e>;
	};

	npu-opp-table {
		compatible = "operating-points-v2";
		mbist-vmin = <0xc96a8 0xdbba0 0xe7ef0>;
		nvmem-cells = <0x61 0x07 0x08>;
		nvmem-cell-names = "leakage\0pvtm\0mbist-vmin";
		rockchip,temp-hysteresis = <0x1388>;
		rockchip,low-temp = <0x00>;
		rockchip,low-temp-adjust-volt = <0x00 0x2bc 0xc350>;
		phandle = <0x5f>;

		opp-200000000 {
			opp-hz = <0x00 0xbebc200>;
			opp-microvolt = <0xc96a8 0xc96a8 0xf4240>;
		};

		opp-300000000 {
			opp-hz = <0x00 0x11b3dc40>;
			opp-microvolt = <0xc96a8 0xc96a8 0xf4240>;
		};

		opp-400000000 {
			opp-hz = <0x00 0x17d78400>;
			opp-microvolt = <0xc96a8 0xc96a8 0xf4240>;
		};

		opp-600000000 {
			opp-hz = <0x00 0x23c34600>;
			opp-microvolt = <0xc96a8 0xc96a8 0xf4240>;
		};

		opp-700000000 {
			opp-hz = <0x00 0x29b92700>;
			opp-microvolt = <0xcf850 0xcf850 0xf4240>;
		};

		opp-800000000 {
			opp-hz = <0x00 0x2faf0800>;
			opp-microvolt = <0xd59f8 0xd59f8 0xf4240>;
		};

		opp-900000000 {
			opp-hz = <0x00 0x35a4e900>;
			opp-microvolt = <0xe1d48 0xe1d48 0xf4240>;
		};

		opp-1000000000 {
			opp-hz = <0x00 0x3b9aca00>;
			opp-microvolt = <0xf4240 0xf4240 0xf4240>;
			status = "disabled";
		};
	};

	bus-npu {
		compatible = "rockchip,rk3568-bus";
		rockchip,busfreq-policy = "clkfreq";
		clocks = <0x02 0x02>;
		clock-names = "bus";
		operating-points-v2 = <0x62>;
		status = "disabled";
		phandle = <0x14f>;
	};

	bus-npu-opp-table {
		compatible = "operating-points-v2";
		opp-shared;
		nvmem-cells = <0x07>;
		nvmem-cell-names = "pvtm";
		rockchip,pvtm-voltage-sel = <0x00 0x14050 0x00 0x14051 0x16b48 0x01 0x16b49 0x186a0 0x02>;
		rockchip,pvtm-ch = <0x00 0x05>;
		phandle = <0x62>;

		opp-700000000 {
			opp-hz = <0x00 0x29b92700>;
			opp-microvolt = <0x00>;
		};

		opp-900000000 {
			opp-hz = <0x00 0x35a4e900>;
			opp-microvolt = <0xdbba0>;
		};

		opp-1000000000 {
			opp-hz = <0x00 0x3b9aca00>;
			opp-microvolt = <0xe7ef0>;
			opp-microvolt-L0 = <0xe7ef0>;
			opp-microvolt-L1 = <0xe1d48>;
			opp-microvolt-L2 = <0x00>;
		};
	};

	iommu@fde4b000 {
		compatible = "rockchip,iommu-v2";
		reg = <0x00 0xfde4b000 0x00 0x40>;
		interrupts = <0x00 0x97 0x04>;
		interrupt-names = "rknpu_mmu";
		clocks = <0x1f 0x28 0x1f 0x29>;
		clock-names = "aclk\0iface";
		power-domains = <0x21 0x06>;
		#iommu-cells = <0x00>;
		status = "disabled";
		phandle = <0x60>;
	};

	gpu@fde60000 {
		compatible = "arm,mali-bifrost";
		reg = <0x00 0xfde60000 0x00 0x4000>;
		interrupts = <0x00 0x27 0x04 0x00 0x29 0x04 0x00 0x28 0x04>;
		interrupt-names = "GPU\0MMU\0JOB";
		upthreshold = <0x28>;
		downdifferential = <0x0a>;
		clocks = <0x02 0x01 0x1f 0x1b>;
		clock-names = "clk_mali\0clk_gpu";
		power-domains = <0x21 0x07>;
		#cooling-cells = <0x02>;
		operating-points-v2 = <0x63>;
		status = "okay";
		mali-supply = <0x64>;
		phandle = <0x1d>;

		power-model {
			compatible = "simple-power-model";
			leakage-range = <0x05 0x0f>;
			ls = <0xffffa23e 0x5927 0x00>;
			static-coefficient = <0x186a0>;
			dynamic-coefficient = <0x3b9>;
			ts = <0xfffe56a6 0xf87a 0xfffffab5 0x14>;
			thermal-zone = "gpu-thermal";
			phandle = <0x150>;
		};
	};

	opp-table2 {
		compatible = "operating-points-v2";
		mbist-vmin = <0xc96a8 0xdbba0 0xe7ef0>;
		nvmem-cells = <0x65 0x07 0x08>;
		nvmem-cell-names = "leakage\0pvtm\0mbist-vmin";
		phandle = <0x63>;

		opp-200000000 {
			opp-hz = <0x00 0xbebc200>;
			opp-microvolt = <0xc96a8>;
		};

		opp-300000000 {
			opp-hz = <0x00 0x11e1a300>;
			opp-microvolt = <0xc96a8>;
		};

		opp-400000000 {
			opp-hz = <0x00 0x17d78400>;
			opp-microvolt = <0xc96a8>;
		};

		opp-600000000 {
			opp-hz = <0x00 0x23c34600>;
			opp-microvolt = <0xc96a8>;
		};

		opp-700000000 {
			opp-hz = <0x00 0x29b92700>;
			opp-microvolt = <0xdbba0>;
		};

		opp-800000000 {
			opp-hz = <0x00 0x2faf0800>;
			opp-microvolt = <0xe7ef0>;
		};
	};

	pvtm@fde80000 {
		compatible = "rockchip,rk3568-gpu-pvtm";
		reg = <0x00 0xfde80000 0x00 0x100>;
		#address-cells = <0x01>;
		#size-cells = <0x00>;

		pvtm@1 {
			reg = <0x01>;
			clocks = <0x1f 0x1e 0x1f 0x1d>;
			clock-names = "clk\0pclk";
			resets = <0x1f 0x24 0x1f 0x23>;
			reset-names = "rts\0rst-p";
			thermal-zone = "gpu-thermal";
		};
	};

	pvtm@fde90000 {
		compatible = "rockchip,rk3568-npu-pvtm";
		reg = <0x00 0xfde90000 0x00 0x100>;
		#address-cells = <0x01>;
		#size-cells = <0x00>;

		pvtm@2 {
			reg = <0x02>;
			clocks = <0x1f 0x2b 0x1f 0x2a 0x1f 0x25>;
			clock-names = "clk\0pclk\0hclk";
			resets = <0x1f 0x2e 0x1f 0x2d>;
			reset-names = "rts\0rst-p";
			thermal-zone = "soc-thermal";
		};
	};

	vdpu@fdea0400 {
		compatible = "rockchip,vpu-decoder-v2";
		reg = <0x00 0xfdea0400 0x00 0x400>;
		interrupts = <0x00 0x8b 0x04>;
		interrupt-names = "irq_dec";
		clocks = <0x1f 0xee 0x1f 0xef>;
		clock-names = "aclk_vcodec\0hclk_vcodec";
		resets = <0x1f 0x11a 0x1f 0x11b>;
		reset-names = "video_a\0video_h";
		iommus = <0x66>;
		power-domains = <0x21 0x0b>;
		rockchip,srv = <0x67>;
		rockchip,taskqueue-node = <0x00>;
		rockchip,resetgroup-node = <0x00>;
		status = "okay";
		phandle = <0x151>;
	};

	iommu@fdea0800 {
		compatible = "rockchip,iommu-v2";
		reg = <0x00 0xfdea0800 0x00 0x40>;
		interrupts = <0x00 0x8a 0x04>;
		interrupt-names = "vdpu_mmu";
		clock-names = "aclk\0iface";
		clocks = <0x1f 0xee 0x1f 0xef>;
		power-domains = <0x21 0x0b>;
		#iommu-cells = <0x00>;
		status = "okay";
		phandle = <0x66>;
	};

	rk_rga@fdeb0000 {
		compatible = "rockchip,rga2";
		reg = <0x00 0xfdeb0000 0x00 0x1000>;
		interrupts = <0x00 0x5a 0x04>;
		clocks = <0x1f 0xf3 0x1f 0xf4 0x1f 0xf5>;
		clock-names = "aclk_rga\0hclk_rga\0clk_rga";
		power-domains = <0x21 0x0a>;
		status = "okay";
		phandle = <0x152>;
	};

	ebc@fdec0000 {
		compatible = "rockchip,rk3568-ebc-tcon";
		reg = <0x00 0xfdec0000 0x00 0x5000>;
		interrupts = <0x00 0x11 0x04>;
		clocks = <0x1f 0xf9 0x1f 0xfa>;
		clock-names = "hclk\0dclk";
		power-domains = <0x21 0x0a>;
		rockchip,grf = <0x32>;
		pinctrl-names = "default";
		pinctrl-0 = <0x68>;
		status = "disabled";
		phandle = <0x153>;
	};

	jpegd@fded0000 {
		compatible = "rockchip,rkv-jpeg-decoder-v1";
		reg = <0x00 0xfded0000 0x00 0x400>;
		interrupts = <0x00 0x3e 0x04>;
		clocks = <0x1f 0xfb 0x1f 0xfc>;
		clock-names = "aclk_vcodec\0hclk_vcodec";
		rockchip,disable-auto-freq;
		resets = <0x1f 0x12c 0x1f 0x12d>;
		reset-names = "video_a\0video_h";
		iommus = <0x69>;
		rockchip,srv = <0x67>;
		rockchip,taskqueue-node = <0x01>;
		rockchip,resetgroup-node = <0x01>;
		power-domains = <0x21 0x0a>;
		status = "okay";
		phandle = <0x154>;
	};

	iommu@fded0480 {
		compatible = "rockchip,iommu-v2";
		reg = <0x00 0xfded0480 0x00 0x40>;
		interrupts = <0x00 0x3d 0x04>;
		interrupt-names = "jpegd_mmu";
		clock-names = "aclk\0iface";
		clocks = <0x1f 0xfb 0x1f 0xfc>;
		power-domains = <0x21 0x0a>;
		#iommu-cells = <0x00>;
		status = "okay";
		phandle = <0x69>;
	};

	vepu@fdee0000 {
		compatible = "rockchip,vpu-encoder-v2";
		reg = <0x00 0xfdee0000 0x00 0x400>;
		interrupts = <0x00 0x40 0x04>;
		clocks = <0x1f 0xfd 0x1f 0xfe>;
		clock-names = "aclk_vcodec\0hclk_vcodec";
		rockchip,disable-auto-freq;
		resets = <0x1f 0x12e 0x1f 0x12f>;
		reset-names = "video_a\0video_h";
		iommus = <0x6a>;
		rockchip,srv = <0x67>;
		rockchip,taskqueue-node = <0x02>;
		rockchip,resetgroup-node = <0x02>;
		power-domains = <0x21 0x0a>;
		status = "okay";
		phandle = <0x155>;
	};

	iommu@fdee0800 {
		compatible = "rockchip,iommu-v2";
		reg = <0x00 0xfdee0800 0x00 0x40>;
		interrupts = <0x00 0x3f 0x04>;
		interrupt-names = "vepu_mmu";
		clock-names = "aclk\0iface";
		clocks = <0x1f 0xfd 0x1f 0xfe>;
		power-domains = <0x21 0x0a>;
		#iommu-cells = <0x00>;
		status = "okay";
		phandle = <0x6a>;
	};

	iep@fdef0000 {
		compatible = "rockchip,iep-v2";
		reg = <0x00 0xfdef0000 0x00 0x500>;
		interrupts = <0x00 0x38 0x04>;
		clocks = <0x1f 0xf6 0x1f 0xf7 0x1f 0xf8>;
		clock-names = "aclk\0hclk\0sclk";
		resets = <0x1f 0x127 0x1f 0x128 0x1f 0x129>;
		reset-names = "rst_a\0rst_h\0rst_s";
		power-domains = <0x21 0x0a>;
		rockchip,srv = <0x67>;
		rockchip,taskqueue-node = <0x05>;
		rockchip,resetgroup-node = <0x05>;
		iommus = <0x6b>;
		status = "disabled";
		phandle = <0x156>;
	};

	iommu@fdef0800 {
		compatible = "rockchip,iommu-v2";
		reg = <0x00 0xfdef0800 0x00 0x100>;
		interrupts = <0x00 0x38 0x04>;
		interrupt-names = "iep_mmu";
		clocks = <0x1f 0xf6 0x1f 0xf7>;
		clock-names = "aclk\0iface";
		#iommu-cells = <0x00>;
		power-domains = <0x21 0x0a>;
		status = "disabled";
		phandle = <0x6b>;
	};

	eink@fdf00000 {
		compatible = "rockchip,rk3568-eink-tcon";
		reg = <0x00 0xfdf00000 0x00 0x74>;
		interrupts = <0x00 0xb2 0x04>;
		clocks = <0x1f 0xff 0x1f 0x100>;
		clock-names = "pclk\0hclk";
		status = "disabled";
		phandle = <0x157>;
	};

	rkvenc@fdf40000 {
		compatible = "rockchip,rkv-encoder-v1";
		reg = <0x00 0xfdf40000 0x00 0x400>;
		interrupts = <0x00 0x8c 0x04>;
		interrupt-names = "irq_enc";
		clocks = <0x1f 0x103 0x1f 0x104 0x1f 0x105>;
		clock-names = "aclk_vcodec\0hclk_vcodec\0clk_core";
		rockchip,normal-rates = <0x11b3dc40 0x00 0x11b3dc40>;
		resets = <0x1f 0x133 0x1f 0x134 0x1f 0x135>;
		reset-names = "video_a\0video_h\0video_core";
		assigned-clocks = <0x1f 0x103 0x1f 0x105>;
		assigned-clock-rates = <0x11b3dc40 0x11b3dc40>;
		iommus = <0x6c>;
		node-name = "rkvenc";
		rockchip,srv = <0x67>;
		rockchip,taskqueue-node = <0x03>;
		rockchip,resetgroup-node = <0x03>;
		power-domains = <0x21 0x0e>;
		operating-points-v2 = <0x6d>;
		status = "okay";
		phandle = <0x158>;
	};

	rkvenc-opp-table {
		compatible = "operating-points-v2";
		nvmem-cells = <0x07>;
		nvmem-cell-names = "pvtm";
		rockchip,pvtm-voltage-sel = <0x00 0x14050 0x00 0x14051 0x16b48 0x01 0x16b49 0x186a0 0x02>;
		rockchip,pvtm-ch = <0x00 0x05>;
		phandle = <0x6d>;

		opp-297000000 {
			opp-hz = <0x00 0x11b3dc40>;
			opp-microvolt = <0x00>;
		};

		opp-400000000 {
			opp-hz = <0x00 0x17d78400>;
			opp-microvolt = <0xe7ef0>;
			opp-microvolt-L0 = <0xe7ef0>;
			opp-microvolt-L1 = <0xe1d48>;
			opp-microvolt-L2 = <0x00>;
		};
	};

	iommu@fdf40f00 {
		compatible = "rockchip,iommu-v2";
		reg = <0x00 0xfdf40f00 0x00 0x40 0x00 0xfdf40f40 0x00 0x40>;
		interrupts = <0x00 0x8d 0x04 0x00 0x8e 0x04>;
		interrupt-names = "rkvenc_mmu0\0rkvenc_mmu1";
		clocks = <0x1f 0x103 0x1f 0x104>;
		clock-names = "aclk\0iface";
		rockchip,disable-mmu-reset;
		rockchip,enable-cmd-retry;
		#iommu-cells = <0x00>;
		power-domains = <0x21 0x0e>;
		status = "okay";
		phandle = <0x6c>;
	};

	rkvdec@fdf80200 {
		compatible = "rockchip,rkv-decoder-rk3568\0rockchip,rkv-decoder-v2";
		reg = <0x00 0xfdf80200 0x00 0x400 0x00 0xfdf80100 0x00 0x100>;
		reg-names = "regs\0link";
		interrupts = <0x00 0x5b 0x04>;
		interrupt-names = "irq_dec";
		clocks = <0x1f 0x108 0x1f 0x109 0x1f 0x10a 0x1f 0x10b 0x1f 0x10c>;
		clock-names = "aclk_vcodec\0hclk_vcodec\0clk_cabac\0clk_core\0clk_hevc_cabac";
		rockchip,normal-rates = <0x11b3dc40 0x00 0x11b3dc40 0x11b3dc40 0x23c34600>;
		rockchip,advanced-rates = <0x179a7b00 0x00 0x179a7b00 0x179a7b00 0x23c34600>;
		rockchip,default-max-load = <0x1fe000>;
		resets = <0x1f 0x142 0x1f 0x143 0x1f 0x144 0x1f 0x145 0x1f 0x146>;
		assigned-clocks = <0x1f 0x108 0x1f 0x10a 0x1f 0x10b 0x1f 0x10c>;
		assigned-clock-rates = <0x11b3dc40 0x11b3dc40 0x11b3dc40 0x11b3dc40>;
		reset-names = "video_a\0video_h\0video_cabac\0video_core\0video_hevc_cabac";
		power-domains = <0x21 0x0d>;
		iommus = <0x6e>;
		rockchip,srv = <0x67>;
		rockchip,taskqueue-node = <0x04>;
		rockchip,resetgroup-node = <0x04>;
		rockchip,sram = <0x6f>;
		rockchip,rcb-iova = <0x10000000 0x10000>;
		rockchip,rcb-min-width = <0x200>;
		rockchip,task-capacity = <0x10>;
		status = "okay";
		phandle = <0x159>;
	};

	iommu@fdf80800 {
		compatible = "rockchip,iommu-v2";
		reg = <0x00 0xfdf80800 0x00 0x40 0x00 0xfdf80840 0x00 0x40>;
		interrupts = <0x00 0x5c 0x04>;
		interrupt-names = "rkvdec_mmu";
		clocks = <0x1f 0x108 0x1f 0x109>;
		clock-names = "aclk\0iface";
		power-domains = <0x21 0x0d>;
		#iommu-cells = <0x00>;
		status = "okay";
		phandle = <0x6e>;
	};

	mipi-csi2@fdfb0000 {
		compatible = "rockchip,rk3568-mipi-csi2";
		reg = <0x00 0xfdfb0000 0x00 0x10000>;
		reg-names = "csihost_regs";
		interrupts = <0x00 0x08 0x04 0x00 0x09 0x04>;
		interrupt-names = "csi-intr1\0csi-intr2";
		clocks = <0x1f 0xd5>;
		clock-names = "pclk_csi2host";
		resets = <0x1f 0xff>;
		reset-names = "srst_csihost_p";
		status = "disabled";
		phandle = <0x15a>;
	};

	rkcif@fdfe0000 {
		compatible = "rockchip,rk3568-cif";
		reg = <0x00 0xfdfe0000 0x00 0x8000>;
		reg-names = "cif_regs";
		interrupts = <0x00 0x92 0x04>;
		interrupt-names = "cif-intr";
		clocks = <0x1f 0xce 0x1f 0xcf 0x1f 0xd0 0x1f 0xd1>;
		clock-names = "aclk_cif\0hclk_cif\0dclk_cif\0iclk_cif_g";
		resets = <0x1f 0xf7 0x1f 0xf8 0x1f 0xf9 0x1f 0xfb 0x1f 0xfa>;
		reset-names = "rst_cif_a\0rst_cif_h\0rst_cif_d\0rst_cif_p\0rst_cif_i";
		assigned-clocks = <0x1f 0xd0>;
		assigned-clock-rates = <0x11e1a300>;
		power-domains = <0x21 0x08>;
		rockchip,grf = <0x32>;
		iommus = <0x70>;
		status = "disabled";
		phandle = <0x71>;
	};

	iommu@fdfe0800 {
		compatible = "rockchip,iommu-v2";
		reg = <0x00 0xfdfe0800 0x00 0x100>;
		interrupts = <0x00 0x92 0x04>;
		interrupt-names = "cif_mmu";
		clocks = <0x1f 0xce 0x1f 0xcf>;
		clock-names = "aclk\0iface";
		power-domains = <0x21 0x08>;
		rockchip,disable-mmu-reset;
		#iommu-cells = <0x00>;
		status = "disabled";
		phandle = <0x70>;
	};

	rkcif_dvp {
		compatible = "rockchip,rkcif-dvp";
		rockchip,hw = <0x71>;
		status = "disabled";
		phandle = <0x72>;
	};

	rkcif_dvp_sditf {
		compatible = "rockchip,rkcif-sditf";
		rockchip,cif = <0x72>;
		status = "disabled";
		phandle = <0x15b>;
	};

	rkcif_mipi_lvds {
		compatible = "rockchip,rkcif-mipi-lvds";
		rockchip,hw = <0x71>;
		status = "disabled";
		phandle = <0x73>;
	};

	rkcif_mipi_lvds_sditf {
		compatible = "rockchip,rkcif-sditf";
		rockchip,cif = <0x73>;
		status = "disabled";
		phandle = <0x15c>;
	};

	rkisp@fdff0000 {
		compatible = "rockchip,rk3568-rkisp";
		reg = <0x00 0xfdff0000 0x00 0x10000>;
		interrupts = <0x00 0x39 0x04 0x00 0x3a 0x04 0x00 0x3c 0x04>;
		interrupt-names = "mipi_irq\0mi_irq\0isp_irq";
		clocks = <0x1f 0xd2 0x1f 0xd3 0x1f 0xd4>;
		clock-names = "aclk_isp\0hclk_isp\0clk_isp";
		resets = <0x1f 0xfd 0x1f 0xfc>;
		reset-names = "isp\0isp-h";
		rockchip,grf = <0x32>;
		power-domains = <0x21 0x08>;
		iommus = <0x74>;
		rockchip,iq-feature = <0x3fb 0xf7fe67ff>;
		status = "disabled";
		phandle = <0x75>;
	};

	iommu@fdff1a00 {
		compatible = "rockchip,iommu-v2";
		reg = <0x00 0xfdff1a00 0x00 0x100>;
		interrupts = <0x00 0x3b 0x04>;
		interrupt-names = "isp_mmu";
		clocks = <0x1f 0xd2 0x1f 0xd3>;
		clock-names = "aclk\0iface";
		power-domains = <0x21 0x08>;
		#iommu-cells = <0x00>;
		rockchip,disable-mmu-reset;
		status = "disabled";
		phandle = <0x74>;
	};

	rkisp-vir0 {
		compatible = "rockchip,rkisp-vir";
		rockchip,hw = <0x75>;
		status = "disabled";
		phandle = <0x15d>;
	};

	rkisp-vir1 {
		compatible = "rockchip,rkisp-vir";
		rockchip,hw = <0x75>;
		status = "disabled";
		phandle = <0x15e>;
	};

	ethernet@fe010000 {
		compatible = "rockchip,rk3568-gmac\0snps,dwmac-4.20a";
		reg = <0x00 0xfe010000 0x00 0x10000>;
		interrupts = <0x00 0x20 0x04 0x00 0x1d 0x04>;
		interrupt-names = "macirq\0eth_wake_irq";
		rockchip,grf = <0x32>;
		clocks = <0x1f 0x186 0x1f 0x189 0x1f 0x189 0x1f 0xc7 0x1f 0xc3 0x1f 0xc4 0x1f 0x189 0x1f 0xc8 0x1f 0xac>;
		clock-names = "stmmaceth\0mac_clk_rx\0mac_clk_tx\0clk_mac_refout\0aclk_mac\0pclk_mac\0clk_mac_speed\0ptp_ref\0pclk_xpcs";
		resets = <0x1f 0xec>;
		reset-names = "stmmaceth";
		snps,mixed-burst;
		snps,tso;
		snps,axi-config = <0x76>;
		snps,mtl-rx-config = <0x77>;
		snps,mtl-tx-config = <0x78>;
		status = "disabled";
		phandle = <0x15f>;

		mdio {
			compatible = "snps,dwmac-mdio";
			#address-cells = <0x01>;
			#size-cells = <0x00>;
			phandle = <0x160>;
		};

		stmmac-axi-config {
			snps,wr_osr_lmt = <0x04>;
			snps,rd_osr_lmt = <0x08>;
			snps,blen = <0x00 0x00 0x00 0x00 0x10 0x08 0x04>;
			phandle = <0x76>;
		};

		rx-queues-config {
			snps,rx-queues-to-use = <0x01>;
			phandle = <0x77>;

			queue0 {
			};
		};

		tx-queues-config {
			snps,tx-queues-to-use = <0x01>;
			phandle = <0x78>;

			queue0 {
			};
		};
	};

	vop@fe040000 {
		compatible = "rockchip,rk3568-vop";
		reg = <0x00 0xfe040000 0x00 0x3000 0x00 0xfe044000 0x00 0x1000>;
		reg-names = "regs\0gamma_lut";
		rockchip,grf = <0x32>;
		interrupts = <0x00 0x94 0x04>;
		clocks = <0x1f 0xdd 0x1f 0xde 0x1f 0xdf 0x1f 0xe0 0x1f 0xe1>;
		clock-names = "aclk_vop\0hclk_vop\0dclk_vp0\0dclk_vp1\0dclk_vp2";
		iommus = <0x79>;
		power-domains = <0x21 0x09>;
		status = "okay";
		support-multi-area;
		phandle = <0x161>;

		ports {
			#address-cells = <0x01>;
			#size-cells = <0x00>;
			phandle = <0x12>;

			port@0 {
				#address-cells = <0x01>;
				#size-cells = <0x00>;
				reg = <0x00>;
				rockchip,plane-mask = <0x14>;
				rockchip,primary-plane = <0x04>;
				phandle = <0x162>;

				endpoint@0 {
					reg = <0x00>;
					remote-endpoint = <0x7a>;
					phandle = <0x14>;
				};

				endpoint@1 {
					reg = <0x01>;
					remote-endpoint = <0x7b>;
					phandle = <0x15>;
				};

				endpoint@2 {
					reg = <0x02>;
					remote-endpoint = <0x7c>;
					phandle = <0x16>;
				};

				endpoint@3 {
					reg = <0x03>;
					remote-endpoint = <0x7d>;
					phandle = <0x17>;
				};
			};

			port@1 {
				#address-cells = <0x01>;
				#size-cells = <0x00>;
				reg = <0x01>;
				phandle = <0x163>;

				endpoint@0 {
					reg = <0x00>;
					remote-endpoint = <0x7e>;
					phandle = <0x85>;
				};

				endpoint@1 {
					reg = <0x01>;
					remote-endpoint = <0x7f>;
					phandle = <0x8b>;
				};

				endpoint@2 {
					reg = <0x02>;
					remote-endpoint = <0x80>;
					phandle = <0x91>;
				};

				endpoint@3 {
					reg = <0x03>;
					remote-endpoint = <0x81>;
					phandle = <0x8f>;
				};

				endpoint@4 {
					reg = <0x04>;
					remote-endpoint = <0x82>;
					phandle = <0x18>;
				};
			};

			port@2 {
				#address-cells = <0x01>;
				#size-cells = <0x00>;
				reg = <0x02>;
				phandle = <0x164>;

				endpoint@0 {
					reg = <0x00>;
					remote-endpoint = <0x83>;
					phandle = <0x2f>;
				};

				endpoint@1 {
					reg = <0x01>;
					remote-endpoint = <0x84>;
					phandle = <0x19>;
				};
			};
		};
	};

	iommu@fe043e00 {
		compatible = "rockchip,iommu-v2";
		reg = <0x00 0xfe043e00 0x00 0x100 0x00 0xfe043f00 0x00 0x100>;
		interrupts = <0x00 0x94 0x04>;
		interrupt-names = "vop_mmu";
		clocks = <0x1f 0xdd 0x1f 0xde>;
		clock-names = "aclk\0iface";
		#iommu-cells = <0x00>;
		status = "okay";
		phandle = <0x79>;
	};

	dsi@fe060000 {
		compatible = "rockchip,rk3568-mipi-dsi";
		reg = <0x00 0xfe060000 0x00 0x10000>;
		interrupts = <0x00 0x44 0x04>;
		clocks = <0x1f 0xe8 0x1f 0xda 0x2e>;
		clock-names = "pclk\0hclk\0hs_clk";
		resets = <0x1f 0x110>;
		reset-names = "apb";
		phys = <0x2e>;
		phy-names = "mipi_dphy";
		power-domains = <0x21 0x09>;
		rockchip,grf = <0x32>;
		#address-cells = <0x01>;
		#size-cells = <0x00>;
		status = "okay";
		phandle = <0x165>;

		ports {
			#address-cells = <0x01>;
			#size-cells = <0x00>;

			port@0 {
				reg = <0x00>;
				#address-cells = <0x01>;
				#size-cells = <0x00>;
				phandle = <0x166>;

				endpoint@0 {
					reg = <0x00>;
					remote-endpoint = <0x14>;
					status = "okay";
					phandle = <0x7a>;
				};

				endpoint@1 {
					reg = <0x01>;
					remote-endpoint = <0x85>;
					status = "disabled";
					phandle = <0x7e>;
				};
			};

			port@1 {
				reg = <0x01>;

				endpoint {
					remote-endpoint = <0x86>;
					phandle = <0x89>;
				};
			};
		};

		panel@0 {
			compatible = "simple-panel-dsi";
			reg = <0x00>;
			reset-delay-ms = <0x3c>;
			enable-delay-ms = <0x78>;
			prepare-delay-ms = <0x3c>;
			init-delay-ms = <0x3c>;
			unprepare-delay-ms = <0x3c>;
			disable-delay-ms = <0x3c>;
			backlight = <0x87>;
			enable-gpios = <0x36 0x17 0x00>;
			reset-gpios = <0x36 0x06 0x01>;
			rotation = <0x10e>;
			dsi,flags = <0xa03>;
			dsi,format = <0x00>;
			dsi,lanes = <0x04>;
			panel-init-sequence = <0x390004ff 0x98810715 0x20320 0x15000204 0x6150002 0x5001500 0x2060115 0x20700 0x15000208 0x150002 0x9001500 0x20a0015 0x20b2f 0x1500020c 0x150002 0xd001500 0x20e0015 0x20f00 0x15000210 0x40150002 0x11021500 0x2120515 0x21300 0x15000214 0x150002 0x15001500 0x2162f15 0x2172f 0x15000218 0x150002 0x19001500 0x21a0015 0x21b50 0x1500021c 0xbc150002 0x1d0c1500 0x21e0015 0x21f00 0x15000220 0x150002 0x21001500 0x2220015 0x223c0 0x15000224 0x30150002 0x25001500 0x2260015 0x22703 0x15000230 0x1150002 0x31231500 0x2324515 0x23367 0x15000234 0x89150002 0x35ab1500 0x2360115 0x23723 0x15000238 0x45150002 0x39671500 0x23a8915 0x23bab 0x1500023c 0xcd150002 0x3def1500 0x2501115 0x25106 0x15000252 0xc150002 0x530d1500 0x2540e15 0x2550f 0x15000256 0x2150002 0x57021500 0x2580215 0x25902 0x1500025a 0x2150002 0x5b021500 0x25c0215 0x25d02 0x1500025e 0x2150002 0x5f021500 0x2600515 0x26105 0x15000262 0x5150002 0x63021500 0x2640115 0x26500 0x15000266 0x8150002 0x67081500 0x2680c15 0x2690d 0x1500026a 0xe150002 0x6b0f1500 0x26c0215 0x26d02 0x1500026e 0x2150002 0x6f021500 0x2700215 0x27102 0x15000272 0x2150002 0x73021500 0x2740215 0x27502 0x15000276 0x5150002 0x77051500 0x2780515 0x27902 0x1500027a 0x1150002 0x7b001500 0x27c0639 0x4ff98 0x81081500 0x276b415 0x27802 0x15000274 0x2b150002 0x8e151500 0x2400115 0x28481 0x15000272 0x25150002 0xe3751500 0x27dcb15 0x27e49 0x15000249 0x10150002 0x32051500 0x23c0539 0x4ff98 0x81011500 0x2220a15 0x24301 0x15000253 0x82150002 0x55851500 0x250b915 0x251ba 0x15000231 0x150002 0xa0001500 0x2a11415 0x2a22b 0x150002a3 0x16150002 0xa41c1500 0x2a52e15 0x2a618 0x150002a7 0x20150002 0xa8781500 0x2a92015 0x2aa2a 0x150002ab 0x83150002 0xac251500 0x2ad1b15 0x2ae54 0x150002af 0x2b150002 0xb02b1500 0x2b14f15 0x2b267 0x150002b3 0x39150002 0xc0001500 0x2c11415 0x2c22b 0x150002c3 0x16150002 0xc41c1500 0x2c52e15 0x2c618 0x150002c7 0x20150002 0xc8781500 0x2c92015 0x2ca2a 0x150002cb 0x83150002 0xcc251500 0x2cd1b15 0x2ce54 0x150002cf 0x2b150002 0xd02b1500 0x2d14f15 0x2d267 0x150002d3 0x39390004 0xff988100 0x5780111 0x5140129>;
			panel-exit-sequence = <0x5100128 0x5200110>;
			phandle = <0x167>;

			display-timings {
				native-mode = <0x88>;
				phandle = <0x168>;

				timing0 {
					clock-frequency = <0x3ef1480>;
					hactive = <0x2d0>;
					vactive = <0x500>;
					hfront-porch = <0x32>;
					hsync-len = <0x14>;
					hback-porch = <0x32>;
					vfront-porch = <0x0a>;
					vsync-len = <0x04>;
					vback-porch = <0x0a>;
					hsync-active = <0x00>;
					vsync-active = <0x00>;
					de-active = <0x00>;
					pixelclk-active = <0x00>;
					phandle = <0x88>;
				};
			};

			ports {
				#address-cells = <0x01>;
				#size-cells = <0x00>;

				port@0 {
					reg = <0x00>;

					endpoint {
						remote-endpoint = <0x89>;
						phandle = <0x86>;
					};
				};
			};
		};
	};

	dsi@fe070000 {
		compatible = "rockchip,rk3568-mipi-dsi";
		reg = <0x00 0xfe070000 0x00 0x10000>;
		interrupts = <0x00 0x45 0x04>;
		clocks = <0x1f 0xe9 0x1f 0xda 0x8a>;
		clock-names = "pclk\0hclk\0hs_clk";
		resets = <0x1f 0x111>;
		reset-names = "apb";
		phys = <0x8a>;
		phy-names = "mipi_dphy";
		power-domains = <0x21 0x09>;
		rockchip,grf = <0x32>;
		#address-cells = <0x01>;
		#size-cells = <0x00>;
		status = "disabled";
		phandle = <0x169>;

		ports {
			#address-cells = <0x01>;
			#size-cells = <0x00>;

			port@0 {
				reg = <0x00>;
				#address-cells = <0x01>;
				#size-cells = <0x00>;
				phandle = <0x16a>;

				endpoint@0 {
					reg = <0x00>;
					remote-endpoint = <0x15>;
					status = "disabled";
					phandle = <0x7b>;
				};

				endpoint@1 {
					reg = <0x01>;
					remote-endpoint = <0x8b>;
					status = "disabled";
					phandle = <0x7f>;
				};
			};
		};
	};

	hdmi@fe0a0000 {
		compatible = "rockchip,rk3568-dw-hdmi";
		reg = <0x00 0xfe0a0000 0x00 0x20000>;
		interrupts = <0x00 0x2d 0x04>;
		clocks = <0x1f 0xe6 0x1f 0xe7 0x1f 0x193 0x31 0x02 0x1f 0xde>;
		clock-names = "iahb\0isfr\0cec\0ref\0hclk";
		power-domains = <0x21 0x09>;
		reg-io-width = <0x04>;
		rockchip,grf = <0x32>;
		#sound-dai-cells = <0x00>;
		pinctrl-names = "default";
		pinctrl-0 = <0x8c 0x8d 0x8e>;
		status = "okay";
		phandle = <0x108>;

		ports {
			#address-cells = <0x01>;
			#size-cells = <0x00>;

			port {
				reg = <0x00>;
				#address-cells = <0x01>;
				#size-cells = <0x00>;
				phandle = <0x16b>;

				endpoint@0 {
					reg = <0x00>;
					remote-endpoint = <0x17>;
					status = "okay";
					phandle = <0x7d>;
				};

				endpoint@1 {
					reg = <0x01>;
					remote-endpoint = <0x8f>;
					status = "disabled";
					phandle = <0x81>;
				};
			};
		};
	};

	edp@fe0c0000 {
		compatible = "rockchip,rk3568-edp";
		reg = <0x00 0xfe0c0000 0x00 0x10000>;
		interrupts = <0x00 0x12 0x04>;
		clocks = <0x31 0x29 0x1f 0xea 0x1f 0xeb 0x1f 0xda>;
		clock-names = "dp\0pclk\0spdif\0hclk";
		resets = <0x1f 0x113 0x1f 0x112>;
		reset-names = "dp\0apb";
		phys = <0x90>;
		phy-names = "dp";
		power-domains = <0x21 0x09>;
		status = "disabled";
		phandle = <0x16c>;

		ports {
			#address-cells = <0x01>;
			#size-cells = <0x00>;

			port@0 {
				reg = <0x00>;
				#address-cells = <0x01>;
				#size-cells = <0x00>;
				phandle = <0x16d>;

				endpoint@0 {
					reg = <0x00>;
					remote-endpoint = <0x16>;
					status = "okay";
					phandle = <0x7c>;
				};

				endpoint@1 {
					reg = <0x01>;
					remote-endpoint = <0x91>;
					status = "disabled";
					phandle = <0x80>;
				};
			};
		};
	};

	nocp-cpu@fe102000 {
		compatible = "rockchip,rk3568-nocp";
		reg = <0x00 0xfe102000 0x00 0x100>;
		phandle = <0x16e>;
	};

	nocp-gpu-vpu-rga-venc@fe102400 {
		compatible = "rockchip,rk3568-nocp";
		reg = <0x00 0xfe102400 0x00 0x100>;
		phandle = <0x16f>;
	};

	nocp-vdec@fe102800 {
		compatible = "rockchip,rk3568-nocp";
		reg = <0x00 0xfe102800 0x00 0x100>;
		phandle = <0x170>;
	};

	nocp-vi-usb-peri-pipe@fe102c00 {
		compatible = "rockchip,rk3568-nocp";
		reg = <0x00 0xfe102c00 0x00 0x100>;
		phandle = <0x171>;
	};

	nocp-vo@fe103000 {
		compatible = "rockchip,rk3568-nocp";
		reg = <0x00 0xfe103000 0x00 0x100>;
		phandle = <0x172>;
	};

	qos@fe128000 {
		compatible = "syscon";
		reg = <0x00 0xfe128000 0x00 0x20>;
		phandle = <0x48>;
	};

	qos@fe138080 {
		compatible = "syscon";
		reg = <0x00 0xfe138080 0x00 0x20>;
		phandle = <0x57>;
	};

	qos@fe138100 {
		compatible = "syscon";
		reg = <0x00 0xfe138100 0x00 0x20>;
		phandle = <0x58>;
	};

	qos@fe138180 {
		compatible = "syscon";
		reg = <0x00 0xfe138180 0x00 0x20>;
		phandle = <0x59>;
	};

	qos@fe148000 {
		compatible = "syscon";
		reg = <0x00 0xfe148000 0x00 0x20>;
		phandle = <0x49>;
	};

	qos@fe148080 {
		compatible = "syscon";
		reg = <0x00 0xfe148080 0x00 0x20>;
		phandle = <0x4a>;
	};

	qos@fe148100 {
		compatible = "syscon";
		reg = <0x00 0xfe148100 0x00 0x20>;
		phandle = <0x4b>;
	};

	qos@fe150000 {
		compatible = "syscon";
		reg = <0x00 0xfe150000 0x00 0x20>;
		phandle = <0x55>;
	};

	qos@fe158000 {
		compatible = "syscon";
		reg = <0x00 0xfe158000 0x00 0x20>;
		phandle = <0x4f>;
	};

	qos@fe158100 {
		compatible = "syscon";
		reg = <0x00 0xfe158100 0x00 0x20>;
		phandle = <0x50>;
	};

	qos@fe158180 {
		compatible = "syscon";
		reg = <0x00 0xfe158180 0x00 0x20>;
		phandle = <0x51>;
	};

	qos@fe158200 {
		compatible = "syscon";
		reg = <0x00 0xfe158200 0x00 0x20>;
		phandle = <0x52>;
	};

	qos@fe158280 {
		compatible = "syscon";
		reg = <0x00 0xfe158280 0x00 0x20>;
		phandle = <0x53>;
	};

	qos@fe158300 {
		compatible = "syscon";
		reg = <0x00 0xfe158300 0x00 0x20>;
		phandle = <0x54>;
	};

	qos@fe180000 {
		compatible = "syscon";
		reg = <0x00 0xfe180000 0x00 0x20>;
		phandle = <0x47>;
	};

	qos@fe190000 {
		compatible = "syscon";
		reg = <0x00 0xfe190000 0x00 0x20>;
		phandle = <0x5a>;
	};

	qos@fe190280 {
		compatible = "syscon";
		reg = <0x00 0xfe190280 0x00 0x20>;
		phandle = <0x5b>;
	};

	qos@fe190300 {
		compatible = "syscon";
		reg = <0x00 0xfe190300 0x00 0x20>;
		phandle = <0x5c>;
	};

	qos@fe190380 {
		compatible = "syscon";
		reg = <0x00 0xfe190380 0x00 0x20>;
		phandle = <0x5d>;
	};

	qos@fe190400 {
		compatible = "syscon";
		reg = <0x00 0xfe190400 0x00 0x20>;
		phandle = <0x5e>;
	};

	qos@fe198000 {
		compatible = "syscon";
		reg = <0x00 0xfe198000 0x00 0x20>;
		phandle = <0x56>;
	};

	qos@fe1a8000 {
		compatible = "syscon";
		reg = <0x00 0xfe1a8000 0x00 0x20>;
		phandle = <0x4c>;
	};

	qos@fe1a8080 {
		compatible = "syscon";
		reg = <0x00 0xfe1a8080 0x00 0x20>;
		phandle = <0x4d>;
	};

	qos@fe1a8100 {
		compatible = "syscon";
		reg = <0x00 0xfe1a8100 0x00 0x20>;
		phandle = <0x4e>;
	};

	dwmmc@fe000000 {
		compatible = "rockchip,rk3568-dw-mshc\0rockchip,rk3288-dw-mshc";
		reg = <0x00 0xfe000000 0x00 0x4000>;
		interrupts = <0x00 0x64 0x04>;
		max-frequency = <0x2faf080>;
		clocks = <0x1f 0xc1 0x1f 0xc2 0x1f 0x18e 0x1f 0x18f>;
		clock-names = "biu\0ciu\0ciu-drive\0ciu-sample";
		fifo-depth = <0x100>;
		resets = <0x1f 0xeb>;
		reset-names = "reset";
		status = "okay";
		supports-sd;
		bus-width = <0x04>;
		cap-mmc-highspeed;
		cap-sd-highspeed;
		disable-wp;
		pinctrl-names = "default";
		pinctrl-0 = <0x92 0x93 0x94 0x95>;
		phandle = <0x173>;
	};

	dfi@fe230000 {
		reg = <0x00 0xfe230000 0x00 0x400>;
		compatible = "rockchip,rk3568-dfi";
		rockchip,pmugrf = <0x33>;
		status = "okay";
		phandle = <0x96>;
	};

	dmc {
		compatible = "rockchip,rk3568-dmc";
		interrupts = <0x00 0x0a 0x04>;
		interrupt-names = "complete";
		devfreq-events = <0x96>;
		clocks = <0x02 0x03>;
		clock-names = "dmc_clk";
		operating-points-v2 = <0x97>;
		vop-bw-dmc-freq = <0x00 0x1f9 0x4f1a0 0x1fa 0x1869f 0x80e80>;
		upthreshold = <0x28>;
		downdifferential = <0x14>;
		system-status-freq = <0x01 0xbe6e0 0x08 0x17cdc0 0x02 0x4f1a0 0x10 0xbe6e0 0x10000 0xbe6e0 0x1000 0x17cdc0 0x4000 0x17cdc0 0x2000 0x17cdc0 0xc00 0x17cdc0>;
		auto-min-freq = <0x4f1a0>;
		auto-freq-en = <0x01>;
		#cooling-cells = <0x02>;
		status = "okay";
		center-supply = <0x98>;
		phandle = <0x13>;
	};

	dmc-fsp {
		compatible = "rockchip,rk3568-dmc-fsp";
		debug_print_level = <0x00>;
		ddr3_params = <0x99>;
		ddr4_params = <0x9a>;
		lpddr3_params = <0x9b>;
		lpddr4_params = <0x9c>;
		lpddr4x_params = <0x9d>;
		status = "okay";
		phandle = <0x174>;
	};

	dmc-opp-table {
		compatible = "operating-points-v2";
		mbist-vmin = <0xc96a8 0xdbba0 0xe7ef0>;
		nvmem-cells = <0x9e 0x07 0x08>;
		nvmem-cell-names = "leakage\0pvtm\0mbist-vmin";
		rockchip,temp-hysteresis = <0x1388>;
		rockchip,low-temp = <0x00>;
		rockchip,low-temp-adjust-volt = <0x00 0x618 0x61a8>;
		phandle = <0x97>;

		opp-324000000 {
			opp-hz = <0x00 0x134fd900>;
			opp-microvolt = <0xdbba0>;
		};

		opp-528000000 {
			opp-hz = <0x00 0x1f78a400>;
			opp-microvolt = <0xdbba0>;
		};

		opp-780000000 {
			opp-hz = <0x00 0x2e7ddb00>;
			opp-microvolt = <0xdbba0>;
		};

		opp-920000000 {
			opp-hz = <0x00 0x36d61600>;
			opp-microvolt = <0xdbba0>;
			status = "disabled";
		};

		opp-1560000000 {
			opp-hz = <0x00 0x5cfbb600>;
			opp-microvolt = <0xdbba0>;
		};
	};

	dmcdbg {
		compatible = "rockchip,rk3568-dmcdbg";
		status = "disabled";
		phandle = <0x175>;
	};

	pcie@fe260000 {
		compatible = "rockchip,rk3568-pcie\0snps,dw-pcie";
		#address-cells = <0x03>;
		#size-cells = <0x02>;
		bus-range = <0x00 0x0f>;
		clocks = <0x1f 0x81 0x1f 0x82 0x1f 0x83 0x1f 0x84 0x1f 0x85>;
		clock-names = "aclk_mst\0aclk_slv\0aclk_dbi\0pclk\0aux";
		device_type = "pci";
		interrupts = <0x00 0x4b 0x04 0x00 0x4a 0x04 0x00 0x49 0x04 0x00 0x48 0x04 0x00 0x47 0x04>;
		interrupt-names = "sys\0pmc\0msg\0legacy\0err";
		#interrupt-cells = <0x01>;
		interrupt-map-mask = <0x00 0x00 0x00 0x07>;
		interrupt-map = <0x00 0x00 0x00 0x01 0x9f 0x00 0x00 0x00 0x00 0x02 0x9f 0x01 0x00 0x00 0x00 0x03 0x9f 0x02 0x00 0x00 0x00 0x04 0x9f 0x03>;
		linux,pci-domain = <0x00>;
		num-ib-windows = <0x06>;
		num-ob-windows = <0x02>;
		max-link-speed = <0x02>;
		msi-map = <0x00 0xa0 0x00 0x1000>;
		num-lanes = <0x01>;
		phys = <0x22 0x02>;
		phy-names = "pcie-phy";
		power-domains = <0x21 0x0f>;
		ranges = <0x800 0x00 0x00 0x03 0x00 0x00 0x800000 0x81000000 0x00 0x800000 0x03 0x800000 0x00 0x100000 0x83000000 0x00 0x900000 0x03 0x900000 0x00 0x3f700000>;
		reg = <0x03 0xc0000000 0x00 0x400000 0x00 0xfe260000 0x00 0x10000>;
		reg-names = "pcie-dbi\0pcie-apb";
		resets = <0x1f 0xa1>;
		reset-names = "pipe";
		status = "disabled";
		phandle = <0x176>;

		legacy-interrupt-controller {
			interrupt-controller;
			#address-cells = <0x00>;
			#interrupt-cells = <0x01>;
			interrupt-parent = <0x01>;
			interrupts = <0x00 0x48 0x01>;
			phandle = <0x9f>;
		};
	};

	dwmmc@fe2b0000 {
		compatible = "rockchip,rk3568-dw-mshc\0rockchip,rk3288-dw-mshc";
		reg = <0x00 0xfe2b0000 0x00 0x4000>;
		interrupts = <0x00 0x62 0x04>;
		max-frequency = <0x8f0d180>;
		clocks = <0x1f 0xb0 0x1f 0xb1 0x1f 0x18a 0x1f 0x18b>;
		clock-names = "biu\0ciu\0ciu-drive\0ciu-sample";
		fifo-depth = <0x100>;
		resets = <0x1f 0xd4>;
		reset-names = "reset";
		status = "okay";
		supports-sd;
		bus-width = <0x04>;
		cap-mmc-highspeed;
		cap-sd-highspeed;
		disable-wp;
		sd-uhs-sdr104;
		vmmc-supply = <0xa1>;
		vqmmc-supply = <0x2b>;
		pinctrl-names = "default";
		pinctrl-0 = <0xa2 0xa3 0xa4 0xa5>;
		phandle = <0x177>;
	};

	dwmmc@fe2c0000 {
		compatible = "rockchip,rk3568-dw-mshc\0rockchip,rk3288-dw-mshc";
		reg = <0x00 0xfe2c0000 0x00 0x4000>;
		interrupts = <0x00 0x63 0x04>;
		max-frequency = <0x8f0d180>;
		clocks = <0x1f 0xb2 0x1f 0xb3 0x1f 0x18c 0x1f 0x18d>;
		clock-names = "biu\0ciu\0ciu-drive\0ciu-sample";
		fifo-depth = <0x100>;
		resets = <0x1f 0xd6>;
		reset-names = "reset";
		status = "okay";
		supports-sdio;
		bus-width = <0x04>;
		disable-wp;
		cap-sd-highspeed;
		cap-sdio-irq;
		keep-power-in-suspend;
		mmc-pwrseq = <0xa6>;
		non-removable;
		pinctrl-names = "default";
		pinctrl-0 = <0xa7 0xa8 0xa9>;
		sd-uhs-sdr104;
		rockchip,default-sample-phase = <0x5a>;
		phandle = <0x178>;
	};

	sfc@fe300000 {
		compatible = "rockchip,sfc";
		reg = <0x00 0xfe300000 0x00 0x4000>;
		interrupts = <0x00 0x65 0x04>;
		clocks = <0x1f 0x78 0x1f 0x76>;
		clock-names = "clk_sfc\0hclk_sfc";
		assigned-clocks = <0x1f 0x78>;
		assigned-clock-rates = <0x5f5e100>;
		status = "disabled";
		phandle = <0x179>;
	};

	sdhci@fe310000 {
		compatible = "rockchip,dwcmshc-sdhci\0snps,dwcmshc-sdhci";
		reg = <0x00 0xfe310000 0x00 0x10000>;
		interrupts = <0x00 0x13 0x04>;
		assigned-clocks = <0x1f 0x7b 0x1f 0x7d 0x1f 0x7c>;
		assigned-clock-rates = <0xbebc200 0x16e3600 0xbebc200>;
		clocks = <0x1f 0x7c 0x1f 0x7a 0x1f 0x79 0x1f 0x7b 0x1f 0x7d>;
		clock-names = "core\0bus\0axi\0block\0timer";
		status = "okay";
		bus-width = <0x08>;
		supports-emmc;
		non-removable;
		max-frequency = <0xbebc200>;
		phandle = <0x17a>;
	};

	nandc@fe330000 {
		compatible = "rockchip,rk-nandc-v9";
		reg = <0x00 0xfe330000 0x00 0x4000>;
		interrupts = <0x00 0x46 0x04>;
		nandc_id = <0x00>;
		clocks = <0x1f 0x75 0x1f 0x74>;
		clock-names = "clk_nandc\0hclk_nandc";
		status = "okay";
		phandle = <0x17b>;
	};

	crypto@fe380000 {
		compatible = "rockchip,rk3568-crypto";
		reg = <0x00 0xfe380000 0x00 0x4000>;
		interrupts = <0x00 0x04 0x04>;
		clocks = <0x1f 0x6a 0x1f 0x6b 0x1f 0x6c 0x1f 0x6d>;
		clock-names = "aclk\0hclk\0sclk\0apb_pclk";
		assigned-clocks = <0x1f 0x6c>;
		assigned-clock-rates = <0xbebc200>;
		resets = <0x1f 0x69>;
		reset-names = "crypto-rst";
		status = "disabled";
		phandle = <0x17c>;
	};

	rng@fe388000 {
		compatible = "rockchip,cryptov2-rng";
		reg = <0x00 0xfe388000 0x00 0x2000>;
		clocks = <0x1f 0x70 0x1f 0x6f>;
		clock-names = "clk_trng\0hclk_trng";
		resets = <0x1f 0x6d>;
		reset-names = "reset";
		status = "okay";
		phandle = <0x17d>;
	};

	otp@fe38c000 {
		compatible = "rockchip,rk3568-otp";
		reg = <0x00 0xfe38c000 0x00 0x4000>;
		#address-cells = <0x01>;
		#size-cells = <0x01>;
		clocks = <0x1f 0x73 0x1f 0x72 0x1f 0x71 0x1f 0x181>;
		clock-names = "usr\0sbpi\0apb\0phy";
		resets = <0x1f 0x1cf>;
		reset-names = "otp_phy";
		phandle = <0x17e>;

		cpu-code@2 {
			reg = <0x02 0x02>;
			phandle = <0x0f>;
		};

		cpu-version@8 {
			reg = <0x08 0x01>;
			bits = <0x03 0x03>;
			phandle = <0x0e>;
		};

		mbist-vmin@9 {
			reg = <0x09 0x01>;
			bits = <0x00 0x04>;
			phandle = <0x08>;
		};

		id@a {
			reg = <0x0a 0x10>;
			phandle = <0x0d>;
		};

		cpu-leakage@1a {
			reg = <0x1a 0x01>;
			phandle = <0x06>;
		};

		log-leakage@1b {
			reg = <0x1b 0x01>;
			phandle = <0x9e>;
		};

		npu-leakage@1c {
			reg = <0x1c 0x01>;
			phandle = <0x61>;
		};

		gpu-leakage@1d {
			reg = <0x1d 0x01>;
			phandle = <0x65>;
		};

		core-pvtm@2a {
			reg = <0x2a 0x02>;
			phandle = <0x07>;
		};
	};

	i2s@fe400000 {
		compatible = "rockchip,rk3568-i2s-tdm";
		reg = <0x00 0xfe400000 0x00 0x1000>;
		interrupts = <0x00 0x34 0x04>;
		clocks = <0x1f 0x3f 0x1f 0x43 0x1f 0x39>;
		clock-names = "mclk_tx\0mclk_rx\0hclk";
		dmas = <0xaa 0x00>;
		dma-names = "tx";
		resets = <0x1f 0x50 0x1f 0x51>;
		reset-names = "tx-m\0rx-m";
		rockchip,cru = <0x1f>;
		rockchip,grf = <0x32>;
		rockchip,playback-only;
		#sound-dai-cells = <0x00>;
		status = "okay";
		phandle = <0x107>;
	};

	i2s@fe410000 {
		compatible = "rockchip,rk3568-i2s-tdm";
		reg = <0x00 0xfe410000 0x00 0x1000>;
		interrupts = <0x00 0x35 0x04>;
		clocks = <0x1f 0x47 0x1f 0x4b 0x1f 0x3a>;
		clock-names = "mclk_tx\0mclk_rx\0hclk";
		dmas = <0xaa 0x02 0xaa 0x03>;
		dma-names = "tx\0rx";
		resets = <0x1f 0x52 0x1f 0x53>;
		reset-names = "tx-m\0rx-m";
		rockchip,cru = <0x1f>;
		rockchip,grf = <0x32>;
		#sound-dai-cells = <0x00>;
		pinctrl-names = "default";
		pinctrl-0 = <0xab 0xac 0xad 0xae>;
		status = "okay";
		rockchip,clk-trcm = <0x01>;
		phandle = <0x105>;
	};

	i2s@fe420000 {
		compatible = "rockchip,rk3568-i2s-tdm";
		reg = <0x00 0xfe420000 0x00 0x1000>;
		interrupts = <0x00 0x36 0x04>;
		clocks = <0x1f 0x4f 0x1f 0x4f 0x1f 0x3b>;
		clock-names = "mclk_tx\0mclk_rx\0hclk";
		dmas = <0xaa 0x04 0xaa 0x05>;
		dma-names = "tx\0rx";
		rockchip,cru = <0x1f>;
		rockchip,grf = <0x32>;
		rockchip,clk-trcm = <0x01>;
		#sound-dai-cells = <0x00>;
		pinctrl-names = "default";
		pinctrl-0 = <0xaf 0xb0 0xb1 0xb2>;
		status = "disabled";
		phandle = <0x17f>;
	};

	i2s@fe430000 {
		compatible = "rockchip,rk3568-i2s-tdm";
		reg = <0x00 0xfe430000 0x00 0x1000>;
		interrupts = <0x00 0x37 0x04>;
		clocks = <0x1f 0x53 0x1f 0x57 0x1f 0x3c>;
		clock-names = "mclk_tx\0mclk_rx\0hclk";
		dmas = <0xaa 0x06 0xaa 0x07>;
		dma-names = "tx\0rx";
		resets = <0x1f 0x55 0x1f 0x56>;
		reset-names = "tx-m\0rx-m";
		rockchip,cru = <0x1f>;
		rockchip,grf = <0x32>;
		rockchip,clk-trcm = <0x01>;
		#sound-dai-cells = <0x00>;
		pinctrl-names = "default";
		pinctrl-0 = <0xb3 0xb4 0xb5 0xb6>;
		status = "disabled";
		phandle = <0x180>;
	};

	pdm@fe440000 {
		compatible = "rockchip,rk3568-pdm";
		reg = <0x00 0xfe440000 0x00 0x1000>;
		clocks = <0x1f 0x5a 0x1f 0x59>;
		clock-names = "pdm_clk\0pdm_hclk";
		dmas = <0xaa 0x09>;
		dma-names = "rx";
		pinctrl-names = "default";
		pinctrl-0 = <0xb7 0xb8 0xb9 0xba 0xbb 0xbc>;
		#sound-dai-cells = <0x00>;
		status = "disabled";
		phandle = <0x181>;
	};

	vad@fe450000 {
		compatible = "rockchip,rk3568-vad";
		reg = <0x00 0xfe450000 0x00 0x10000>;
		reg-names = "vad";
		clocks = <0x1f 0x5b>;
		clock-names = "hclk";
		interrupts = <0x00 0x89 0x04>;
		rockchip,audio-src = <0x00>;
		rockchip,det-channel = <0x00>;
		rockchip,mode = <0x00>;
		#sound-dai-cells = <0x00>;
		status = "disabled";
		phandle = <0x182>;
	};

	spdif@fe460000 {
		compatible = "rockchip,rk3568-spdif";
		reg = <0x00 0xfe460000 0x00 0x1000>;
		interrupts = <0x00 0x66 0x04>;
		dmas = <0xaa 0x01>;
		dma-names = "tx";
		clock-names = "mclk\0hclk";
		clocks = <0x1f 0x5f 0x1f 0x5c>;
		#sound-dai-cells = <0x00>;
		pinctrl-names = "default";
		pinctrl-0 = <0xbd>;
		status = "disabled";
		phandle = <0x183>;
	};

	audpwm@fe470000 {
		compatible = "rockchip,rk3568-audio-pwm\0rockchip,audio-pwm-v1";
		reg = <0x00 0xfe470000 0x00 0x1000>;
		clocks = <0x1f 0x63 0x1f 0x60>;
		clock-names = "clk\0hclk";
		dmas = <0xaa 0x08>;
		dma-names = "tx";
		#sound-dai-cells = <0x00>;
		rockchip,sample-width-bits = <0x0b>;
		rockchip,interpolat-points = <0x01>;
		status = "disabled";
		phandle = <0x184>;
	};

	codec-digital@fe478000 {
		compatible = "rockchip,rk3568-codec-digital\0rockchip,codec-digital-v1";
		reg = <0x00 0xfe478000 0x00 0x1000>;
		clocks = <0x1f 0x67 0x1f 0x66 0x1f 0x65 0x1f 0x64>;
		clock-names = "adc\0dac\0i2c\0pclk";
		pinctrl-names = "default";
		pinctrl-0 = <0xbe>;
		resets = <0x1f 0x5f>;
		reset-names = "reset";
		rockchip,grf = <0x32>;
		#sound-dai-cells = <0x00>;
		status = "disabled";
		phandle = <0x185>;
	};

	dmac@fe530000 {
		compatible = "arm,pl330\0arm,primecell";
		reg = <0x00 0xfe530000 0x00 0x4000>;
		interrupts = <0x00 0x0e 0x04 0x00 0x0d 0x04>;
		clocks = <0x1f 0x10d>;
		clock-names = "apb_pclk";
		#dma-cells = <0x01>;
		arm,pl330-periph-burst;
		phandle = <0x41>;
	};

	dmac@fe550000 {
		compatible = "arm,pl330\0arm,primecell";
		reg = <0x00 0xfe550000 0x00 0x4000>;
		interrupts = <0x00 0x10 0x04 0x00 0x0f 0x04>;
		clocks = <0x1f 0x10d>;
		clock-names = "apb_pclk";
		#dma-cells = <0x01>;
		arm,pl330-periph-burst;
		phandle = <0xaa>;
	};

	rkscr@fe560000 {
		compatible = "rockchip-scr";
		reg = <0x00 0xfe560000 0x00 0x10000>;
		interrupts = <0x00 0x61 0x04>;
		pinctrl-names = "default";
		pinctrl-0 = <0xbf>;
		clocks = <0x1f 0x114>;
		clock-names = "g_pclk_sim_card";
		status = "disabled";
		phandle = <0x186>;
	};

	can@fe570000 {
		compatible = "rockchip,canfd-1.0";
		reg = <0x00 0xfe570000 0x00 0x1000>;
		interrupts = <0x00 0x01 0x04>;
		clocks = <0x1f 0x141 0x1f 0x140>;
		clock-names = "baudclk\0apb_pclk";
		resets = <0x1f 0x155 0x1f 0x154>;
		reset-names = "can\0can-apb";
		tx-fifo-depth = <0x01>;
		rx-fifo-depth = <0x06>;
		status = "disabled";
		phandle = <0x187>;
	};

	can@fe580000 {
		compatible = "rockchip,canfd-1.0";
		reg = <0x00 0xfe580000 0x00 0x1000>;
		interrupts = <0x00 0x02 0x04>;
		clocks = <0x1f 0x143 0x1f 0x142>;
		clock-names = "baudclk\0apb_pclk";
		resets = <0x1f 0x157 0x1f 0x156>;
		reset-names = "can\0can-apb";
		tx-fifo-depth = <0x01>;
		rx-fifo-depth = <0x06>;
		status = "disabled";
		phandle = <0x188>;
	};

	can@fe590000 {
		compatible = "rockchip,canfd-1.0";
		reg = <0x00 0xfe590000 0x00 0x1000>;
		interrupts = <0x00 0x03 0x04>;
		clocks = <0x1f 0x145 0x1f 0x144>;
		clock-names = "baudclk\0apb_pclk";
		resets = <0x1f 0x159 0x1f 0x158>;
		reset-names = "can\0can-apb";
		tx-fifo-depth = <0x01>;
		rx-fifo-depth = <0x06>;
		status = "disabled";
		phandle = <0x189>;
	};

	i2c@fe5a0000 {
		compatible = "rockchip,rk3399-i2c";
		reg = <0x00 0xfe5a0000 0x00 0x1000>;
		clocks = <0x1f 0x148 0x1f 0x147>;
		clock-names = "i2c\0pclk";
		interrupts = <0x00 0x2f 0x04>;
		pinctrl-names = "default";
		pinctrl-0 = <0xc0>;
		#address-cells = <0x01>;
		#size-cells = <0x00>;
		status = "disabled";
		phandle = <0x18a>;
	};

	i2c@fe5b0000 {
		compatible = "rockchip,rk3399-i2c";
		reg = <0x00 0xfe5b0000 0x00 0x1000>;
		clocks = <0x1f 0x14a 0x1f 0x149>;
		clock-names = "i2c\0pclk";
		interrupts = <0x00 0x30 0x04>;
		pinctrl-names = "default";
		pinctrl-0 = <0xc1>;
		#address-cells = <0x01>;
		#size-cells = <0x00>;
		status = "disabled";
		phandle = <0x18b>;
	};

	i2c@fe5c0000 {
		compatible = "rockchip,rk3399-i2c";
		reg = <0x00 0xfe5c0000 0x00 0x1000>;
		clocks = <0x1f 0x14c 0x1f 0x14b>;
		clock-names = "i2c\0pclk";
		interrupts = <0x00 0x31 0x04>;
		pinctrl-names = "default";
		pinctrl-0 = <0xc2>;
		#address-cells = <0x01>;
		#size-cells = <0x00>;
		status = "disabled";
		clock-frequency = <0x61a80>;
		i2c-scl-rising-time-ns = <0x8a>;
		i2c-scl-falling-time-ns = <0x04>;
		phandle = <0x18c>;
	};

	i2c@fe5d0000 {
		compatible = "rockchip,rk3399-i2c";
		reg = <0x00 0xfe5d0000 0x00 0x1000>;
		clocks = <0x1f 0x14e 0x1f 0x14d>;
		clock-names = "i2c\0pclk";
		interrupts = <0x00 0x32 0x04>;
		pinctrl-names = "default";
		pinctrl-0 = <0xc3>;
		#address-cells = <0x01>;
		#size-cells = <0x00>;
		status = "disabled";
		phandle = <0x18d>;
	};

	i2c@fe5e0000 {
		compatible = "rockchip,rk3399-i2c";
		reg = <0x00 0xfe5e0000 0x00 0x1000>;
		clocks = <0x1f 0x150 0x1f 0x14f>;
		clock-names = "i2c\0pclk";
		interrupts = <0x00 0x33 0x04>;
		pinctrl-names = "default";
		pinctrl-0 = <0xc4>;
		#address-cells = <0x01>;
		#size-cells = <0x00>;
		status = "disabled";
		clock-frequency = <0x61a80>;
		i2c-scl-rising-time-ns = <0x90>;
		i2c-scl-falling-time-ns = <0x04>;
		phandle = <0x18e>;
	};

	timer@fe5f0000 {
		compatible = "rockchip,rk3568-timer\0rockchip,rk3288-timer";
		reg = <0x00 0xfe5f0000 0x00 0x1000>;
		interrupts = <0x00 0x6d 0x04>;
		clocks = <0x1f 0x16c 0x1f 0x16d>;
		clock-names = "pclk\0timer";
		phandle = <0x18f>;
	};

	watchdog@fe600000 {
		compatible = "snps,dw-wdt";
		reg = <0x00 0xfe600000 0x00 0x100>;
		clocks = <0x1f 0x116 0x1f 0x115>;
		clock-names = "tclk\0pclk";
		interrupts = <0x00 0x95 0x04>;
		status = "okay";
		phandle = <0x190>;
	};

	spi@fe610000 {
		compatible = "rockchip,rk3066-spi";
		reg = <0x00 0xfe610000 0x00 0x1000>;
		interrupts = <0x00 0x67 0x04>;
		#address-cells = <0x01>;
		#size-cells = <0x00>;
		clocks = <0x1f 0x152 0x1f 0x151>;
		clock-names = "spiclk\0apb_pclk";
		dmas = <0x41 0x14 0x41 0x15>;
		dma-names = "tx\0rx";
		pinctrl-names = "default\0high_speed";
		pinctrl-0 = <0xc5 0xc6 0xc7>;
		pinctrl-1 = <0xc5 0xc6 0xc8>;
		status = "disabled";
		phandle = <0x191>;
	};

	spi@fe620000 {
		compatible = "rockchip,rk3066-spi";
		reg = <0x00 0xfe620000 0x00 0x1000>;
		interrupts = <0x00 0x68 0x04>;
		#address-cells = <0x01>;
		#size-cells = <0x00>;
		clocks = <0x1f 0x154 0x1f 0x153>;
		clock-names = "spiclk\0apb_pclk";
		dmas = <0x41 0x16 0x41 0x17>;
		dma-names = "tx\0rx";
		pinctrl-names = "default\0high_speed";
		pinctrl-0 = <0xc9 0xca 0xcb>;
		pinctrl-1 = <0xc9 0xca 0xcc>;
		status = "disabled";
		phandle = <0x192>;
	};

	spi@fe630000 {
		compatible = "rockchip,rk3066-spi";
		reg = <0x00 0xfe630000 0x00 0x1000>;
		interrupts = <0x00 0x69 0x04>;
		#address-cells = <0x01>;
		#size-cells = <0x00>;
		clocks = <0x1f 0x156 0x1f 0x155>;
		clock-names = "spiclk\0apb_pclk";
		dmas = <0x41 0x18 0x41 0x19>;
		dma-names = "tx\0rx";
		pinctrl-names = "default\0high_speed";
		pinctrl-0 = <0xcd 0xce 0xcf>;
		pinctrl-1 = <0xcd 0xce 0xd0>;
		status = "disabled";
		phandle = <0x193>;
	};

	spi@fe640000 {
		compatible = "rockchip,rk3066-spi";
		reg = <0x00 0xfe640000 0x00 0x1000>;
		interrupts = <0x00 0x6a 0x04>;
		#address-cells = <0x01>;
		#size-cells = <0x00>;
		clocks = <0x1f 0x158 0x1f 0x157>;
		clock-names = "spiclk\0apb_pclk";
		dmas = <0x41 0x1a 0x41 0x1b>;
		dma-names = "tx\0rx";
		pinctrl-names = "default\0high_speed";
		pinctrl-0 = <0xd1 0xd2 0xd3>;
		pinctrl-1 = <0xd1 0xd2 0xd4>;
		status = "disabled";
		phandle = <0x194>;
	};

	serial@fe650000 {
		compatible = "rockchip,rk3568-uart\0snps,dw-apb-uart";
		reg = <0x00 0xfe650000 0x00 0x100>;
		interrupts = <0x00 0x75 0x04>;
		clocks = <0x1f 0x11f 0x1f 0x11c>;
		clock-names = "baudclk\0apb_pclk";
		reg-shift = <0x02>;
		reg-io-width = <0x04>;
		dmas = <0x41 0x02 0x41 0x03>;
		pinctrl-names = "default";
		pinctrl-0 = <0xd5 0xd6>;
		status = "okay";
		phandle = <0x195>;
	};

	serial@fe660000 {
		compatible = "rockchip,rk3568-uart\0snps,dw-apb-uart";
		reg = <0x00 0xfe660000 0x00 0x100>;
		interrupts = <0x00 0x76 0x04>;
		clocks = <0x1f 0x123 0x1f 0x120>;
		clock-names = "baudclk\0apb_pclk";
		reg-shift = <0x02>;
		reg-io-width = <0x04>;
		dmas = <0x41 0x04 0x41 0x05>;
		pinctrl-names = "default";
		pinctrl-0 = <0xd7>;
		status = "disabled";
		phandle = <0x196>;
	};

	serial@fe670000 {
		compatible = "rockchip,rk3568-uart\0snps,dw-apb-uart";
		reg = <0x00 0xfe670000 0x00 0x100>;
		interrupts = <0x00 0x77 0x04>;
		clocks = <0x1f 0x127 0x1f 0x124>;
		clock-names = "baudclk\0apb_pclk";
		reg-shift = <0x02>;
		reg-io-width = <0x04>;
		dmas = <0x41 0x06 0x41 0x07>;
		pinctrl-names = "default";
		pinctrl-0 = <0xd8>;
		status = "disabled";
		phandle = <0x197>;
	};

	serial@fe680000 {
		compatible = "rockchip,rk3568-uart\0snps,dw-apb-uart";
		reg = <0x00 0xfe680000 0x00 0x100>;
		interrupts = <0x00 0x78 0x04>;
		clocks = <0x1f 0x12b 0x1f 0x128>;
		clock-names = "baudclk\0apb_pclk";
		reg-shift = <0x02>;
		reg-io-width = <0x04>;
		dmas = <0x41 0x08 0x41 0x09>;
		pinctrl-names = "default";
		pinctrl-0 = <0xd9>;
		status = "disabled";
		phandle = <0x198>;
	};

	serial@fe690000 {
		compatible = "rockchip,rk3568-uart\0snps,dw-apb-uart";
		reg = <0x00 0xfe690000 0x00 0x100>;
		interrupts = <0x00 0x79 0x04>;
		clocks = <0x1f 0x12f 0x1f 0x12c>;
		clock-names = "baudclk\0apb_pclk";
		reg-shift = <0x02>;
		reg-io-width = <0x04>;
		dmas = <0x41 0x0a 0x41 0x0b>;
		pinctrl-names = "default";
		pinctrl-0 = <0xda>;
		status = "disabled";
		phandle = <0x199>;
	};

	serial@fe6a0000 {
		compatible = "rockchip,rk3568-uart\0snps,dw-apb-uart";
		reg = <0x00 0xfe6a0000 0x00 0x100>;
		interrupts = <0x00 0x7a 0x04>;
		clocks = <0x1f 0x133 0x1f 0x130>;
		clock-names = "baudclk\0apb_pclk";
		reg-shift = <0x02>;
		reg-io-width = <0x04>;
		dmas = <0x41 0x0c 0x41 0x0d>;
		pinctrl-names = "default";
		pinctrl-0 = <0xdb>;
		status = "disabled";
		phandle = <0x19a>;
	};

	serial@fe6b0000 {
		compatible = "rockchip,rk3568-uart\0snps,dw-apb-uart";
		reg = <0x00 0xfe6b0000 0x00 0x100>;
		interrupts = <0x00 0x7b 0x04>;
		clocks = <0x1f 0x137 0x1f 0x134>;
		clock-names = "baudclk\0apb_pclk";
		reg-shift = <0x02>;
		reg-io-width = <0x04>;
		dmas = <0x41 0x0e 0x41 0x0f>;
		pinctrl-names = "default";
		pinctrl-0 = <0xdc>;
		status = "disabled";
		phandle = <0x19b>;
	};

	serial@fe6c0000 {
		compatible = "rockchip,rk3568-uart\0snps,dw-apb-uart";
		reg = <0x00 0xfe6c0000 0x00 0x100>;
		interrupts = <0x00 0x7c 0x04>;
		clocks = <0x1f 0x13b 0x1f 0x138>;
		clock-names = "baudclk\0apb_pclk";
		reg-shift = <0x02>;
		reg-io-width = <0x04>;
		dmas = <0x41 0x10 0x41 0x11>;
		pinctrl-names = "default";
		pinctrl-0 = <0xdd>;
		status = "disabled";
		phandle = <0x19c>;
	};

	serial@fe6d0000 {
		compatible = "rockchip,rk3568-uart\0snps,dw-apb-uart";
		reg = <0x00 0xfe6d0000 0x00 0x100>;
		interrupts = <0x00 0x7d 0x04>;
		clocks = <0x1f 0x13f 0x1f 0x13c>;
		clock-names = "baudclk\0apb_pclk";
		reg-shift = <0x02>;
		reg-io-width = <0x04>;
		dmas = <0x41 0x12 0x41 0x13>;
		pinctrl-names = "default";
		pinctrl-0 = <0xde>;
		status = "disabled";
		phandle = <0x19d>;
	};

	pwm@fe6e0000 {
		compatible = "rockchip,rk3568-pwm\0rockchip,rk3328-pwm";
		reg = <0x00 0xfe6e0000 0x00 0x10>;
		#pwm-cells = <0x03>;
		pinctrl-names = "active";
		pinctrl-0 = <0xdf>;
		clocks = <0x1f 0x15a 0x1f 0x159>;
		clock-names = "pwm\0pclk";
		status = "okay";
		phandle = <0x102>;
	};

	pwm@fe6e0010 {
		compatible = "rockchip,rk3568-pwm\0rockchip,rk3328-pwm";
		reg = <0x00 0xfe6e0010 0x00 0x10>;
		#pwm-cells = <0x03>;
		pinctrl-names = "active";
		pinctrl-0 = <0xe0>;
		clocks = <0x1f 0x15a 0x1f 0x159>;
		clock-names = "pwm\0pclk";
		status = "disabled";
		phandle = <0x19e>;
	};

	pwm@fe6e0020 {
		compatible = "rockchip,rk3568-pwm\0rockchip,rk3328-pwm";
		reg = <0x00 0xfe6e0020 0x00 0x10>;
		#pwm-cells = <0x03>;
		pinctrl-names = "active";
		pinctrl-0 = <0xe1>;
		clocks = <0x1f 0x15a 0x1f 0x159>;
		clock-names = "pwm\0pclk";
		status = "disabled";
		phandle = <0x19f>;
	};

	pwm@fe6e0030 {
		compatible = "rockchip,rk3568-pwm\0rockchip,rk3328-pwm";
		reg = <0x00 0xfe6e0030 0x00 0x10>;
		interrupts = <0x00 0x53 0x04 0x00 0x57 0x04>;
		#pwm-cells = <0x03>;
		pinctrl-names = "active";
		pinctrl-0 = <0xe2>;
		clocks = <0x1f 0x15a 0x1f 0x159>;
		clock-names = "pwm\0pclk";
		status = "disabled";
		phandle = <0x1a0>;
	};

	pwm@fe6f0000 {
		compatible = "rockchip,rk3568-pwm\0rockchip,rk3328-pwm";
		reg = <0x00 0xfe6f0000 0x00 0x10>;
		#pwm-cells = <0x03>;
		pinctrl-names = "active";
		pinctrl-0 = <0xe3>;
		clocks = <0x1f 0x15d 0x1f 0x15c>;
		clock-names = "pwm\0pclk";
		status = "disabled";
		phandle = <0x1a1>;
	};

	pwm@fe6f0010 {
		compatible = "rockchip,rk3568-pwm\0rockchip,rk3328-pwm";
		reg = <0x00 0xfe6f0010 0x00 0x10>;
		#pwm-cells = <0x03>;
		pinctrl-names = "active";
		pinctrl-0 = <0xe4>;
		clocks = <0x1f 0x15d 0x1f 0x15c>;
		clock-names = "pwm\0pclk";
		status = "disabled";
		phandle = <0x1a2>;
	};

	pwm@fe6f0020 {
		compatible = "rockchip,rk3568-pwm\0rockchip,rk3328-pwm";
		reg = <0x00 0xfe6f0020 0x00 0x10>;
		#pwm-cells = <0x03>;
		pinctrl-names = "active";
		pinctrl-0 = <0xe5>;
		clocks = <0x1f 0x15d 0x1f 0x15c>;
		clock-names = "pwm\0pclk";
		status = "disabled";
		phandle = <0x1a3>;
	};

	pwm@fe6f0030 {
		compatible = "rockchip,rk3568-pwm\0rockchip,rk3328-pwm";
		reg = <0x00 0xfe6f0030 0x00 0x10>;
		interrupts = <0x00 0x54 0x04 0x00 0x58 0x04>;
		#pwm-cells = <0x03>;
		pinctrl-names = "active";
		pinctrl-0 = <0xe6>;
		clocks = <0x1f 0x15d 0x1f 0x15c>;
		clock-names = "pwm\0pclk";
		status = "disabled";
		phandle = <0x1a4>;
	};

	pwm@fe700000 {
		compatible = "rockchip,rk3568-pwm\0rockchip,rk3328-pwm";
		reg = <0x00 0xfe700000 0x00 0x10>;
		#pwm-cells = <0x03>;
		pinctrl-names = "active";
		pinctrl-0 = <0xe7>;
		clocks = <0x1f 0x160 0x1f 0x15f>;
		clock-names = "pwm\0pclk";
		status = "disabled";
		phandle = <0x1a5>;
	};

	pwm@fe700010 {
		compatible = "rockchip,rk3568-pwm\0rockchip,rk3328-pwm";
		reg = <0x00 0xfe700010 0x00 0x10>;
		#pwm-cells = <0x03>;
		pinctrl-names = "active";
		pinctrl-0 = <0xe8>;
		clocks = <0x1f 0x160 0x1f 0x15f>;
		clock-names = "pwm\0pclk";
		status = "disabled";
		phandle = <0x1a6>;
	};

	pwm@fe700020 {
		compatible = "rockchip,rk3568-pwm\0rockchip,rk3328-pwm";
		reg = <0x00 0xfe700020 0x00 0x10>;
		#pwm-cells = <0x03>;
		pinctrl-names = "active";
		pinctrl-0 = <0xe9>;
		clocks = <0x1f 0x160 0x1f 0x15f>;
		clock-names = "pwm\0pclk";
		status = "disabled";
		phandle = <0x1a7>;
	};

	pwm@fe700030 {
		compatible = "rockchip,rk3568-pwm\0rockchip,rk3328-pwm";
		reg = <0x00 0xfe700030 0x00 0x10>;
		interrupts = <0x00 0x55 0x04 0x00 0x59 0x04>;
		#pwm-cells = <0x03>;
		pinctrl-names = "active";
		pinctrl-0 = <0xea>;
		clocks = <0x1f 0x160 0x1f 0x15f>;
		clock-names = "pwm\0pclk";
		status = "disabled";
		phandle = <0x1a8>;
	};

	tsadc@fe710000 {
		compatible = "rockchip,rk3568-tsadc";
		reg = <0x00 0xfe710000 0x00 0x100>;
		interrupts = <0x00 0x73 0x04>;
		rockchip,grf = <0x32>;
		clocks = <0x1f 0x111 0x1f 0x10f>;
		clock-names = "tsadc\0apb_pclk";
		assigned-clocks = <0x1f 0x110 0x1f 0x111>;
		assigned-clock-rates = <0x1036640 0xaae60>;
		resets = <0x1f 0x182 0x1f 0x181 0x1f 0x1d7>;
		reset-names = "tsadc\0tsadc-apb\0tsadc-phy";
		#thermal-sensor-cells = <0x01>;
		rockchip,hw-tshut-temp = <0x1d4c0>;
		rockchip,hw-tshut-mode = <0x00>;
		rockchip,hw-tshut-polarity = <0x00>;
		pinctrl-names = "gpio\0otpout";
		pinctrl-0 = <0xeb>;
		pinctrl-1 = <0xec>;
		status = "okay";
		phandle = <0x1b>;
	};

	saradc@fe720000 {
		compatible = "rockchip,rk3568-saradc\0rockchip,rk3399-saradc";
		reg = <0x00 0xfe720000 0x00 0x100>;
		interrupts = <0x00 0x5d 0x04>;
		#io-channel-cells = <0x01>;
		clocks = <0x1f 0x113 0x1f 0x112>;
		clock-names = "saradc\0apb_pclk";
		resets = <0x1f 0x180>;
		reset-names = "saradc-apb";
		status = "okay";
		vref-supply = <0xed>;
		phandle = <0xff>;
	};

	mailbox@fe780000 {
		compatible = "rockchip,rk3568-mailbox\0rockchip,rk3368-mailbox";
		reg = <0x00 0xfe780000 0x00 0x1000>;
		interrupts = <0x00 0xb7 0x04 0x00 0xb8 0x04 0x00 0xb9 0x04 0x00 0xba 0x04>;
		clocks = <0x1f 0x11b>;
		clock-names = "pclk_mailbox";
		#mbox-cells = <0x01>;
		status = "disabled";
		phandle = <0x1a9>;
	};

	phy@fe830000 {
		compatible = "rockchip,rk3568-naneng-combphy";
		reg = <0x00 0xfe830000 0x00 0x100>;
		#phy-cells = <0x01>;
		clocks = <0x31 0x22 0x1f 0x17d 0x1f 0x7f>;
		clock-names = "refclk\0apbclk\0pipe_clk";
		assigned-clocks = <0x31 0x22>;
		assigned-clock-rates = <0x5f5e100>;
		resets = <0x1f 0x1c6 0x1f 0x1c7>;
		reset-names = "combphy-apb\0combphy";
		rockchip,pipe-grf = <0xee>;
		rockchip,pipe-phy-grf = <0xef>;
		status = "okay";
		phandle = <0x20>;
	};

	phy@fe840000 {
		compatible = "rockchip,rk3568-naneng-combphy";
		reg = <0x00 0xfe840000 0x00 0x100>;
		#phy-cells = <0x01>;
		clocks = <0x31 0x25 0x1f 0x17e 0x1f 0x7f>;
		clock-names = "refclk\0apbclk\0pipe_clk";
		assigned-clocks = <0x31 0x25>;
		assigned-clock-rates = <0x5f5e100>;
		resets = <0x1f 0x1c8 0x1f 0x1c9>;
		reset-names = "combphy-apb\0combphy";
		rockchip,pipe-grf = <0xee>;
		rockchip,pipe-phy-grf = <0xf0>;
		status = "disabled";
		phandle = <0x22>;
	};

	video-phy@fe850000 {
		compatible = "rockchip,rk3568-video-phy";
		reg = <0x00 0xfe850000 0x00 0x10000 0x00 0xfe060000 0x00 0x10000>;
		clocks = <0x31 0x17 0x1f 0x17a 0x1f 0xe8>;
		clock-names = "ref\0pclk_phy\0pclk_host";
		#clock-cells = <0x00>;
		resets = <0x1f 0x1bb>;
		reset-names = "rst";
		power-domains = <0x21 0x09>;
		#phy-cells = <0x00>;
		status = "okay";
		phandle = <0x2e>;
	};

	video-phy@fe860000 {
		compatible = "rockchip,rk3568-video-phy";
		reg = <0x00 0xfe860000 0x00 0x10000 0x00 0xfe070000 0x00 0x10000>;
		clocks = <0x31 0x19 0x1f 0x17b 0x1f 0xe9>;
		clock-names = "ref\0pclk_phy\0pclk_host";
		#clock-cells = <0x00>;
		resets = <0x1f 0x1bc>;
		reset-names = "rst";
		power-domains = <0x21 0x09>;
		#phy-cells = <0x00>;
		status = "disabled";
		phandle = <0x8a>;
	};

	csi2-dphy-hw@fe870000 {
		compatible = "rockchip,rk3568-csi2-dphy-hw";
		reg = <0x00 0xfe870000 0x00 0x1000>;
		clocks = <0x1f 0x179>;
		clock-names = "pclk";
		rockchip,grf = <0x32>;
		status = "disabled";
		phandle = <0xf1>;
	};

	csi2-dphy0 {
		compatible = "rockchip,rk3568-csi2-dphy";
		rockchip,hw = <0xf1>;
		status = "disabled";
		phandle = <0x1aa>;
	};

	csi2-dphy1 {
		compatible = "rockchip,rk3568-csi2-dphy";
		rockchip,hw = <0xf1>;
		status = "disabled";
		phandle = <0x1ab>;
	};

	csi2-dphy2 {
		compatible = "rockchip,rk3568-csi2-dphy";
		rockchip,hw = <0xf1>;
		status = "disabled";
		phandle = <0x1ac>;
	};

	usb2-phy@fe8a0000 {
		compatible = "rockchip,rk3568-usb2phy";
		reg = <0x00 0xfe8a0000 0x00 0x10000>;
		interrupts = <0x00 0x87 0x04>;
		clocks = <0x31 0x13>;
		clock-names = "phyclk";
		#clock-cells = <0x00>;
		assigned-clocks = <0x1f 0x0b>;
		assigned-clock-parents = <0x24>;
		clock-output-names = "usb480m_phy";
		rockchip,usbgrf = <0xf2>;
		status = "okay";
		phandle = <0x24>;

		host-port {
			#phy-cells = <0x00>;
			status = "okay";
			phandle = <0x25>;
		};

		otg-port {
			#phy-cells = <0x00>;
			status = "okay";
			phandle = <0x23>;
		};
	};

	usb2-phy@fe8b0000 {
		compatible = "rockchip,rk3568-usb2phy";
		reg = <0x00 0xfe8b0000 0x00 0x10000>;
		interrupts = <0x00 0x88 0x04>;
		clocks = <0x31 0x15>;
		clock-names = "phyclk";
		#clock-cells = <0x00>;
		rockchip,usbgrf = <0xf3>;
		status = "okay";
		phandle = <0x26>;

		host-port {
			#phy-cells = <0x00>;
			status = "okay";
			phandle = <0x28>;
		};

		otg-port {
			#phy-cells = <0x00>;
			status = "okay";
			phandle = <0x27>;
		};
	};

	pinctrl {
		compatible = "rockchip,rk3568-pinctrl";
		rockchip,grf = <0x32>;
		rockchip,pmu = <0x33>;
		#address-cells = <0x02>;
		#size-cells = <0x02>;
		ranges;
		phandle = <0xf4>;

		gpio@fdd60000 {
			compatible = "rockchip,gpio-bank";
			reg = <0x00 0xfdd60000 0x00 0x100>;
			interrupts = <0x00 0x21 0x04>;
			clocks = <0x31 0x2e 0x31 0x0c>;
			gpio-controller;
			#gpio-cells = <0x02>;
			gpio-ranges = <0xf4 0x00 0x00 0x20>;
			interrupt-controller;
			#interrupt-cells = <0x02>;
			phandle = <0x36>;
		};

		gpio@fe740000 {
			compatible = "rockchip,gpio-bank";
			reg = <0x00 0xfe740000 0x00 0x100>;
			interrupts = <0x00 0x22 0x04>;
			clocks = <0x1f 0x163 0x1f 0x164>;
			gpio-controller;
			#gpio-cells = <0x02>;
			gpio-ranges = <0xf4 0x00 0x20 0x20>;
			interrupt-controller;
			#interrupt-cells = <0x02>;
			phandle = <0x1ad>;
		};

		gpio@fe750000 {
			compatible = "rockchip,gpio-bank";
			reg = <0x00 0xfe750000 0x00 0x100>;
			interrupts = <0x00 0x23 0x04>;
			clocks = <0x1f 0x165 0x1f 0x166>;
			gpio-controller;
			#gpio-cells = <0x02>;
			gpio-ranges = <0xf4 0x00 0x40 0x20>;
			interrupt-controller;
			#interrupt-cells = <0x02>;
			phandle = <0x104>;
		};

		gpio@fe760000 {
			compatible = "rockchip,gpio-bank";
			reg = <0x00 0xfe760000 0x00 0x100>;
			interrupts = <0x00 0x24 0x04>;
			clocks = <0x1f 0x167 0x1f 0x168>;
			gpio-controller;
			#gpio-cells = <0x02>;
			gpio-ranges = <0xf4 0x00 0x60 0x20>;
			interrupt-controller;
			#interrupt-cells = <0x02>;
			phandle = <0x101>;
		};

		gpio@fe770000 {
			compatible = "rockchip,gpio-bank";
			reg = <0x00 0xfe770000 0x00 0x100>;
			interrupts = <0x00 0x25 0x04>;
			clocks = <0x1f 0x169 0x1f 0x16a>;
			gpio-controller;
			#gpio-cells = <0x02>;
			gpio-ranges = <0xf4 0x00 0x80 0x20>;
			interrupt-controller;
			#interrupt-cells = <0x02>;
			phandle = <0x40>;
		};

		pcfg-pull-up {
			bias-pull-up;
			phandle = <0xf7>;
		};

		pcfg-pull-down {
			bias-pull-down;
			phandle = <0xfe>;
		};

		pcfg-pull-none {
			bias-disable;
			phandle = <0xf5>;
		};

		pcfg-pull-none-drv-level-1 {
			bias-disable;
			drive-strength = <0x01>;
			phandle = <0xf9>;
		};

		pcfg-pull-none-drv-level-2 {
			bias-disable;
			drive-strength = <0x02>;
			phandle = <0xf8>;
		};

		pcfg-pull-none-drv-level-3 {
			bias-disable;
			drive-strength = <0x03>;
			phandle = <0xfd>;
		};

		pcfg-pull-up-drv-level-1 {
			bias-pull-up;
			drive-strength = <0x01>;
			phandle = <0xfc>;
		};

		pcfg-pull-up-drv-level-2 {
			bias-pull-up;
			drive-strength = <0x02>;
			phandle = <0xf6>;
		};

		pcfg-pull-none-smt {
			bias-disable;
			input-schmitt-enable;
			phandle = <0xfa>;
		};

		pcfg-output-low-pull-down {
			output-low;
			bias-pull-down;
			phandle = <0xfb>;
		};

		acodec {

			acodec-pins {
				rockchip,pins = <0x01 0x09 0x05 0xf5 0x01 0x01 0x05 0xf5 0x01 0x00 0x05 0xf5 0x01 0x07 0x05 0xf5 0x01 0x08 0x05 0xf5 0x01 0x03 0x05 0xf5 0x01 0x05 0x05 0xf5>;
				phandle = <0xbe>;
			};
		};

		cam {

			cam-sleep {
				rockchip,pins = <0x04 0x07 0x00 0xf5>;
				phandle = <0x1ae>;
			};

			camera-rst {
				rockchip,pins = <0x04 0x08 0x00 0xf5 0x04 0x09 0x00 0xf5>;
				phandle = <0x1af>;
			};

			flash-led {
				rockchip,pins = <0x04 0x06 0x00 0xf5>;
				phandle = <0x103>;
			};
		};

		clk32k {

			clk32k-out0 {
				rockchip,pins = <0x00 0x08 0x02 0xf5>;
				phandle = <0x1e>;
			};
		};

		ebc {

			ebc-pins {
				rockchip,pins = <0x04 0x10 0x02 0xf5 0x04 0x0b 0x02 0xf5 0x04 0x0c 0x02 0xf5 0x04 0x06 0x02 0xf5 0x04 0x11 0x02 0xf5 0x03 0x16 0x02 0xf5 0x03 0x17 0x02 0xf5 0x03 0x18 0x02 0xf5 0x03 0x19 0x02 0xf5 0x03 0x1a 0x02 0xf5 0x03 0x1b 0x02 0xf5 0x03 0x1c 0x02 0xf5 0x03 0x1d 0x02 0xf5 0x03 0x1e 0x02 0xf5 0x03 0x1f 0x02 0xf5 0x04 0x00 0x02 0xf5 0x04 0x01 0x02 0xf5 0x04 0x02 0x02 0xf5 0x04 0x03 0x02 0xf5 0x04 0x04 0x02 0xf5 0x04 0x05 0x02 0xf5 0x04 0x0e 0x02 0xf5 0x04 0x0f 0x02 0xf5>;
				phandle = <0x68>;
			};
		};

		hdmitx {

			hdmitxm0-cec {
				rockchip,pins = <0x04 0x19 0x01 0xf5>;
				phandle = <0x8e>;
			};

			hdmitx-scl {
				rockchip,pins = <0x04 0x17 0x01 0xf5>;
				phandle = <0x8c>;
			};

			hdmitx-sda {
				rockchip,pins = <0x04 0x18 0x01 0xf5>;
				phandle = <0x8d>;
			};
		};

		i2c0 {

			i2c0-xfer {
				rockchip,pins = <0x00 0x09 0x01 0xfa 0x00 0x0a 0x01 0xfa>;
				phandle = <0x34>;
			};
		};

		i2c1 {

			i2c1-xfer {
				rockchip,pins = <0x00 0x0b 0x01 0xfa 0x00 0x0c 0x01 0xfa>;
				phandle = <0xc0>;
			};
		};

		i2c2 {

			i2c2m1-xfer {
				rockchip,pins = <0x04 0x0d 0x01 0xfa 0x04 0x0c 0x01 0xfa>;
				phandle = <0xc1>;
			};
		};

		i2c3 {

			i2c3m1-xfer {
				rockchip,pins = <0x03 0x0d 0x04 0xfa 0x03 0x0e 0x04 0xfa>;
				phandle = <0xc2>;
			};
		};

		i2c4 {

			i2c4m0-xfer {
				rockchip,pins = <0x04 0x0b 0x01 0xfa 0x04 0x0a 0x01 0xfa>;
				phandle = <0xc3>;
			};
		};

		i2c5 {

			i2c5m0-xfer {
				rockchip,pins = <0x03 0x0b 0x04 0xfa 0x03 0x0c 0x04 0xfa>;
				phandle = <0xc4>;
			};
		};

		i2s1 {

			i2s1m0-lrcktx {
				rockchip,pins = <0x01 0x05 0x01 0xf5>;
				phandle = <0xac>;
			};

			i2s1m0-mclk {
				rockchip,pins = <0x01 0x02 0x01 0xf5>;
				phandle = <0x3f>;
			};

			i2s1m0-sclktx {
				rockchip,pins = <0x01 0x03 0x01 0xf5>;
				phandle = <0xab>;
			};

			i2s1m0-sdi0 {
				rockchip,pins = <0x01 0x0b 0x01 0xf5>;
				phandle = <0xad>;
			};

			i2s1m0-sdo0 {
				rockchip,pins = <0x01 0x07 0x01 0xf5>;
				phandle = <0xae>;
			};
		};

		i2s2 {

			i2s2m0-lrcktx {
				rockchip,pins = <0x02 0x13 0x01 0xf5>;
				phandle = <0xb0>;
			};

			i2s2m0-sclktx {
				rockchip,pins = <0x02 0x12 0x01 0xf5>;
				phandle = <0xaf>;
			};

			i2s2m0-sdi {
				rockchip,pins = <0x02 0x15 0x01 0xf5>;
				phandle = <0xb1>;
			};

			i2s2m0-sdo {
				rockchip,pins = <0x02 0x14 0x01 0xf5>;
				phandle = <0xb2>;
			};
		};

		i2s3 {

			i2s3m0-lrck {
				rockchip,pins = <0x03 0x04 0x04 0xf5>;
				phandle = <0xb4>;
			};

			i2s3m0-sclk {
				rockchip,pins = <0x03 0x03 0x04 0xf5>;
				phandle = <0xb3>;
			};

			i2s3m0-sdi {
				rockchip,pins = <0x03 0x06 0x04 0xf5>;
				phandle = <0xb5>;
			};

			i2s3m0-sdo {
				rockchip,pins = <0x03 0x05 0x04 0xf5>;
				phandle = <0xb6>;
			};
		};

		lcdc {

			lcdc-ctl {
				rockchip,pins = <0x03 0x00 0x01 0xf5 0x02 0x18 0x01 0xf5 0x02 0x19 0x01 0xf5 0x02 0x1a 0x01 0xf5 0x02 0x1b 0x01 0xf5 0x02 0x1c 0x01 0xf5 0x02 0x1d 0x01 0xf5 0x02 0x1e 0x01 0xf5 0x02 0x1f 0x01 0xf5 0x03 0x01 0x01 0xf5 0x03 0x02 0x01 0xf5 0x03 0x03 0x01 0xf5 0x03 0x04 0x01 0xf5 0x03 0x05 0x01 0xf5 0x03 0x06 0x01 0xf5 0x03 0x07 0x01 0xf5 0x03 0x08 0x01 0xf5 0x03 0x09 0x01 0xf5 0x03 0x0a 0x01 0xf5 0x03 0x0b 0x01 0xf5 0x03 0x0c 0x01 0xf5 0x03 0x0d 0x01 0xf5 0x03 0x0e 0x01 0xf5 0x03 0x0f 0x01 0xf5 0x03 0x10 0x01 0xf5 0x03 0x13 0x01 0xf5 0x03 0x11 0x01 0xf5 0x03 0x12 0x01 0xf5>;
				phandle = <0x30>;
			};
		};

		pdm {

			pdmm0-clk {
				rockchip,pins = <0x01 0x06 0x03 0xf5>;
				phandle = <0xb7>;
			};

			pdmm0-clk1 {
				rockchip,pins = <0x01 0x04 0x03 0xf5>;
				phandle = <0xb8>;
			};

			pdmm0-sdi0 {
				rockchip,pins = <0x01 0x0b 0x02 0xf5>;
				phandle = <0xb9>;
			};

			pdmm0-sdi1 {
				rockchip,pins = <0x01 0x0a 0x03 0xf5>;
				phandle = <0xba>;
			};

			pdmm0-sdi2 {
				rockchip,pins = <0x01 0x09 0x03 0xf5>;
				phandle = <0xbb>;
			};

			pdmm0-sdi3 {
				rockchip,pins = <0x01 0x08 0x03 0xf5>;
				phandle = <0xbc>;
			};
		};

		pmic {

			pmic_int {
				rockchip,pins = <0x00 0x03 0x00 0xf7>;
				phandle = <0x37>;
			};

			soc_slppin_gpio {
				rockchip,pins = <0x00 0x02 0x00 0xfb>;
				phandle = <0x3a>;
			};

			soc_slppin_slp {
				rockchip,pins = <0x00 0x02 0x01 0xf7>;
				phandle = <0x38>;
			};

			soc_slppin_rst {
				rockchip,pins = <0x00 0x02 0x02 0xf5>;
				phandle = <0x1b0>;
			};
		};

		pwm0 {

			pwm0m0-pins {
				rockchip,pins = <0x00 0x0f 0x01 0xf5>;
				phandle = <0x43>;
			};
		};

		pwm1 {

			pwm1m0-pins {
				rockchip,pins = <0x00 0x10 0x01 0xf5>;
				phandle = <0x44>;
			};
		};

		pwm2 {

			pwm2m0-pins {
				rockchip,pins = <0x00 0x11 0x01 0xf5>;
				phandle = <0x45>;
			};
		};

		pwm3 {

			pwm3-pins {
				rockchip,pins = <0x00 0x12 0x01 0xf5>;
				phandle = <0x46>;
			};
		};

		pwm4 {

			pwm4-pins {
				rockchip,pins = <0x00 0x13 0x01 0xf5>;
				phandle = <0xdf>;
			};
		};

		pwm5 {

			pwm5-pins {
				rockchip,pins = <0x00 0x14 0x01 0xf5>;
				phandle = <0xe0>;
			};
		};

		pwm6 {

			pwm6-pins {
				rockchip,pins = <0x00 0x15 0x01 0xf5>;
				phandle = <0xe1>;
			};
		};

		pwm7 {

			pwm7-pins {
				rockchip,pins = <0x00 0x16 0x01 0xf5>;
				phandle = <0xe2>;
			};
		};

		pwm8 {

			pwm8m0-pins {
				rockchip,pins = <0x03 0x09 0x05 0xf5>;
				phandle = <0xe3>;
			};
		};

		pwm9 {

			pwm9m0-pins {
				rockchip,pins = <0x03 0x0a 0x05 0xf5>;
				phandle = <0xe4>;
			};
		};

		pwm10 {

			pwm10m0-pins {
				rockchip,pins = <0x03 0x0d 0x05 0xf5>;
				phandle = <0xe5>;
			};
		};

		pwm11 {

			pwm11m0-pins {
				rockchip,pins = <0x03 0x0e 0x05 0xf5>;
				phandle = <0xe6>;
			};
		};

		pwm12 {

			pwm12m0-pins {
				rockchip,pins = <0x03 0x0f 0x02 0xf5>;
				phandle = <0xe7>;
			};
		};

		pwm13 {

			pwm13m0-pins {
				rockchip,pins = <0x03 0x10 0x02 0xf5>;
				phandle = <0xe8>;
			};
		};

		pwm14 {

			pwm14m0-pins {
				rockchip,pins = <0x03 0x14 0x01 0xf5>;
				phandle = <0xe9>;
			};
		};

		pwm15 {

			pwm15m0-pins {
				rockchip,pins = <0x03 0x15 0x01 0xf5>;
				phandle = <0xea>;
			};
		};

		scr {

			scr-pins {
				rockchip,pins = <0x01 0x02 0x03 0xf5 0x01 0x07 0x03 0xf7 0x01 0x03 0x03 0xf7 0x01 0x05 0x03 0xf5>;
				phandle = <0xbf>;
			};
		};

		sdmmc0 {

			sdmmc0-bus4 {
				rockchip,pins = <0x01 0x1d 0x01 0xf6 0x01 0x1e 0x01 0xf6 0x01 0x1f 0x01 0xf6 0x02 0x00 0x01 0xf6>;
				phandle = <0xa2>;
			};

			sdmmc0-clk {
				rockchip,pins = <0x02 0x02 0x01 0xf6>;
				phandle = <0xa3>;
			};

			sdmmc0-cmd {
				rockchip,pins = <0x02 0x01 0x01 0xf6>;
				phandle = <0xa4>;
			};

			sdmmc0-det {
				rockchip,pins = <0x00 0x04 0x01 0xf7>;
				phandle = <0xa5>;
			};
		};

		sdmmc1 {

			sdmmc1-bus4 {
				rockchip,pins = <0x02 0x03 0x01 0xf6 0x02 0x04 0x01 0xf6 0x02 0x05 0x01 0xf6 0x02 0x06 0x01 0xf6>;
				phandle = <0xa7>;
			};

			sdmmc1-clk {
				rockchip,pins = <0x02 0x08 0x01 0xf6>;
				phandle = <0xa9>;
			};

			sdmmc1-cmd {
				rockchip,pins = <0x02 0x07 0x01 0xf6>;
				phandle = <0xa8>;
			};
		};

		sdmmc2 {

			sdmmc2m1-bus4 {
				rockchip,pins = <0x03 0x01 0x05 0xf6 0x03 0x02 0x05 0xf6 0x03 0x03 0x05 0xf6 0x03 0x04 0x05 0xf6>;
				phandle = <0x92>;
			};

			sdmmc2m1-clk {
				rockchip,pins = <0x03 0x06 0x05 0xf6>;
				phandle = <0x93>;
			};

			sdmmc2m1-cmd {
				rockchip,pins = <0x03 0x05 0x05 0xf6>;
				phandle = <0x94>;
			};

			sdmmc2m1-det {
				rockchip,pins = <0x03 0x07 0x04 0xf7>;
				phandle = <0x95>;
			};
		};

		spdif {

			spdifm0-tx {
				rockchip,pins = <0x01 0x04 0x04 0xf5>;
				phandle = <0xbd>;
			};
		};

		spi0 {

			spi0m0-pins {
				rockchip,pins = <0x00 0x0d 0x02 0xf5 0x00 0x15 0x02 0xf5 0x00 0x0e 0x02 0xf5>;
				phandle = <0xc7>;
			};

			spi0m0-cs0 {
				rockchip,pins = <0x00 0x16 0x02 0xf5>;
				phandle = <0xc5>;
			};

			spi0m0-cs1 {
				rockchip,pins = <0x00 0x14 0x02 0xf5>;
				phandle = <0xc6>;
			};
		};

		spi1 {

			spi1m0-pins {
				rockchip,pins = <0x02 0x0d 0x03 0xf5 0x02 0x0e 0x03 0xf5 0x02 0x0f 0x04 0xf5>;
				phandle = <0xcb>;
			};

			spi1m0-cs0 {
				rockchip,pins = <0x02 0x10 0x04 0xf5>;
				phandle = <0xc9>;
			};

			spi1m0-cs1 {
				rockchip,pins = <0x02 0x16 0x03 0xf5>;
				phandle = <0xca>;
			};
		};

		spi2 {

			spi2m0-pins {
				rockchip,pins = <0x02 0x11 0x04 0xf5 0x02 0x12 0x04 0xf5 0x02 0x13 0x04 0xf5>;
				phandle = <0xcf>;
			};

			spi2m0-cs0 {
				rockchip,pins = <0x02 0x14 0x04 0xf5>;
				phandle = <0xcd>;
			};

			spi2m0-cs1 {
				rockchip,pins = <0x02 0x15 0x04 0xf5>;
				phandle = <0xce>;
			};
		};

		spi3 {

			spi3m0-pins {
				rockchip,pins = <0x04 0x0b 0x04 0xf5 0x04 0x08 0x04 0xf5 0x04 0x0a 0x04 0xf5>;
				phandle = <0xd3>;
			};

			spi3m0-cs0 {
				rockchip,pins = <0x04 0x06 0x04 0xf5>;
				phandle = <0xd1>;
			};

			spi3m0-cs1 {
				rockchip,pins = <0x04 0x07 0x04 0xf5>;
				phandle = <0xd2>;
			};
		};

		tsadc {

			tsadc-shutorg {
				rockchip,pins = <0x00 0x01 0x02 0xf5>;
				phandle = <0xec>;
			};
		};

		uart0 {

			uart0-xfer {
				rockchip,pins = <0x00 0x10 0x03 0xf7 0x00 0x11 0x03 0xf7>;
				phandle = <0x42>;
			};
		};

		uart1 {

			uart1m0-xfer {
				rockchip,pins = <0x02 0x0b 0x02 0xf7 0x02 0x0c 0x02 0xf7>;
				phandle = <0xd5>;
			};

			uart1m0-ctsn {
				rockchip,pins = <0x02 0x0e 0x02 0xf5>;
				phandle = <0xd6>;
			};

			uart1m0-rtsn {
				rockchip,pins = <0x02 0x0d 0x02 0xf5>;
				phandle = <0x10e>;
			};
		};

		uart2 {

			uart2m0-xfer {
				rockchip,pins = <0x00 0x18 0x01 0xf7 0x00 0x19 0x01 0xf7>;
				phandle = <0xd7>;
			};
		};

		uart3 {

			uart3m0-xfer {
				rockchip,pins = <0x01 0x00 0x02 0xf7 0x01 0x01 0x02 0xf7>;
				phandle = <0xd8>;
			};
		};

		uart4 {

			uart4m0-xfer {
				rockchip,pins = <0x01 0x04 0x02 0xf7 0x01 0x06 0x02 0xf7>;
				phandle = <0xd9>;
			};
		};

		uart5 {

			uart5m0-xfer {
				rockchip,pins = <0x02 0x01 0x03 0xf7 0x02 0x02 0x03 0xf7>;
				phandle = <0xda>;
			};
		};

		uart6 {

			uart6m0-xfer {
				rockchip,pins = <0x02 0x03 0x03 0xf7 0x02 0x04 0x03 0xf7>;
				phandle = <0xdb>;
			};
		};

		uart7 {

			uart7m0-xfer {
				rockchip,pins = <0x02 0x05 0x03 0xf7 0x02 0x06 0x03 0xf7>;
				phandle = <0xdc>;
			};
		};

		uart8 {

			uart8m0-xfer {
				rockchip,pins = <0x02 0x16 0x02 0xf7 0x02 0x15 0x03 0xf7>;
				phandle = <0xdd>;
			};
		};

		uart9 {

			uart9m0-xfer {
				rockchip,pins = <0x02 0x07 0x03 0xf7 0x02 0x08 0x03 0xf7>;
				phandle = <0xde>;
			};
		};

		spi0-hs {

			spi0m0-pins {
				rockchip,pins = <0x00 0x0d 0x02 0xfc 0x00 0x15 0x02 0xfc 0x00 0x0e 0x02 0xfc>;
				phandle = <0xc8>;
			};
		};

		spi1-hs {

			spi1m0-pins {
				rockchip,pins = <0x02 0x0d 0x03 0xfc 0x02 0x0e 0x03 0xfc 0x02 0x0f 0x04 0xfc>;
				phandle = <0xcc>;
			};
		};

		spi2-hs {

			spi2m0-pins {
				rockchip,pins = <0x02 0x11 0x04 0xfc 0x02 0x12 0x04 0xfc 0x02 0x13 0x04 0xfc>;
				phandle = <0xd0>;
			};
		};

		spi3-hs {

			spi3m0-pins {
				rockchip,pins = <0x04 0x0b 0x04 0xfc 0x04 0x08 0x04 0xfc 0x04 0x0a 0x04 0xfc>;
				phandle = <0xd4>;
			};
		};

		gpio-func {

			tsadc-gpio-func {
				rockchip,pins = <0x00 0x01 0x00 0xf5>;
				phandle = <0xeb>;
			};
		};

		tp {

			tp-gpio {
				rockchip,pins = <0x03 0x08 0x00 0xf7 0x03 0x09 0x00 0xf5>;
				phandle = <0x1b1>;
			};
		};

		headphone {

			hp-det {
				rockchip,pins = <0x04 0x16 0x00 0xf7>;
				phandle = <0x109>;
			};
		};

		lcd {

			lcd-rst-gpio {
				rockchip,pins = <0x00 0x12 0x00 0xf5>;
				phandle = <0x1b2>;
			};

			lcd-enable-gpio {
				rockchip,pins = <0x00 0x17 0x00 0xf5>;
				phandle = <0x1b3>;
			};

			lcd-stanby-gpio {
				rockchip,pins = <0x00 0x10 0x00 0xfe>;
				phandle = <0x1b4>;
			};
		};

		sensor {

			sensor-gpio {
				rockchip,pins = <0x03 0x02 0x00 0xf5>;
				phandle = <0x1b5>;
			};
		};

		sdio-pwrseq {

			wifi-enable-h {
				rockchip,pins = <0x00 0x00 0x00 0xf5 0x00 0x10 0x00 0xf5>;
				phandle = <0x10a>;
			};
		};

		vcc_sd {

			vcc-sd-h {
				rockchip,pins = <0x00 0x05 0x00 0xf5>;
				phandle = <0x10b>;
			};
		};

		wireless-wlan {

			wifi-host-wake-irq {
				rockchip,pins = <0x00 0x14 0x00 0xfe>;
				phandle = <0x10d>;
			};
		};

		wireless-bluetooth {

			uart1-gpios {
				rockchip,pins = <0x02 0x0d 0x00 0xf5>;
				phandle = <0x10f>;
			};
		};

		gpio-leds {

			leds-gpio {
				rockchip,pins = <0x00 0x12 0x00 0xf5 0x04 0x13 0x00 0xf5 0x04 0x14 0x00 0xf5 0x04 0x15 0x00 0xf5>;
				phandle = <0x10c>;
			};
		};

		led {

			charge-led-gpio {
				rockchip,pins = <0x03 0x11 0x00 0xf5 0x03 0x12 0x00 0xf5 0x03 0x13 0x00 0xf5>;
				phandle = <0x3e>;
			};
		};

		btns {

			btn-pins {
				rockchip,pins = <0x04 0x07 0x00 0xf7 0x04 0x0a 0x00 0xf7 0x04 0x10 0x00 0xf7 0x04 0x11 0x00 0xf7 0x04 0x05 0x00 0xf7 0x04 0x08 0x00 0xf7 0x04 0x09 0x00 0xf7 0x04 0x01 0x00 0xf7 0x04 0x02 0x00 0xf7 0x04 0x03 0x00 0xf7 0x04 0x04 0x00 0xf7 0x04 0x0b 0x00 0xf7 0x04 0x0c 0x00 0xf7 0x04 0x06 0x00 0xf7 0x03 0x0e 0x00 0xf7 0x03 0x0d 0x00 0xf7 0x03 0x0f 0x00 0xf7>;
				phandle = <0x100>;
			};
		};
	};

	chosen {
		bootargs = "earlycon=uart8250,mmio32,0xfe660000 console=ttyFIQ0";
		phandle = <0x1b6>;
	};

	fiq-debugger {
		compatible = "rockchip,fiq-debugger";
		rockchip,serial-id = <0x02>;
		rockchip,wake-irq = <0x00>;
		rockchip,irq-mode-enable = <0x01>;
		rockchip,baudrate = <0x16e360>;
		interrupts = <0x00 0xfc 0x08>;
		pinctrl-names = "default";
		pinctrl-0 = <0xd7>;
		status = "okay";
	};

	debug@fd904000 {
		compatible = "rockchip,debug";
		reg = <0x00 0xfd904000 0x00 0x1000 0x00 0xfd905000 0x00 0x1000 0x00 0xfd906000 0x00 0x1000 0x00 0xfd907000 0x00 0x1000>;
		phandle = <0x1b7>;
	};

	cspmu@fd90c000 {
		compatible = "rockchip,cspmu";
		reg = <0x00 0xfd90c000 0x00 0x1000 0x00 0xfd90d000 0x00 0x1000 0x00 0xfd90e000 0x00 0x1000 0x00 0xfd90f000 0x00 0x1000>;
		phandle = <0x1b8>;
	};

	adc-keys {
		compatible = "adc-keys";
		status = "okay";
		io-channels = <0xff 0x00>;
		io-channel-names = "buttons";
		keyup-threshold-microvolt = <0x1b7740>;
		poll-interval = <0x64>;
		phandle = <0x1b9>;

		vol-up-key {
			label = "volume up";
			linux,code = <0x73>;
			press-threshold-microvolt = <0x6d6>;
		};

		vol-down-key {
			label = "volume down";
			linux,code = <0x72>;
			press-threshold-microvolt = <0x48a1c>;
		};

		esc-key {
			linux,code = <0x01>;
			label = "esc";
			press-threshold-microvolt = <0xc92c0>;
		};

		select-key {
			linux,code = <0x36>;
			label = "select";
			press-threshold-microvolt = <0x1295d0>;
		};

		start-key {
			linux,code = <0x1c>;
			label = "start";
			press-threshold-microvolt = <0x1721e0>;
		};
	};

	singleadc-joypad {
		compatible = "singleadc-joypad";
		joypad-name = "retrogame_joypad";
		joypad-product = <0x1101>;
		joypad-revision = <0x100>;
		status = "okay";
		pinctrl-names = "default";
		pinctrl-0 = <0x100>;
		io-channel-names = "amux_adc";
		io-channels = <0xff 0x03>;
		amux-count = <0x04>;
		amux-a-gpios = <0x40 0x0e 0x01>;
		amux-b-gpios = <0x40 0x0d 0x01>;
		amux-en-gpios = <0x40 0x0f 0x01>;
		button-adc-scale = <0x02>;
		button-adc-deadzone = <0x40>;
		button-adc-fuzz = <0x20>;
		button-adc-flat = <0x20>;
		abs_x-p-tuning = <0x1c2>;
		abs_x-n-tuning = <0x1c2>;
		abs_y-p-tuning = <0x1c2>;
		abs_y-n-tuning = <0x1c2>;
		abs_rx-p-tuning = <0x1c2>;
		abs_rx-n-tuning = <0x1c2>;
		abs_ry-p-tuning = <0x1c2>;
		abs_ry-n-tuning = <0x1c2>;
		poll-interval = <0x0a>;
		phandle = <0x1ba>;

		sw1 {
			gpios = <0x40 0x0b 0x01>;
			label = "GPIO DPAD-UP";
			linux,code = <0x220>;
		};

		sw2 {
			gpios = <0x40 0x0c 0x01>;
			label = "GPIO DPAD-DOWN";
			linux,code = <0x221>;
		};

		sw3 {
			gpios = <0x40 0x09 0x01>;
			label = "GPIO DPAD-LEFT";
			linux,code = <0x222>;
		};

		sw4 {
			gpios = <0x40 0x0a 0x01>;
			label = "GPIO DPAD-RIGHT";
			linux,code = <0x223>;
		};

		sw5 {
			gpios = <0x40 0x07 0x01>;
			label = "GPIO BTN-A";
			linux,code = <0x130>;
		};

		sw6 {
			gpios = <0x40 0x06 0x01>;
			label = "GPIO BTN-B";
			linux,code = <0x131>;
		};

		sw7 {
			gpios = <0x40 0x05 0x01>;
			label = "GPIO BTN-X";
			linux,code = <0x133>;
		};

		sw8 {
			gpios = <0x40 0x08 0x01>;
			label = "GPIO BTN-Y";
			linux,code = <0x134>;
		};

		sw9 {
			gpios = <0x101 0x0e 0x01>;
			label = "GPIO BTN_SELECT";
			linux,code = <0x13a>;
		};

		sw10 {
			gpios = <0x101 0x0d 0x01>;
			label = "GPIO BTN_START";
			linux,code = <0x13b>;
		};

		sw11 {
			gpios = <0x101 0x0f 0x01>;
			label = "GPIO BTN_F";
			linux,code = <0x13c>;
		};

		sw12 {
			gpios = <0x40 0x01 0x01>;
			label = "GPIO BTN_TL";
			linux,code = <0x136>;
		};

		sw13 {
			gpios = <0x40 0x04 0x01>;
			label = "GPIO BTN_TR2";
			linux,code = <0x139>;
		};

		sw14 {
			gpios = <0x40 0x02 0x01>;
			label = "GPIO BTN_TL2";
			linux,code = <0x138>;
		};

		sw15 {
			gpios = <0x40 0x03 0x01>;
			label = "GPIO BTN_TR";
			linux,code = <0x137>;
		};

		sw16 {
			gpios = <0x40 0x10 0x01>;
			label = "GPIO BTN_THUMBL";
			linux,code = <0x13d>;
		};

		sw17 {
			gpios = <0x40 0x11 0x01>;
			label = "GPIO BTN_THUMBR";
			linux,code = <0x13e>;
		};
	};

	backlight {
		compatible = "pwm-backlight";
		pwms = <0x102 0x00 0x61a8 0x00>;
		brightness-levels = <0x00 0x14 0x14 0x15 0x15 0x16 0x16 0x17 0x17 0x18 0x18 0x19 0x19 0x1a 0x1a 0x1b 0x1b 0x1c 0x1c 0x1d 0x1d 0x1e 0x1e 0x1f 0x1f 0x20 0x20 0x21 0x21 0x22 0x22 0x23 0x23 0x24 0x24 0x25 0x25 0x26 0x26 0x27 0x28 0x29 0x2a 0x2b 0x2c 0x2d 0x2e 0x2f 0x30 0x31 0x32 0x32 0x33 0x34 0x35 0x36 0x37 0x37 0x38 0x39 0x3a 0x3b 0x3c 0x3d 0x3e 0x3f 0x40 0x40 0x41 0x41 0x42 0x43 0x44 0x45 0x46 0x47 0x47 0x48 0x49 0x4a 0x4b 0x4c 0x4d 0x4e 0x4f 0x4f 0x50 0x51 0x52 0x53 0x54 0x55 0x56 0x56 0x57 0x58 0x59 0x5a 0x5b 0x5c 0x5d 0x5e 0x5e 0x5f 0x60 0x61 0x62 0x63 0x64 0x65 0x65 0x66 0x67 0x68 0x69 0x6a 0x6b 0x6b 0x6c 0x6d 0x6e 0x6f 0x70 0x71 0x72 0x73 0x73 0x74 0x75 0x76 0x77 0x78 0x79 0x7a 0x7b 0x7b 0x7c 0x7d 0x7e 0x7f 0x80 0x81 0x82 0x82 0x83 0x84 0x85 0x86 0x87 0x88 0x88 0x89 0x8a 0x8b 0x8c 0x8d 0x8e 0x8f 0x8f 0x90 0x91 0x92 0x93 0x93 0x94 0x95 0x96 0x97 0x98 0x99 0x9a 0x9b 0x9c 0x9c 0x9d 0x9e 0x9f 0x9d 0x9e 0x9f 0xa0 0xa1 0xa2 0xa2 0xa3 0xa4 0xa5 0xa6 0xa7 0xa8 0xa9 0xa9 0xaa 0xab 0xac 0xad 0xae 0xaf 0xaf 0xb0 0xb1 0xb2 0xb3 0xb4 0xb5 0xb6 0xb6 0xb7 0xb8 0xb9 0xba 0xbb 0xbc 0xbd 0xbe 0xbe 0xbf 0xc0 0xc1 0xc2 0xc3 0xc4 0xc5 0xc5 0xc6 0xc7 0xc8 0xc9 0xca 0xcb 0xcc 0xcc 0xcd 0xce 0xcf 0xd0 0xd1 0xd1 0xd2 0xd3 0xd4 0xd5 0xd5 0xd6 0xd6 0xd7 0xd7 0xd8 0xd8 0xd9 0xd9 0xda 0xda 0xdb 0xdb 0xdc>;
		default-brightness-level = <0xc8>;
		phandle = <0x87>;
	};

	charge-animation {
		compatible = "rockchip,uboot-charge";
		rockchip,uboot-charge-on = <0x00>;
		rockchip,android-charge-on = <0x00>;
		rockchip,uboot-low-power-voltage = <0xd16>;
		rockchip,screen-on-voltage = <0xd48>;
		status = "disabled";
	};

	flash-rgb13h {
		status = "disabled";
		compatible = "led,rgb13h";
		label = "gpio-flash";
		pinctrl-names = "default";
		pinctrl-0 = <0x103>;
		led-max-microamp = <0x4e20>;
		flash-max-microamp = <0x4e20>;
		flash-max-timeout-us = <0xf4240>;
		enable-gpio = <0x40 0x06 0x00>;
		rockchip,camera-module-index = <0x00>;
		rockchip,camera-module-facing = "back";
		phandle = <0x1bb>;
	};

	rk817-sound {
		compatible = "simple-audio-card";
		simple-audio-card,format = "i2s";
		simple-audio-card,name = "rockchip,rk817-codec";
		simple-audio-card,mclk-fs = <0x100>;
		simple-audio-card,widgets = "Microphone\0Mic Jack\0Headphone\0Headphones\0Speaker\0Speaker";
		simple-audio-card,routing = "MICL\0Mic Jack\0Headphones\0HPOL\0Headphones\0HPOR\0Speaker\0SPKO";
		simple-audio-card,hp-det-gpio = <0x104 0x16 0x00>;
		simple-audio-card,pin-switches = "Speaker\0Headphones";

		simple-audio-card,cpu {
			sound-dai = <0x105>;
		};

		simple-audio-card,codec {
			sound-dai = <0x106>;
		};
	};

	hdmi-sound {
		compatible = "simple-audio-card";
		simple-audio-card,format = "i2s";
		simple-audio-card,mclk-fs = <0x80>;
		simple-audio-card,name = "rockchip,hdmi";
		status = "okay";
		phandle = <0x1bc>;

		simple-audio-card,cpu {
			sound-dai = <0x107>;
		};

		simple-audio-card,codec {
			sound-dai = <0x108>;
		};
	};

	vccsys {
		compatible = "regulator-fixed";
		regulator-name = "vcc3v8_sys";
		regulator-always-on;
		regulator-boot-on;
		regulator-min-microvolt = <0x39fbc0>;
		regulator-max-microvolt = <0x39fbc0>;
		phandle = <0x35>;
	};

	rk-headset {
		status = "okay";
		compatible = "rockchip_headset";
		headset_gpio = <0x40 0x16 0x00>;
		pinctrl-names = "default";
		pinctrl-0 = <0x109>;
		phandle = <0x1bd>;
	};

	sdio-pwrseq {
		compatible = "mmc-pwrseq-simple";
		pinctrl-names = "default";
		pinctrl-0 = <0x10a>;
		post-power-on-delay-ms = <0xc8>;
		reset-gpios = <0x36 0x00 0x00 0x36 0x10 0x01>;
		phandle = <0xa6>;
	};

	vcc-sd {
		compatible = "regulator-gpio";
		enable-active-low;
		enable-gpio = <0x36 0x05 0x01>;
		regulator-min-microvolt = <0x325aa0>;
		regulator-max-microvolt = <0x325aa0>;
		pinctrl-names = "default";
		pinctrl-0 = <0x10b>;
		regulator-name = "vcc_sd";
		states = <0x325aa0 0x00 0x325aa0 0x01>;
		phandle = <0xa1>;
	};

	gpio-leds {
		compatible = "gpio-leds";
		pinctrl-names = "default";
		pinctrl-0 = <0x10c>;
		phandle = <0x1be>;

		left_joystick {
			gpios = <0x40 0x14 0x00>;
			default-state = "on";
		};

		right_joystick {
			gpios = <0x40 0x15 0x00>;
			default-state = "on";
		};

		left_below {
			gpios = <0x36 0x12 0x00>;
			default-state = "on";
		};

		right_below {
			gpios = <0x40 0x13 0x00>;
			default-state = "on";
		};
	};

	wireless-wlan {
		compatible = "wlan-platdata";
		rockchip,grf = <0x32>;
		wifi_chip_type = "rtl8821cs";
		pinctrl-names = "default";
		pinctrl-0 = <0x10d>;
		WIFI,host_wake_irq = <0x36 0x14 0x00>;
		status = "okay";
	};

	wireless-bluetooth {
		compatible = "bluetooth-platdata";
		uart_rts_gpios = <0x104 0x0d 0x01>;
		pinctrl-names = "default\0rts_gpio";
		pinctrl-0 = <0x10e>;
		pinctrl-1 = <0x10f>;
		BT,reset_gpio = <0x36 0x11 0x00>;
		BT,wake_gpio = <0x36 0x0e 0x00>;
		BT,wake_host_irq = <0x36 0x0d 0x00>;
		status = "okay";
	};

	__symbols__ {
		ddr3_params = "/ddr3-params";
		ddr4_params = "/ddr4-params";
		lpddr3_params = "/lpddr3-params";
		lpddr4_params = "/lpddr4-params";
		lpddr4x_params = "/lpddr4x-params";
		cpu0 = "/cpus/cpu@0";
		cpu1 = "/cpus/cpu@100";
		cpu2 = "/cpus/cpu@200";
		cpu3 = "/cpus/cpu@300";
		CPU_SLEEP = "/cpus/idle-states/cpu-sleep";
		cpu0_opp_table = "/cpu0-opp-table";
		display_subsystem = "/display-subsystem";
		route_dsi0 = "/display-subsystem/route/route-dsi0";
		route_dsi1 = "/display-subsystem/route/route-dsi1";
		route_edp = "/display-subsystem/route/route-edp";
		route_hdmi = "/display-subsystem/route/route-hdmi";
		route_lvds = "/display-subsystem/route/route-lvds";
		route_rgb = "/display-subsystem/route/route-rgb";
		optee = "/firmware/optee";
		scmi = "/firmware/scmi";
		scmi_clk = "/firmware/scmi/protocol@14";
		sdei = "/firmware/sdei";
		mpp_srv = "/mpp-srv";
		reserved_memory = "/reserved-memory";
		drm_logo = "/reserved-memory/drm-logo@00000000";
		drm_cubic_lut = "/reserved-memory/drm-cubic-lut@00000000";
		ramoops = "/reserved-memory/ramoops@110000";
		rockchip_suspend = "/rockchip-suspend";
		rockchip_system_monitor = "/rockchip-system-monitor";
		thermal_zones = "/thermal-zones";
		soc_thermal = "/thermal-zones/soc-thermal";
		threshold = "/thermal-zones/soc-thermal/trips/trip-point-0";
		target = "/thermal-zones/soc-thermal/trips/trip-point-1";
		soc_crit = "/thermal-zones/soc-thermal/trips/soc-crit";
		gpu_thermal = "/thermal-zones/gpu-thermal";
		gmac1_clkin = "/external-gmac1-clock";
		gmac1_xpcsclk = "/xpcs-gmac1-clock";
		i2s1_mclkin_rx = "/i2s1-mclkin-rx";
		i2s1_mclkin_tx = "/i2s1-mclkin-tx";
		i2s2_mclkin = "/i2s2-mclkin";
		i2s3_mclkin = "/i2s3-mclkin";
		mpll = "/mpll";
		xin24m = "/xin24m";
		xin32k = "/xin32k";
		scmi_shmem = "/scmi-shmem@10f000";
		sata1 = "/sata@fc400000";
		sata2 = "/sata@fc800000";
		usbdrd30 = "/usbdrd";
		usbdrd_dwc3 = "/usbdrd/dwc3@fcc00000";
		usbhost30 = "/usbhost";
		usbhost_dwc3 = "/usbhost/dwc3@fd000000";
		gic = "/interrupt-controller@fd400000";
		its = "/interrupt-controller@fd400000/interrupt-controller@fd440000";
		usb_host0_ehci = "/usb@fd800000";
		usb_host0_ohci = "/usb@fd840000";
		usb_host1_ehci = "/usb@fd880000";
		usb_host1_ohci = "/usb@fd8c0000";
		xpcs = "/syscon@fda00000";
		pmugrf = "/syscon@fdc20000";
		pmu_io_domains = "/syscon@fdc20000/io-domains";
		reboot_mode = "/syscon@fdc20000/reboot-mode";
		pipegrf = "/syscon@fdc50000";
		grf = "/syscon@fdc60000";
		io_domains = "/syscon@fdc60000/io-domains";
		lvds = "/syscon@fdc60000/lvds";
		lvds_in_vp1 = "/syscon@fdc60000/lvds/ports/port@0/endpoint@1";
		lvds_in_vp2 = "/syscon@fdc60000/lvds/ports/port@0/endpoint@2";
		rgb = "/syscon@fdc60000/rgb";
		rgb_in_vp2 = "/syscon@fdc60000/rgb/ports/port@0/endpoint@2";
		pipe_phy_grf0 = "/syscon@fdc70000";
		pipe_phy_grf1 = "/syscon@fdc80000";
		pipe_phy_grf2 = "/syscon@fdc90000";
		usb2phy0_grf = "/syscon@fdca0000";
		usb2phy1_grf = "/syscon@fdca8000";
		edp_phy = "/edp-phy@fdcb0000";
		sram = "/sram@fdcc0000";
		rkvdec_sram = "/sram@fdcc0000/rkvdec-sram@0";
		pmucru = "/clock-controller@fdd00000";
		cru = "/clock-controller@fdd20000";
		i2c0 = "/i2c@fdd40000";
		vdd_cpu = "/i2c@fdd40000/tcs4525@1c";
		rk817 = "/i2c@fdd40000/pmic@20";
		pinctrl_rk8xx = "/i2c@fdd40000/pmic@20/pinctrl_rk8xx";
		rk817_slppin_null = "/i2c@fdd40000/pmic@20/pinctrl_rk8xx/rk817_slppin_null";
		rk817_slppin_slp = "/i2c@fdd40000/pmic@20/pinctrl_rk8xx/rk817_slppin_slp";
		rk817_slppin_pwrdn = "/i2c@fdd40000/pmic@20/pinctrl_rk8xx/rk817_slppin_pwrdn";
		rk817_slppin_rst = "/i2c@fdd40000/pmic@20/pinctrl_rk8xx/rk817_slppin_rst";
		vdd_logic = "/i2c@fdd40000/pmic@20/regulators/DCDC_REG1";
		vdd_gpu = "/i2c@fdd40000/pmic@20/regulators/DCDC_REG2";
		vcc_ddr = "/i2c@fdd40000/pmic@20/regulators/DCDC_REG3";
		vcc_3v3 = "/i2c@fdd40000/pmic@20/regulators/DCDC_REG4";
		vcca1v8_pmu = "/i2c@fdd40000/pmic@20/regulators/LDO_REG1";
		vdda_0v9 = "/i2c@fdd40000/pmic@20/regulators/LDO_REG2";
		vdda0v9_pmu = "/i2c@fdd40000/pmic@20/regulators/LDO_REG3";
		vccio_acodec = "/i2c@fdd40000/pmic@20/regulators/LDO_REG4";
		vccio_sd = "/i2c@fdd40000/pmic@20/regulators/LDO_REG5";
		vcc3v3_pmu = "/i2c@fdd40000/pmic@20/regulators/LDO_REG6";
		vcc_1v8 = "/i2c@fdd40000/pmic@20/regulators/LDO_REG7";
		vcc1v8_dvp = "/i2c@fdd40000/pmic@20/regulators/LDO_REG8";
		vcc2v8_dvp = "/i2c@fdd40000/pmic@20/regulators/LDO_REG9";
		dcdc_boost = "/i2c@fdd40000/pmic@20/regulators/BOOST";
		otg_switch = "/i2c@fdd40000/pmic@20/regulators/OTG_SWITCH";
		rk817_codec = "/i2c@fdd40000/pmic@20/codec";
		uart0 = "/serial@fdd50000";
		pwm0 = "/pwm@fdd70000";
		pwm1 = "/pwm@fdd70010";
		pwm2 = "/pwm@fdd70020";
		pwm3 = "/pwm@fdd70030";
		pmu = "/power-management@fdd90000";
		power = "/power-management@fdd90000/power-controller";
		rknpu = "/npu@fde40000";
		npu_opp_table = "/npu-opp-table";
		bus_npu = "/bus-npu";
		bus_npu_opp_table = "/bus-npu-opp-table";
		rknpu_mmu = "/iommu@fde4b000";
		gpu = "/gpu@fde60000";
		gpu_power_model = "/gpu@fde60000/power-model";
		gpu_opp_table = "/opp-table2";
		vdpu = "/vdpu@fdea0400";
		vdpu_mmu = "/iommu@fdea0800";
		rk_rga = "/rk_rga@fdeb0000";
		ebc = "/ebc@fdec0000";
		jpegd = "/jpegd@fded0000";
		jpegd_mmu = "/iommu@fded0480";
		vepu = "/vepu@fdee0000";
		vepu_mmu = "/iommu@fdee0800";
		iep = "/iep@fdef0000";
		iep_mmu = "/iommu@fdef0800";
		eink = "/eink@fdf00000";
		rkvenc = "/rkvenc@fdf40000";
		rkvenc_opp_table = "/rkvenc-opp-table";
		rkvenc_mmu = "/iommu@fdf40f00";
		rkvdec = "/rkvdec@fdf80200";
		rkvdec_mmu = "/iommu@fdf80800";
		mipi_csi2 = "/mipi-csi2@fdfb0000";
		rkcif = "/rkcif@fdfe0000";
		rkcif_mmu = "/iommu@fdfe0800";
		rkcif_dvp = "/rkcif_dvp";
		rkcif_dvp_sditf = "/rkcif_dvp_sditf";
		rkcif_mipi_lvds = "/rkcif_mipi_lvds";
		rkcif_mipi_lvds_sditf = "/rkcif_mipi_lvds_sditf";
		rkisp = "/rkisp@fdff0000";
		rkisp_mmu = "/iommu@fdff1a00";
		rkisp_vir0 = "/rkisp-vir0";
		rkisp_vir1 = "/rkisp-vir1";
		gmac1 = "/ethernet@fe010000";
		mdio1 = "/ethernet@fe010000/mdio";
		gmac1_stmmac_axi_setup = "/ethernet@fe010000/stmmac-axi-config";
		gmac1_mtl_rx_setup = "/ethernet@fe010000/rx-queues-config";
		gmac1_mtl_tx_setup = "/ethernet@fe010000/tx-queues-config";
		vop = "/vop@fe040000";
		vop_out = "/vop@fe040000/ports";
		vp0 = "/vop@fe040000/ports/port@0";
		vp0_out_dsi0 = "/vop@fe040000/ports/port@0/endpoint@0";
		vp0_out_dsi1 = "/vop@fe040000/ports/port@0/endpoint@1";
		vp0_out_edp = "/vop@fe040000/ports/port@0/endpoint@2";
		vp0_out_hdmi = "/vop@fe040000/ports/port@0/endpoint@3";
		vp1 = "/vop@fe040000/ports/port@1";
		vp1_out_dsi0 = "/vop@fe040000/ports/port@1/endpoint@0";
		vp1_out_dsi1 = "/vop@fe040000/ports/port@1/endpoint@1";
		vp1_out_edp = "/vop@fe040000/ports/port@1/endpoint@2";
		vp1_out_hdmi = "/vop@fe040000/ports/port@1/endpoint@3";
		vp1_out_lvds = "/vop@fe040000/ports/port@1/endpoint@4";
		vp2 = "/vop@fe040000/ports/port@2";
		vp2_out_lvds = "/vop@fe040000/ports/port@2/endpoint@0";
		vp2_out_rgb = "/vop@fe040000/ports/port@2/endpoint@1";
		vop_mmu = "/iommu@fe043e00";
		dsi0 = "/dsi@fe060000";
		dsi0_in = "/dsi@fe060000/ports/port@0";
		dsi0_in_vp0 = "/dsi@fe060000/ports/port@0/endpoint@0";
		dsi0_in_vp1 = "/dsi@fe060000/ports/port@0/endpoint@1";
		dsi_out_panel = "/dsi@fe060000/ports/port@1/endpoint";
		dsi0_panel = "/dsi@fe060000/panel@0";
		disp_timings0 = "/dsi@fe060000/panel@0/display-timings";
		dsi0_timing0 = "/dsi@fe060000/panel@0/display-timings/timing0";
		panel_in_dsi = "/dsi@fe060000/panel@0/ports/port@0/endpoint";
		dsi1 = "/dsi@fe070000";
		dsi1_in = "/dsi@fe070000/ports/port@0";
		dsi1_in_vp0 = "/dsi@fe070000/ports/port@0/endpoint@0";
		dsi1_in_vp1 = "/dsi@fe070000/ports/port@0/endpoint@1";
		hdmi = "/hdmi@fe0a0000";
		hdmi_in = "/hdmi@fe0a0000/ports/port";
		hdmi_in_vp0 = "/hdmi@fe0a0000/ports/port/endpoint@0";
		hdmi_in_vp1 = "/hdmi@fe0a0000/ports/port/endpoint@1";
		edp = "/edp@fe0c0000";
		edp_in = "/edp@fe0c0000/ports/port@0";
		edp_in_vp0 = "/edp@fe0c0000/ports/port@0/endpoint@0";
		edp_in_vp1 = "/edp@fe0c0000/ports/port@0/endpoint@1";
		nocp_cpu = "/nocp-cpu@fe102000";
		nocp_gpu_vpu_rga_venc = "/nocp-gpu-vpu-rga-venc@fe102400";
		nocp_npu_vdec = "/nocp-vdec@fe102800";
		nocp_vi_usb_peri_pipe = "/nocp-vi-usb-peri-pipe@fe102c00";
		nocp_vo = "/nocp-vo@fe103000";
		qos_gpu = "/qos@fe128000";
		qos_rkvenc_rd_m0 = "/qos@fe138080";
		qos_rkvenc_rd_m1 = "/qos@fe138100";
		qos_rkvenc_wr_m0 = "/qos@fe138180";
		qos_isp = "/qos@fe148000";
		qos_vicap0 = "/qos@fe148080";
		qos_vicap1 = "/qos@fe148100";
		qos_vpu = "/qos@fe150000";
		qos_ebc = "/qos@fe158000";
		qos_iep = "/qos@fe158100";
		qos_jpeg_dec = "/qos@fe158180";
		qos_jpeg_enc = "/qos@fe158200";
		qos_rga_rd = "/qos@fe158280";
		qos_rga_wr = "/qos@fe158300";
		qos_npu = "/qos@fe180000";
		qos_pcie2x1 = "/qos@fe190000";
		qos_sata1 = "/qos@fe190280";
		qos_sata2 = "/qos@fe190300";
		qos_usb3_0 = "/qos@fe190380";
		qos_usb3_1 = "/qos@fe190400";
		qos_rkvdec = "/qos@fe198000";
		qos_hdcp = "/qos@fe1a8000";
		qos_vop_m0 = "/qos@fe1a8080";
		qos_vop_m1 = "/qos@fe1a8100";
		sdmmc2 = "/dwmmc@fe000000";
		dfi = "/dfi@fe230000";
		dmc = "/dmc";
		dmc_fsp = "/dmc-fsp";
		dmc_opp_table = "/dmc-opp-table";
		dmcdbg = "/dmcdbg";
		pcie2x1 = "/pcie@fe260000";
		pcie2x1_intc = "/pcie@fe260000/legacy-interrupt-controller";
		sdmmc0 = "/dwmmc@fe2b0000";
		sdmmc1 = "/dwmmc@fe2c0000";
		sfc = "/sfc@fe300000";
		sdhci = "/sdhci@fe310000";
		nandc0 = "/nandc@fe330000";
		crypto = "/crypto@fe380000";
		rng = "/rng@fe388000";
		otp = "/otp@fe38c000";
		cpu_code = "/otp@fe38c000/cpu-code@2";
		otp_cpu_version = "/otp@fe38c000/cpu-version@8";
		mbist_vmin = "/otp@fe38c000/mbist-vmin@9";
		otp_id = "/otp@fe38c000/id@a";
		cpu_leakage = "/otp@fe38c000/cpu-leakage@1a";
		log_leakage = "/otp@fe38c000/log-leakage@1b";
		npu_leakage = "/otp@fe38c000/npu-leakage@1c";
		gpu_leakage = "/otp@fe38c000/gpu-leakage@1d";
		core_pvtm = "/otp@fe38c000/core-pvtm@2a";
		i2s0_8ch = "/i2s@fe400000";
		i2s1_8ch = "/i2s@fe410000";
		i2s2_2ch = "/i2s@fe420000";
		i2s3_2ch = "/i2s@fe430000";
		pdm = "/pdm@fe440000";
		vad = "/vad@fe450000";
		spdif_8ch = "/spdif@fe460000";
		audpwm = "/audpwm@fe470000";
		dig_acodec = "/codec-digital@fe478000";
		dmac0 = "/dmac@fe530000";
		dmac1 = "/dmac@fe550000";
		scr = "/rkscr@fe560000";
		can0 = "/can@fe570000";
		can1 = "/can@fe580000";
		can2 = "/can@fe590000";
		i2c1 = "/i2c@fe5a0000";
		i2c2 = "/i2c@fe5b0000";
		i2c3 = "/i2c@fe5c0000";
		i2c4 = "/i2c@fe5d0000";
		i2c5 = "/i2c@fe5e0000";
		rktimer = "/timer@fe5f0000";
		wdt = "/watchdog@fe600000";
		spi0 = "/spi@fe610000";
		spi1 = "/spi@fe620000";
		spi2 = "/spi@fe630000";
		spi3 = "/spi@fe640000";
		uart1 = "/serial@fe650000";
		uart2 = "/serial@fe660000";
		uart3 = "/serial@fe670000";
		uart4 = "/serial@fe680000";
		uart5 = "/serial@fe690000";
		uart6 = "/serial@fe6a0000";
		uart7 = "/serial@fe6b0000";
		uart8 = "/serial@fe6c0000";
		uart9 = "/serial@fe6d0000";
		pwm4 = "/pwm@fe6e0000";
		pwm5 = "/pwm@fe6e0010";
		pwm6 = "/pwm@fe6e0020";
		pwm7 = "/pwm@fe6e0030";
		pwm8 = "/pwm@fe6f0000";
		pwm9 = "/pwm@fe6f0010";
		pwm10 = "/pwm@fe6f0020";
		pwm11 = "/pwm@fe6f0030";
		pwm12 = "/pwm@fe700000";
		pwm13 = "/pwm@fe700010";
		pwm14 = "/pwm@fe700020";
		pwm15 = "/pwm@fe700030";
		tsadc = "/tsadc@fe710000";
		saradc = "/saradc@fe720000";
		mailbox = "/mailbox@fe780000";
		combphy1_usq = "/phy@fe830000";
		combphy2_psq = "/phy@fe840000";
		video_phy0 = "/video-phy@fe850000";
		video_phy1 = "/video-phy@fe860000";
		csi2_dphy_hw = "/csi2-dphy-hw@fe870000";
		csi2_dphy0 = "/csi2-dphy0";
		csi2_dphy1 = "/csi2-dphy1";
		csi2_dphy2 = "/csi2-dphy2";
		usb2phy0 = "/usb2-phy@fe8a0000";
		u2phy0_host = "/usb2-phy@fe8a0000/host-port";
		u2phy0_otg = "/usb2-phy@fe8a0000/otg-port";
		usb2phy1 = "/usb2-phy@fe8b0000";
		u2phy1_host = "/usb2-phy@fe8b0000/host-port";
		u2phy1_otg = "/usb2-phy@fe8b0000/otg-port";
		pinctrl = "/pinctrl";
		gpio0 = "/pinctrl/gpio@fdd60000";
		gpio1 = "/pinctrl/gpio@fe740000";
		gpio2 = "/pinctrl/gpio@fe750000";
		gpio3 = "/pinctrl/gpio@fe760000";
		gpio4 = "/pinctrl/gpio@fe770000";
		pcfg_pull_up = "/pinctrl/pcfg-pull-up";
		pcfg_pull_down = "/pinctrl/pcfg-pull-down";
		pcfg_pull_none = "/pinctrl/pcfg-pull-none";
		pcfg_pull_none_drv_level_1 = "/pinctrl/pcfg-pull-none-drv-level-1";
		pcfg_pull_none_drv_level_2 = "/pinctrl/pcfg-pull-none-drv-level-2";
		pcfg_pull_none_drv_level_3 = "/pinctrl/pcfg-pull-none-drv-level-3";
		pcfg_pull_up_drv_level_1 = "/pinctrl/pcfg-pull-up-drv-level-1";
		pcfg_pull_up_drv_level_2 = "/pinctrl/pcfg-pull-up-drv-level-2";
		pcfg_pull_none_smt = "/pinctrl/pcfg-pull-none-smt";
		pcfg_output_low_pull_down = "/pinctrl/pcfg-output-low-pull-down";
		acodec_pins = "/pinctrl/acodec/acodec-pins";
		cam_sleep = "/pinctrl/cam/cam-sleep";
		camera_rst = "/pinctrl/cam/camera-rst";
		flash_led_gpios = "/pinctrl/cam/flash-led";
		clk32k_out0 = "/pinctrl/clk32k/clk32k-out0";
		ebc_pins = "/pinctrl/ebc/ebc-pins";
		hdmitxm0_cec = "/pinctrl/hdmitx/hdmitxm0-cec";
		hdmitx_scl = "/pinctrl/hdmitx/hdmitx-scl";
		hdmitx_sda = "/pinctrl/hdmitx/hdmitx-sda";
		i2c0_xfer = "/pinctrl/i2c0/i2c0-xfer";
		i2c1_xfer = "/pinctrl/i2c1/i2c1-xfer";
		i2c2m1_xfer = "/pinctrl/i2c2/i2c2m1-xfer";
		i2c3m1_xfer = "/pinctrl/i2c3/i2c3m1-xfer";
		i2c4m0_xfer = "/pinctrl/i2c4/i2c4m0-xfer";
		i2c5m0_xfer = "/pinctrl/i2c5/i2c5m0-xfer";
		i2s1m0_lrcktx = "/pinctrl/i2s1/i2s1m0-lrcktx";
		i2s1m0_mclk = "/pinctrl/i2s1/i2s1m0-mclk";
		i2s1m0_sclktx = "/pinctrl/i2s1/i2s1m0-sclktx";
		i2s1m0_sdi0 = "/pinctrl/i2s1/i2s1m0-sdi0";
		i2s1m0_sdo0 = "/pinctrl/i2s1/i2s1m0-sdo0";
		i2s2m0_lrcktx = "/pinctrl/i2s2/i2s2m0-lrcktx";
		i2s2m0_sclktx = "/pinctrl/i2s2/i2s2m0-sclktx";
		i2s2m0_sdi = "/pinctrl/i2s2/i2s2m0-sdi";
		i2s2m0_sdo = "/pinctrl/i2s2/i2s2m0-sdo";
		i2s3m0_lrck = "/pinctrl/i2s3/i2s3m0-lrck";
		i2s3m0_sclk = "/pinctrl/i2s3/i2s3m0-sclk";
		i2s3m0_sdi = "/pinctrl/i2s3/i2s3m0-sdi";
		i2s3m0_sdo = "/pinctrl/i2s3/i2s3m0-sdo";
		lcdc_ctl = "/pinctrl/lcdc/lcdc-ctl";
		pdmm0_clk = "/pinctrl/pdm/pdmm0-clk";
		pdmm0_clk1 = "/pinctrl/pdm/pdmm0-clk1";
		pdmm0_sdi0 = "/pinctrl/pdm/pdmm0-sdi0";
		pdmm0_sdi1 = "/pinctrl/pdm/pdmm0-sdi1";
		pdmm0_sdi2 = "/pinctrl/pdm/pdmm0-sdi2";
		pdmm0_sdi3 = "/pinctrl/pdm/pdmm0-sdi3";
		pmic_int = "/pinctrl/pmic/pmic_int";
		soc_slppin_gpio = "/pinctrl/pmic/soc_slppin_gpio";
		soc_slppin_slp = "/pinctrl/pmic/soc_slppin_slp";
		soc_slppin_rst = "/pinctrl/pmic/soc_slppin_rst";
		pwm0m0_pins = "/pinctrl/pwm0/pwm0m0-pins";
		pwm1m0_pins = "/pinctrl/pwm1/pwm1m0-pins";
		pwm2m0_pins = "/pinctrl/pwm2/pwm2m0-pins";
		pwm3_pins = "/pinctrl/pwm3/pwm3-pins";
		pwm4_pins = "/pinctrl/pwm4/pwm4-pins";
		pwm5_pins = "/pinctrl/pwm5/pwm5-pins";
		pwm6_pins = "/pinctrl/pwm6/pwm6-pins";
		pwm7_pins = "/pinctrl/pwm7/pwm7-pins";
		pwm8m0_pins = "/pinctrl/pwm8/pwm8m0-pins";
		pwm9m0_pins = "/pinctrl/pwm9/pwm9m0-pins";
		pwm10m0_pins = "/pinctrl/pwm10/pwm10m0-pins";
		pwm11m0_pins = "/pinctrl/pwm11/pwm11m0-pins";
		pwm12m0_pins = "/pinctrl/pwm12/pwm12m0-pins";
		pwm13m0_pins = "/pinctrl/pwm13/pwm13m0-pins";
		pwm14m0_pins = "/pinctrl/pwm14/pwm14m0-pins";
		pwm15m0_pins = "/pinctrl/pwm15/pwm15m0-pins";
		scr_pins = "/pinctrl/scr/scr-pins";
		sdmmc0_bus4 = "/pinctrl/sdmmc0/sdmmc0-bus4";
		sdmmc0_clk = "/pinctrl/sdmmc0/sdmmc0-clk";
		sdmmc0_cmd = "/pinctrl/sdmmc0/sdmmc0-cmd";
		sdmmc0_det = "/pinctrl/sdmmc0/sdmmc0-det";
		sdmmc1_bus4 = "/pinctrl/sdmmc1/sdmmc1-bus4";
		sdmmc1_clk = "/pinctrl/sdmmc1/sdmmc1-clk";
		sdmmc1_cmd = "/pinctrl/sdmmc1/sdmmc1-cmd";
		sdmmc2m1_bus4 = "/pinctrl/sdmmc2/sdmmc2m1-bus4";
		sdmmc2m1_clk = "/pinctrl/sdmmc2/sdmmc2m1-clk";
		sdmmc2m1_cmd = "/pinctrl/sdmmc2/sdmmc2m1-cmd";
		sdmmc2m1_det = "/pinctrl/sdmmc2/sdmmc2m1-det";
		spdifm0_tx = "/pinctrl/spdif/spdifm0-tx";
		spi0m0_pins = "/pinctrl/spi0/spi0m0-pins";
		spi0m0_cs0 = "/pinctrl/spi0/spi0m0-cs0";
		spi0m0_cs1 = "/pinctrl/spi0/spi0m0-cs1";
		spi1m0_pins = "/pinctrl/spi1/spi1m0-pins";
		spi1m0_cs0 = "/pinctrl/spi1/spi1m0-cs0";
		spi1m0_cs1 = "/pinctrl/spi1/spi1m0-cs1";
		spi2m0_pins = "/pinctrl/spi2/spi2m0-pins";
		spi2m0_cs0 = "/pinctrl/spi2/spi2m0-cs0";
		spi2m0_cs1 = "/pinctrl/spi2/spi2m0-cs1";
		spi3m0_pins = "/pinctrl/spi3/spi3m0-pins";
		spi3m0_cs0 = "/pinctrl/spi3/spi3m0-cs0";
		spi3m0_cs1 = "/pinctrl/spi3/spi3m0-cs1";
		tsadc_shutorg = "/pinctrl/tsadc/tsadc-shutorg";
		uart0_xfer = "/pinctrl/uart0/uart0-xfer";
		uart1m0_xfer = "/pinctrl/uart1/uart1m0-xfer";
		uart1m0_ctsn = "/pinctrl/uart1/uart1m0-ctsn";
		uart1m0_rtsn = "/pinctrl/uart1/uart1m0-rtsn";
		uart2m0_xfer = "/pinctrl/uart2/uart2m0-xfer";
		uart3m0_xfer = "/pinctrl/uart3/uart3m0-xfer";
		uart4m0_xfer = "/pinctrl/uart4/uart4m0-xfer";
		uart5m0_xfer = "/pinctrl/uart5/uart5m0-xfer";
		uart6m0_xfer = "/pinctrl/uart6/uart6m0-xfer";
		uart7m0_xfer = "/pinctrl/uart7/uart7m0-xfer";
		uart8m0_xfer = "/pinctrl/uart8/uart8m0-xfer";
		uart9m0_xfer = "/pinctrl/uart9/uart9m0-xfer";
		spi0m0_pins_hs = "/pinctrl/spi0-hs/spi0m0-pins";
		spi1m0_pins_hs = "/pinctrl/spi1-hs/spi1m0-pins";
		spi2m0_pins_hs = "/pinctrl/spi2-hs/spi2m0-pins";
		spi3m0_pins_hs = "/pinctrl/spi3-hs/spi3m0-pins";
		tsadc_gpio_func = "/pinctrl/gpio-func/tsadc-gpio-func";
		tp_gpio = "/pinctrl/tp/tp-gpio";
		hp_det = "/pinctrl/headphone/hp-det";
		lcd_rst_gpio = "/pinctrl/lcd/lcd-rst-gpio";
		lcd_enable_gpio = "/pinctrl/lcd/lcd-enable-gpio";
		lcd_stanby_gpio = "/pinctrl/lcd/lcd-stanby-gpio";
		sensor_gpio = "/pinctrl/sensor/sensor-gpio";
		wifi_enable_h = "/pinctrl/sdio-pwrseq/wifi-enable-h";
		vcc_sd_h = "/pinctrl/vcc_sd/vcc-sd-h";
		wifi_host_wake_irq = "/pinctrl/wireless-wlan/wifi-host-wake-irq";
		uart1_gpios = "/pinctrl/wireless-bluetooth/uart1-gpios";
		leds_gpio = "/pinctrl/gpio-leds/leds-gpio";
		charge_led_gpio = "/pinctrl/led/charge-led-gpio";
		btn_pins = "/pinctrl/btns/btn-pins";
		chosen = "/chosen";
		debug = "/debug@fd904000";
		cspmu = "/cspmu@fd90c000";
		adc_keys = "/adc-keys";
		joypad = "/singleadc-joypad";
		backlight = "/backlight";
		flash_rgb13h = "/flash-rgb13h";
		hdmi_sound = "/hdmi-sound";
		vccsys = "/vccsys";
		rk_headset = "/rk-headset";
		sdio_pwrseq = "/sdio-pwrseq";
		vcc_sd = "/vcc-sd";
		leds = "/gpio-leds";
	};
};
